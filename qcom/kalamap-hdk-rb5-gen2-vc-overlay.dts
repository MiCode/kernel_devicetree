/dts-v1/;
/plugin/;

#include "kalamap-hdk-rb5-gen2-vc.dtsi"

/ {
	model = "Qualcomm Technologies, Inc. Kalamap HDK RB5 Gen2 VC";
	compatible = "qcom,kalamap-hdk", "qcom,kalamap", "qcom,hdk";
	qcom,msm-id = <603 0x20000>;
	qcom,board-id = <0x1001f 0x6>;
};

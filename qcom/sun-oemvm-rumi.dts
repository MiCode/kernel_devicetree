// SPDX-License-Identifier: BSD-3-Clause
/*
 * Copyright (c) 2023 Qualcomm Innovation Center, Inc. All rights reserved.
 */

/dts-v1/;

#include "sun-oemvm.dtsi"
#include "sun-oemvm-rumi.dtsi"

/ {
	model = "Qualcomm Technologies, Inc. Sun OEMVM RUMI";
	compatible = "qcom,sun-rumi", "qcom,sun", "qcom,rumi";
	qcom,board-id = <15 0>;
};

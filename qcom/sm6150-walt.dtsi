// SPDX-License-Identifier: BSD-3-Clause
/*
 * Copyright (c) 2025 Qualcomm Innovation Center, Inc. All rights reserved.
 */

&soc {
	walt {
		#address-cells = <1>;
		#size-cells = <1>;
		ranges;

		qcom,cycle-cntr {
			compatible = "qcom,cycle-cntr-hw";
			reg = <0x18323000 0x1400>, <0x18325800 0x1400>;
			reg-names = "freq-domain0", "freq-domain1";
		};
	};
};

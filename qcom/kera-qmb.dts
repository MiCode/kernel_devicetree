// SPDX-License-Identifier: BSD-3-Clause
/*
 * Copyright (c) Qualcomm Technologies, Inc. and/or its subsidiaries.
 */

/dts-v1/;

#include "kera-qmb.dtsi"

/ {
	model = "Qualcomm Technologies, Inc. Kera QMB SoC";
	compatible = "qcom,kera-qmb";
	qcom,board-id = <0 0>;
};

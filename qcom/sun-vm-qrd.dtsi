// SPDX-License-Identifier: BSD-3-Clause
/*
 * Copyright (c) 2024 Qualcomm Innovation Center, Inc. All rights reserved.
 */
&soc {
};


&qupv3_se4_spi {
	status = "ok";
	qcom,touch-active = "st,fts";

	st_fts@0 {
		compatible = "st,fts";
		reg = <0x0>;
		st,irq-flags = <8>;
		spi-max-frequency = <1000000>;

		st,touch-type = "primary";
		st,qts_en;
		qts,trusted-touch-mode = "vm_mode";
		qts,touch-environment = "pvm";
		qts,trusted-touch-type = "primary";
		qts,trusted-touch-spi-irq = <652>;
		qts,trusted-touch-io-bases = <0xa90000>;
		qts,trusted-touch-io-sizes = <0x1000>;
		qts,trusted-touch-vm-gpio-list = <&tlmm 48 0 &tlmm 49 0 &tlmm 50 0
						&tlmm 51 0 &tlmm 161 0 &tlmm 162 0x2008>;

	};
};

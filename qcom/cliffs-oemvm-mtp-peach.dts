/dts-v1/;

#include "cliffs-oemvm.dtsi"
#include "cliffs-oemvm-mtp-peach.dtsi"

/ {
	model = "Qualcomm Technologies, Inc. Cliffs OEMVM MTP + peach WLAN";
	compatible = "qcom,cliffs-mtp", "qcom,cliffs", "qcom,mtp";
	qcom,board-id = <8 3>;
};

// SPDX-License-Identifier: BSD-3-Clause
/*
 * Copyright (c) 2024 Qualcomm Innovation Center, Inc. All rights reserved.
 */

/dts-v1/;

#include "canoe-v2.dtsi"

/ {
	model = "Qualcomm Technologies, Inc. Canoe v2 SoC";
	compatible = "qcom,canoe";
	qcom,board-id = <0 0>;
};


// SPDX-License-Identifier: BSD-3-Clause
/*
 * Copyright (c) 2025 Qualcomm Innovation Center, Inc. All rights reserved.
 */

/dts-v1/;

#include "tunap-vm.dtsi"

/ {
	model = "Qualcomm Technologies, Inc. TunaP SVM SoC";
	compatible = "qcom,tunap";
	qcom,board-id = <0 0>;
};

// SPDX-License-Identifier: BSD-3-Clause
/*
 * Copyright (c) 2024 Qualcomm Innovation Center, Inc. All rights reserved.
 */

/dts-v1/;

#include "kera-oemvm.dtsi"
#include "kera-oemvm-atp.dtsi"

/ {
	model = "Qualcomm Technologies, Inc. Kera OEMVM ATP";
	compatible = "qcom,kera-atp", "qcom,kera", "qcom,kerap-atp", "qcom,kerap",
			"qcom,atp";

	qcom,board-id = <33 0>;
};

/dts-v1/;

#include "sa6155p-vm.dtsi"
#include "sa6155p-vm-la.dtsi"

/ {
	model = "Qualcomm Technologies, Inc. SA6155P Guest Virtual Machine";
	compatible = "qcom,sa6155p", "qcom,quinvm";
	qcom,board-id = <0x0 0x1000001>;
};

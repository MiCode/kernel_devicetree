// SPDX-License-Identifier: BSD-3-Clause
/*
 * Copyright (c) 2024 Qualcomm Innovation Center, Inc. All rights reserved.
 */

/dts-v1/;

#include "parrotp.dtsi"

/ {
	model = "Qualcomm Technologies, Inc. ParrotP SoC";
	compatible = "qcom,parrotp";
	qcom,board-id = <0 0>;
};

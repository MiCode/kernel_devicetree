/dts-v1/;
/plugin/;

#include "niobe-idp-edp.dtsi"

/ {
	model = "Qualcomm Technologies, Inc. Niobe IDP EDP";
	compatible = "qcom,niobe-idp", "qcom,niobe", "qcom,idp";
	qcom,msm-id = <629 0x10000>;
	qcom,board-id = <0x10022 3>;
};

// SPDX-License-Identifier: BSD-3-Clause
/*
 * Copyright (c) 2023-2024 Qualcomm Innovation Center, Inc. All rights reserved.
 */
/dts-v1/;

#include "sun-oemvm.dtsi"
#include "sun-oemvm-qrd.dtsi"

/ {
	model = "Qualcomm Technologies, Inc. Sun OEMVM QRD";
	compatible = "qcom,sun-qrd", "qcom,sun", "qcom,qrd";
	qcom,board-id = <0x1000B 0>, <0x2000B 0>, <0x3000B 0>;
};

/dts-v1/;

#include "cliffs-vm.dtsi"
#include "cliffs-vm-mtp-kiwi.dtsi"

/ {
	model = "Qualcomm Technologies, Inc. Cliffs SVM MTP + kiwi WLAN";
	compatible = "qcom,cliffs-mtp", "qcom,cliffs", "qcom,mtp";
	qcom,board-id = <8 2>;
};

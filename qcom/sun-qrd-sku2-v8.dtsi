// SPDX-License-Identifier: BSD-3-Clause
/*
 * Copyright (c) 2023 Qualcomm Innovation Center, Inc. All rights reserved.
 */

#include "sun-qrd-sku2.dtsi"
#include "sun-pmic-overlay-v8.dtsi"

&regulator_ocp_notifier {
	/delete-property/ periph-9a4-supply; /* S4J */
	periph-5a7-supply = <&S5F>;
	/delete-property/ periph-5aa-supply; /* S6F */
	periph-5b0-supply = <&S8F_LEVEL>;
};

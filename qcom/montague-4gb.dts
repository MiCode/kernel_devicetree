// SPDX-License-Identifier: BSD-3-Clause
/*
 * Copyright (c) Qualcomm Technologies, Inc. and/or its subsidiaries.
 */

/dts-v1/;

#include "montague-4gb.dtsi"

/ {
	model = "Qualcomm Technologies, Inc. Montague 4Gb SoC";
	compatible = "qcom,montague";
	qcom,board-id = <0 0x600>;
};

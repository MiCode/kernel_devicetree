/dts-v1/;

#include "lagoon.dtsi"
#include "gauguin-sm6350.dtsi"

/ {
	model = "Qualcomm Technologies, Inc. Gauguin";
	compatible = "qcom,lagoon-qrd", "qcom,lagoon", "qcom,qrd";
	qcom,board-id = <0x23 0>;
};

/dts-v1/;

#include "volcano6i.dtsi"

/ {
	model = "Qualcomm Technologies, Inc. Volcano6I FP3 SoC";
	compatible = "qcom,volcano";
	qcom,msm-id = <0Xc000291 0x10000>;
	qcom,board-id = <0 0>;

	chosen {
		softsku-id = "3";
	};
};

&pcie1 {
	status = "ok";
};

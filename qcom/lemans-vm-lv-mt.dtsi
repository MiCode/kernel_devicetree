&hab {
	vmid = <3>;
};

&usb1 {
	status = "disabled";
};

&usb2_phy1 {
	status = "disabled";
};

&usb_qmp_phy1 {
	status = "disabled";
};

&pcie1 {
	status = "disabled";
};

&pcie1_msi_snps {
	status = "disabled";
};

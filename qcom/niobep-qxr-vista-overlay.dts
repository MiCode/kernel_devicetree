/dts-v1/;
/plugin/;

#include "niobep-qxr-vista.dtsi"

/ {
	model = "Qualcomm Technologies, Inc. NiobeP QXR Vista";
	compatible = "qcom,niobep-qxr", "qcom,niobep", "qcom,qxr";
	qcom,msm-id = <652 0x10000>;
	qcom,board-id = <0x10026 0x1>;
};

/dts-v1/;

#include "crow-vm.dtsi"
#include "crow-vm-qrd.dtsi"

/{
	model = "Qualcomm Technologies, Inc. Crow VM QRD";
	compatible = "qcom,crow-qrd", "qcom,crow", "qcom,qrd";
	qcom,board-id = <11 0>;
};

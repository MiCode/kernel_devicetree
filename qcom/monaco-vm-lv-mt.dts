// SPDX-License-Identifier: BSD-3-Clause
/*
 * Copyright (c) Qualcomm Technologies, Inc. and/or its subsidiaries.
 */

/dts-v1/;

#include "monaco-vm.dtsi"
#include "monaco-vm-lv-mt.dtsi"

/ {
	model = "Qualcomm Technologies, Inc. Monaco Multi LV Virtual Machine";
	compatible = "qcom,monaco", "qcom,quinvm";
	qcom,board-id = <0x0 0x2000002>;
};

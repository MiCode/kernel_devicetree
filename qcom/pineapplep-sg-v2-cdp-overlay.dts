/dts-v1/;
/plugin/;

#include "pineapplep-sg-v2-cdp.dtsi"

/ {
	model = "Qualcomm Technologies, Inc. PineappleP SG V2 CDP";
	compatible = "qcom,pineapplep-cdp", "qcom,pineapplep", "qcom,cdp";
	qcom,msm-id = <682 0x20000>;
	qcom,board-id = <1 0>, <0x01000001 0>;
};

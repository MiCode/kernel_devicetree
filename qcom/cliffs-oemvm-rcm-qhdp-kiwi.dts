/dts-v1/;

#include "cliffs-oemvm.dtsi"
#include "cliffs-oemvm-rcm-qhdp-kiwi.dtsi"

/ {
	model = "Qualcomm Technologies, Inc. Cliffs OEMVM RCM + QHDP + kiwi WLAN";
	compatible = "qcom,cliffs-rcm", "qcom,cliffs", "qcom,rcm";
	qcom,board-id = <21 3>;
};

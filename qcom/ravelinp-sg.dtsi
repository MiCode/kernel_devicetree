// SPDX-License-Identifier: BSD-3-Clause
/*
 * Copyright (c) 2024 Qualcomm Innovation Center, Inc. All rights reserved.
 */

#include "ravelin-sg.dtsi"

/ {

	model = "Qualcomm Technologies, Inc. RavelinP SG";
	compatible = "qcom,ravelinp";
	qcom,msm-id = <654 0x10000>;
};

/dts-v1/;

#include "seraph-vm.dtsi"
#include "seraph-vm-rumi.dtsi"

/ {
	model = "Qualcomm Technologies, Inc. Seraph SVM RUMI";
	compatible = "qcom,seraph-rumi", "qcom,seraph", "qcom,seraph";
	qcom,board-id = <0 0>;
};

// SPDX-License-Identifier: BSD-3-Clause
/*
 * Copyright (c) 2024 Qualcomm Innovation Center, Inc. All rights reserved.
 */
/dts-v1/;

#include "canoe-vm.dtsi"
#include "canoe-vm-rcm.dtsi"

/ {
	model = "Qualcomm Technologies, Inc. Canoe SVM RCM";
	compatible = "qcom,canoe-rcm", "qcom,canoe", "qcom,canoep-rcm", "qcom,canoep",
			   "qcom,rcm";
	qcom,board-id = <0x15 0>;
};

/dts-v1/;

#include "waipio-oemvm.dtsi"
#include "waipio-oemvm-mtp.dtsi"

/ {
	model = "Qualcomm Technologies, Inc. Waipio OEMVM MTP";
	compatible = "qcom,waipio-mtp", "qcom,waipio", "qcom,mtp";
	qcom,board-id = <0x10008 0>;
};

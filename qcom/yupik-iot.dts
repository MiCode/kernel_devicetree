// SPDX-License-Identifier: BSD-3-Clause
/*
 * Copyright (c) 2025 Qualcomm Innovation Center, Inc. All rights reserved.
 */

/dts-v1/;

#include "yupik-iot.dtsi"

/ {
	model = "Qualcomm Technologies, Inc. YUPIK-IOT SoC";
	compatible = "qcom,yupik-iot";
	qcom,board-id = <0 0>;
};

// SPDX-License-Identifier: BSD-3-Clause
/*
 * Copyright (c) 2025 Qualcomm Innovation Center, Inc. All rights reserved.
 */

&soc {
	walt {
		#address-cells = <1>;
		#size-cells = <1>;
		ranges;

		qcom,cycle-cntr {
			compatible = "qcom,gclk";
			reg = <0x19880400 0x8>,
				<0x1A880400 0x8>;
			reg-names = "freq-domain0",
				"freq-domain1";
		};
	};
};

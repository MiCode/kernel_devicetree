// SPDX-License-Identifier: BSD-3-Clause
/*
 * Copyright (c) 2024 Qualcomm Innovation Center, Inc. All rights reserved.
 */

/dts-v1/;
/plugin/;

#include "monaco-idp-v1.dtsi"

/ {
	model = "Qualcomm Technologies, Inc. Monaco IDP V1.1";
	qcom,board-id = <0x010122 0x0>;
};

// SPDX-License-Identifier: BSD-3-Clause
/*
 * Copyright (c) 2024 Qualcomm Innovation Center, Inc. All rights reserved.
 */

/dts-v1/;
/plugin/;

#include "sa8155-adp-common.dtsi"

/ {
	model = "ADP-AIR";
	compatible = "qcom,sa8155p-v2-adp-air", "qcom,sa8155p",
		"qcom,adp-air";
	qcom,msm-id = <367 0x20000>;
	qcom,board-id = <0x01000019 0>;
};

// SPDX-License-Identifier: BSD-3-Clause
/*
 * Copyright (c) 2024 Qualcomm Innovation Center, Inc. All rights reserved.
 */

#include "sun-vm.dtsi"

/ {
	model = "Qualcomm Technologies, Inc. SunP VM";
	compatible = "qcom,sunp";
	qcom,msm-id = <639 0x10000>, <639 0x20000>;
};


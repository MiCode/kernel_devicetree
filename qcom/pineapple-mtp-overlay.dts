/dts-v1/;
/plugin/;

#include "pineapple-mtp.dtsi"

/ {
	model = "Qualcomm Technologies, Inc. Pineapple MTP";
	compatible = "qcom,pineapple-mtp", "qcom,pineapple", "qcom,pineapplep-mtp", "qcom,pineapplep", "qcom,mtp";
	qcom,msm-id = <557 0x20000>, <577 0x20000>, <682 0x20000>,
			<645 0x20000>, <646 0x20000>, <702 0x20000>;
	qcom,board-id = <8 0>;
};

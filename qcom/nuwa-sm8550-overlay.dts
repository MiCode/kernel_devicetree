/dts-v1/;
/plugin/;

#include "nuwa-sm8550.dtsi"

/ {
	model = "Qualcomm Technologies, Inc. 8550 nuwa";
	compatible = "qcom,kalama-mtp", "qcom,kalama", "qcom,mtp";
	qcom,msm-id = <519 0x10000>, <536 0x10000>, <519 0x20000>, <536 0x20000>, <600 0x20000>, <601 0x20000>;
    qcom,board-id = <0x10008 0>;
	xiaomi,miboard-id = <0x1 0>;
};

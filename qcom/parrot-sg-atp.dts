// SPDX-License-Identifier: BSD-3-Clause
/*
 * Copyright (c) 2024 Qualcomm Innovation Center, Inc. All rights reserved.
 */

/dts-v1/;

#include "parrot-sg.dtsi"
#include "parrot-sg-atp.dtsi"

/ {
	model = "Qualcomm Technologies, Inc. Parrot SG ATP";
	compatible = "qcom,parrot-atp", "qcom,parrot", "qcom,atp";
	qcom,board-id = <33 0>;
};

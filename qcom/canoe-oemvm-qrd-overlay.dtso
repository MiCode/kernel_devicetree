// SPDX-License-Identifier: BSD-3-Clause
/*
 * Copyright (c) 2025 Qualcomm Innovation Center, Inc. All rights reserved.
 */
/dts-v1/;
/plugin/;

#include "canoe-oemvm-avf.dtsi"
#include "canoe-oemvm-qrd-avf.dtsi"

/ {
	model = "Qualcomm Technologies, Inc. Canoe OEMVM QRD";
	compatible = "qcom,canoe-qrd", "qcom,canoe", "qcom,canoep-qrd", "qcom,canoep",
			   "qcom,qrd";
	qcom,board-id = <11 0>;
};

/dts-v1/;
/plugin/;

#include "pitti-idp.dtsi"
#include "pitti-pm7250b.dtsi"

/ {
	model = "Qualcomm Technologies, Inc. Pitti IDP-PM7250b";
	compatible = "qcom,pitti-idp", "qcom,pitti", "qcom,idp";
	qcom,msm-id = <608 0x10000>;
	qcom,board-id = <34 0>;
};

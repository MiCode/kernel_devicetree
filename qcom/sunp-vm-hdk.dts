// SPDX-License-Identifier: BSD-3-Clause
/*
 * Copyright (c) 2024 Qualcomm Innovation Center, Inc. All rights reserved.
 */
/dts-v1/;

#include "sunp-vm.dtsi"
#include "sunp-vm-hdk.dtsi"

/ {
	model = "Qualcomm Technologies, Inc. SunP SVM HDK";
	compatible = "qcom,sunp-hdk", "qcom,sunp", "qcom,hdk";
	qcom,board-id = <0x1001F 0>;
};

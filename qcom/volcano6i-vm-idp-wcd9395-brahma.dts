/dts-v1/;
/plugin/;

#include "volcano-vm.dtsi"
#include "volcano6i-vm-idp-wcd9395-brahma.dtsi"

/ {
	model = "Qualcomm Technologies, Inc. Volcano6I SVM IDP + WCD9395 HSJ + Brahma";
	compatible = "qcom,volcano-idp", "qcom,volcano", "qcom,idp";
	qcom,board-id = <34 3>;
};

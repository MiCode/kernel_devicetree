// SPDX-License-Identifier: BSD-3-Clause
/*
 * Copyright (c) Qualcomm Technologies, Inc. and/or its subsidiaries.
 */

&sdhc_1 {
	status = "okay";
	vdd-supply = <&L20A>;
	qcom,vdd-voltage-level = <2952000 2952000>;
	qcom,vdd-current-level = <0 150000>;

	vdd-io-supply = <&L16A>;
	qcom,vdd-io-always-on;
	qcom,vdd-io-lpm-sup;
	qcom,vdd-io-voltage-level = <1800000 1800000>;
	qcom,vdd-io-current-level = <0 200120>;

	mmc-ddr-1_8v;
	mmc-hs200-1_8v;
	mmc-hs400-1_8v;
	mmc-hs400-enhanced-strobe;

	pinctrl-names = "default", "sleep";
	pinctrl-0 = <&sdc1_on>;
	pinctrl-1 = <&sdc1_off>;
};

&sdhc_3 {

	/* device communication power supply for msm_io*/
	vdd-io-supply = <&L11A>;
	qcom,vdd-io-voltage-level = <1800000 1800000>;
	qcom,vdd-io-always-on;
	qcom,vdd-io-current-level = <200 22697>;

	keep-power-in-suspend;
	qcom,core_3_0v_support;
	no-sd;
	no-mmc;
	qcom,restore-after-cx-collapse;
	pinctrl-names = "default", "sleep";
	pinctrl-0 = <&sdc3_clk_on &sdc3_cmd_on &sdc3_data_on>;
	pinctrl-1 = <&sdc3_clk_off &sdc3_cmd_off &sdc3_data_off>;

	status = "ok";
};

&regulator_ocp_notifier {
	periph-1c1-supply = <&L1A_LEVEL>;
	periph-1c2-supply = <&L2A_LEVEL>;
	periph-1c3-supply = <&L3A>;
	periph-1c4-supply = <&L4A>;
	periph-1c5-supply = <&L5A_LEVEL>;
	periph-1c6-supply = <&L6A>;
	periph-1c7-supply = <&L7A>;
	periph-1c8-supply = <&L8A>;
	periph-1c9-supply = <&L9A>;
	periph-1ca-supply = <&L10A>;
	periph-1cb-supply = <&L11A>;
	periph-1cc-supply = <&L12A>;
	periph-1cd-supply = <&L13A>;
	periph-1ce-supply = <&L14A>;
	periph-1d0-supply = <&L16A>;
	periph-1d1-supply = <&L17A>;
	periph-1d2-supply = <&L18A>;
	periph-1d3-supply = <&L19A>;
	periph-1d4-supply = <&L20A>;
	periph-1d5-supply = <&L21A>;
	periph-1d6-supply = <&L22A>;
	periph-1d7-supply = <&L23A>;
	periph-1d8-supply = <&L24A>;
	periph-1d9-supply = <&L25A>;
	periph-1da-supply = <&L26A>;
	periph-1db-supply = <&L27A>;
	periph-1dc-supply = <&L28A>;
	periph-1dd-supply = <&L29A>;
	periph-1e5-supply = <&BOB1>;
	periph-19b-supply = <&S1A>;
	periph-19e-supply = <&S2A>;
	periph-1a7-supply = <&S5A_LEVEL>;
	periph-1aa-supply = <&S6A_LEVEL>;
	periph-1ad-supply = <&S7A>;
	periph-1b0-supply = <&S8A_LEVEL>;
	periph-1b3-supply = <&S9A_LEVEL>;
	periph-1b6-supply = <&S10A_LEVEL>;
	periph-1b9-supply = <&S11A>;
	periph-c40-supply = <&L1M>;
	periph-c41-supply = <&L2M>;
	periph-c42-supply = <&L3M>;
	periph-c43-supply = <&L4M>;
	periph-c44-supply = <&L5M>;
	periph-c45-supply = <&L6M>;
	periph-c46-supply = <&L7M>;
};

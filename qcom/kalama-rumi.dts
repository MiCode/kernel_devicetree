/dts-v1/;
/memreserve/ 0xE3700000 0x00002000;

#include "kalama.dtsi"
#include "kalama-rumi.dtsi"

/ {
	model = "Qualcomm Technologies, Inc. Kalama RUMI";
	compatible = "qcom,kalama-rumi", "qcom,kalama", "qcom,rumi";
	qcom,board-id = <15 0>;
};

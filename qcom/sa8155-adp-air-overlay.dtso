// SPDX-License-Identifier: BSD-3-Clause
/*
 * Copyright (c) 2024 Qualcomm Innovation Center, Inc. All rights reserved.
 */

/dts-v1/;
/plugin/;

#include "sa8155-adp-common.dtsi"

/ {
	model = "ADP-AIR";
	compatible = "qcom,sa8155-v2-adp-air", "qcom,sa8155",
		"qcom,adp-air";
	qcom,msm-id = <362 0x20000>;
	qcom,board-id = <0X01000019 0>;
};

/dts-v1/;
/plugin/;

#include "monaco_auto-adp-air.dtsi"

/ {
	model = "Qualcomm Technologies, Inc. MonacoAU ADAS ADP AIR";
	compatible = "qcom,monaco_auto", "qcom,adp-air", "qcom,monaco_auto-adas", "qcom,monaco_auto-adas-adp-air";
	qcom,msm-id = <605 0x10000>;
	qcom,board-id = <0x1190100 0>;
};


/dts-v1/;
/plugin/;

#include "lemans-qam-star.dtsi"

/ {
	model = "Qualcomm Technologies, Inc. Lemans ADAS HIGH QAM STAR";
	compatible = "qcom,lemans", "qcom,qam-star", "qcom,lemans-adas-high", "qcom,lemans-adas-high-qam-star";
	qcom,msm-id = <533 0x10000>;
	qcom,board-id = <0x10025 0>;
};


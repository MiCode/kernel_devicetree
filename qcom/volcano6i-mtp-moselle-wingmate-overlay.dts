/dts-v1/;
/plugin/;

#include "volcano6i-mtp-moselle-wingmate.dtsi"
#include "volcano-pm7550ba.dtsi"

/ {
	model = "Qualcomm Technologies, Inc. Volcano6I MTP + WCD9378 HSJ + SN220T + Wingmate + Moselle";
	compatible = "qcom,volcano-mtp", "qcom,volcano", "qcom,volcanop-mtp", "qcom,volcanop", "qcom,mtp";
	qcom,board-id = <8 8>;
	qcom,msm-id = <0X4000291 0x10000>, <0x4000292 0x10000>, <0x8000291 0x10000>, <0x8000292 0x10000>, <0xc000291 0x10000>, <0xc000292 0x10000>, <0x10000291 0x10000>, <0x10000292 0x10000>;
};

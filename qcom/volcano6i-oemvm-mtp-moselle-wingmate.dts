/dts-v1/;
/plugin/;

#include "volcano-oemvm.dtsi"
#include "volcano6i-oemvm-mtp-moselle-wingmate.dtsi"

/ {
	model = "Qualcomm Technologies, Inc. Volcano6I OEMVM MTP + WCD9378 HSJ + SN220T + Wingmate + Moselle";
	compatible = "qcom,volcano-mtp", "qcom,volcano", "qcom,mtp";
	qcom,board-id = <8 8>;
};


/dts-v1/;
/plugin/;

#include "pitti-idp.dtsi"
#include "pitti-pmiv0104.dtsi"
/ {
	model = "Qualcomm Technologies, Inc. Pitti IDP-pmiv0104";
	compatible = "qcom,pitti-idp", "qcom,pitti", "qcom,idp";
	qcom,msm-id = <623 0x10000>;
	qcom,board-id = <34 0>;
};

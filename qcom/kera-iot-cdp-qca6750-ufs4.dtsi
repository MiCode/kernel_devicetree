// SPDX-License-Identifier: BSD-3-Clause
/*
 * Copyright (c) 2024-2025 Qualcomm Innovation Center, Inc. All rights reserved.
 */

#include "kera-cdp.dtsi"
#include "kera_ufs4.dtsi"

&gcc {
	/delete-property/ protected-clocks;
};

&gcc_pcie_1_gdsc {
	status = "ok";
};

&gcc_pcie_1_phy_gdsc {
	status = "ok";
};

#include "pitti-idp.dtsi"

&soc {
};

&qupv3_se3_i2c {
	status = "disabled";
};

&qupv3_se3_spi {
	#address-cells = <1>;
	#size-cells = <0>;

	status = "ok";
	qcom,touch-active = "goodix,gt9916S";
	qcom,la-vm;

	goodix-berlin@0 {
		compatible = "goodix,gt9916S";
		reg = <0>;
		spi-max-frequency = <1000000>;
		interrupt-parent = <&tlmm>;
		interrupts = <94 0x2008>;
		goodix,reset-gpio = <&tlmm 93 0x00>;
		goodix,irq-gpio = <&tlmm 94 0x2008>;
		goodix,irq-flags = <2>;
		goodix,panel-max-x = <1080>;
		goodix,panel-max-y = <2400>;
		goodix,panel-max-w = <255>;
		goodix,panel-max-p = <4096>;
		goodix,firmware-name = "goodix_firmware_spi.bin";
		goodix,config-name = "goodix_cfg_group_spi.bin";
		goodix,avdd-name = "avdd";
		goodix,iovdd-name = "iovdd";
		avdd-supply = <&L21A>;
		iovdd-supply = <&L9A>;
		goodix,touch-type = "primary";
		goodix,qts_en;
	};
};

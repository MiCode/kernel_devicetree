// SPDX-License-Identifier: BSD-3-Clause
/*
 * Copyright (c) 2024 Qualcomm Innovation Center, Inc. All rights reserved.
 */

/dts-v1/;

#include "sunp-v2.dtsi"
#include "sunp-tp-v2.dtsi"

/ {
	model = "Qualcomm Technologies, Inc. SunP v2 Alt. Thermal Profile SoC";
	compatible = "qcom,sunp";
	qcom,board-id = <0 0>;
};

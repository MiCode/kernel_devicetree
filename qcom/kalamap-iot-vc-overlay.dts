/dts-v1/;
/plugin/;

#include "kalamap-iot-vc.dtsi"

/ {
	model = "Qualcomm Technologies, Inc. KalamaP IoT VC";
	compatible = "qcom,kalamap-iot", "qcom,kalamap", "qcom,iot";
	qcom,msm-id = <603 0x20000>;
	qcom,board-id = <0x10020 1>;
};

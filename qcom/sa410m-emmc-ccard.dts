/dts-v1/;

#include "sa410m-idp.dtsi"

/ {
	model = "Qualcomm Technologies, Inc. SA410M EMMC CCARD";
	compatible = "qcom,sa410m", "qcom,idp", "qcom,sa410m-ccard";
	qcom,msm-id=<560 0x10000>;
	qcom,board-id = <25 0x0>;
};

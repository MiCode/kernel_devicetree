/dts-v1/;
/memreserve/ 0x90f00000 0x00010000;

#include "sa525m.dtsi"
#include "sdxpinn-rumi.dtsi"

/ {
	model = "Qualcomm Technologies, Inc. SA525M RUMI";
	compatible = "qcom,sdxpinn-rumi", "qcom,sdxpinn", "qcom,rumi";
	qcom,board-id = <15 0>;
};

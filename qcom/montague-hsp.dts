// SPDX-License-Identifier: BSD-3-Clause
/*
 * Copyright (c) Qualcomm Technologies, Inc. and/or its subsidiaries.
 */

/dts-v1/;


#include "montague.dtsi"
#include "montague-hsp.dtsi"

/ {
	model = "Qualcomm Technologies, Inc. Montague HSP IDP";
	compatible = "qcom,montague-idp", "qcom,montague", "qcom,idp";
	qcom,board-id = <0x10022 0x4>;
};

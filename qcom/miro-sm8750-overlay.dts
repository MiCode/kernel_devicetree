/dts-v1/;
/plugin/;

#include "miro-sm8750.dtsi"

/ {
	model = "Qualcomm Technologies, Inc. Miro based on SM8750";
	compatible = "qcom,sun-mtp", "qcom,sun", "qcom,sunp-mtp", "qcom,sunp",
			   "qcom,mtp";
	qcom,msm-id = <618 0x10000>, <618 0x20000>, <639 0x10000>, <639 0x20000>,
		      <0x100026a 0x10000>, <0x100026a 0x20000>,
		      <0x100027f 0x10000>, <0x100027f 0x20000>;
	qcom,board-id = <0x40008 0>;
	xiaomi,miboard-id = <0x3 0>;

};


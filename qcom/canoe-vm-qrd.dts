// SPDX-License-Identifier: BSD-3-Clause
/*
 * Copyright (c) 2024 Qualcomm Innovation Center, Inc. All rights reserved.
 */
/dts-v1/;

#include "canoe-vm.dtsi"
#include "canoe-vm-qrd.dtsi"

/ {
	model = "Qualcomm Technologies, Inc. Canoe SVM QRD";
	compatible = "qcom,canoe-qrd", "qcom,canoe", "qcom,canoep-qrd", "qcom,canoep",
			   "qcom,qrd";
	qcom,board-id = <11 0>;
};

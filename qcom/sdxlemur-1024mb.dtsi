#include "sdxlemur-512mb.dtsi"

&mpss_adsp_mem {
	reg = <0x90800000 0x10000000>;
};

&access_control_mem {
	reg = <0x8fd80000 0x80000>;
};

&reserved_memory {
	audio_heap_mem: audio_mem_region@8c000000 {
		reg = <0x8c000000 0x400000>;
	};
};

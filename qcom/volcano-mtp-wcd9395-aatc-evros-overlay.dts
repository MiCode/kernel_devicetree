/dts-v1/;
/plugin/;

#include "volcano-mtp-wcd9395-aatc-evros.dtsi"
#include "volcano-pmiv0104.dtsi"

/ {
	model = "Qualcomm Technologies, Inc. Volcano MTP + WCD9395 AATC + SN220T + Evros";
	compatible = "qcom,volcano-mtp", "qcom,volcano", "qcom,volcanop-mtp", "qcom,volcanop", "qcom,mtp";
	qcom,msm-id = <636 0x10000>, <640 0x10000>, <641 0x10000>;
	qcom,board-id = <8 9>;
};


&pmiv0104_eusb2_repeater {
	vdd18-supply = <&L7B>;
	vdd3-supply = <&L17B>;
	status = "ok";
};

&eusb2_phy0 {
	dummy-supply = <&pmiv0104_eusb2_repeater>;
	usb-repeater = <&pmiv0104_eusb2_repeater>;
};

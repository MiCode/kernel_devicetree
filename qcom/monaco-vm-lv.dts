/dts-v1/;

#include "monaco-vm.dtsi"
#include "monaco-vm-lv.dtsi"

/ {
	model = "Qualcomm Technologies, Inc. Monaco Single LV Virtual Machine";
	compatible = "qcom,monaco", "qcom,quinvm";
	qcom,board-id = <0 0x1000002>;
};

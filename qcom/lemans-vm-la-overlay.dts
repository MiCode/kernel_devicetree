/dts-v1/;
/plugin/;


/ {
	model = "Qualcomm Technologies, Inc. Lemans Single LA Guest Virtual Machine";
	compatible = "qcom,lemans", "qcom,quinvm";
	qcom,msm-id = <532 0x20000>;
	qcom,board-id = <0x0 0x1000001>;
};

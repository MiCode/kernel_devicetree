// SPDX-License-Identifier: BSD-3-Clause
/*
 * Copyright (c) Qualcomm Technologies, Inc. and/or its subsidiaries.
 * Shuntian-specific PM7550BA eUSB2 repeater configuration
 *
 * Note: This file should be included AFTER alor-pm7550ba-pmd802x.dtsi
 * to add shuntian-specific override-seq properties.
 */

&dwc3_0 {
 	usb-phy = <&eusb2_phy0>, <&usb_qmp_dp_phy>;
 	maximum-speed = "super-speed";
};

&pm7550ba_eusb2_repeater {
	qcom,host-param-override-seq =
		<0x07 0x50
		0x0F 0x51
		0x05 0x52
		0x07 0x53
		0x02 0x54
		0x03 0x55
		0x00 0x56
		0x02 0x57
		0x02 0x58
		0x03 0x59
		0x01 0x5a
		0x02 0x5b>;
	qcom,param-override-seq =
		<0x06 0x50
		0x0F 0x51
		0x04 0x52
		0x01 0x53
		0x01 0x54
		0x03 0x55
		0x00 0x56
		0x05 0x57
		0x02 0x58
		0x03 0x59
		0x01 0x5a
		0x02 0x5b>;
	qcom,param-override-seq-factory =
		<0x00 0x50
		0x0E 0x51
		0x01 0x52
		0x07 0x53
		0x03 0x54
		0x03 0x55
		0x00 0x56
		0x06 0x57
		0x02 0x58
		0x03 0x59
		0x01 0x5a
		0x02 0x5b>;
};

&wcd_usbss {
	wcd-usb-sbu-compliance;
};

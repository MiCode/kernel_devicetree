/dts-v1/;
/plugin/;

#include "pineapplep-sg-v2-aim500.dtsi"

/ {
	model = "Qualcomm Technologies, Inc. PineappleP SG V2 AIM500";
	compatible = "qcom,pineapplep-hdk", "qcom,pineapplep", "qcom,hdk";
	qcom,msm-id = <682 0x20000>;
	qcom,board-id = <0x1011f 1>;
};

// SPDX-License-Identifier: BSD-3-Clause
/*
 * Copyright (c) 2023 Qualcomm Innovation Center, Inc. All rights reserved.
 */
/dts-v1/;

#include "sun-oemvm.dtsi"
#include "sun-oemvm-mtp.dtsi"

/ {
	model = "Qualcomm Technologies, Inc. Sun OEMVM MTP";
	compatible = "qcom,sun-mtp", "qcom,sun", "qcom,sunp-mtp",
			"qcom,sunp", "qcom,mtp";
	qcom,board-id = <0x10008 0>;
};

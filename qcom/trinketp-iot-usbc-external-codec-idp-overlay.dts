/dts-v1/;
/plugin/;

#include "trinketp-iot-idp.dtsi"

/ {
	model = "USB-C Ext Audio Codec IDP";
	compatible = "qcom,trinketp-iot-idp", "qcom,trinketp-iot", "qcom,idp";
	qcom,msm-id = <468 0x10000>;
	qcom,board-id = <34 3>;
};

#include "sa8155-v1.dtsi"

/ {
	model = "Qualcomm Technologies, Inc. SA8155P ";
	qcom,msm-name = "SA8155P V1";
	compatible = "qcom,sa8155p";
	qcom,msm-id = <367 0x10000>;
};

&usb0 {
	qcom,disable-wakeup;
	qcom,host-poweroff-in-pm-suspend;
	qcom,hibernate-skip-thaw;
};

&usb1 {
	qcom,disable-wakeup;
	qcom,host-poweroff-in-pm-suspend;
	qcom,hibernate-skip-thaw;
	qcom,disable-host-ssphy-powerdown;
};

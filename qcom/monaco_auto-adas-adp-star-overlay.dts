/dts-v1/;
/plugin/;

#include "monaco_auto-adp-star.dtsi"

/ {
	model = "Qualcomm Technologies, Inc. MonacoAU ADAS ADP STAR";
	compatible = "qcom,monaco_auto", "qcom,adp-star", "qcom,monaco_auto-adas", "qcom,monaco_auto-adas-adp-star";
	qcom,msm-id = <605 0x10000>;
	qcom,board-id = <0x30019 0>;
};

// SPDX-License-Identifier: BSD-3-Clause
/*
 * Copyright (c) 2023 Qualcomm Innovation Center, Inc. All rights reserved.
 */
/dts-v1/;

#include "sun-oemvm.dtsi"
#include "sun-oemvm-cdp.dtsi"

/ {
	model = "Qualcomm Technologies, Inc. Sun OEMVM CDP";
	compatible = "qcom,sun-cdp", "qcom,sun", "qcom,sunp-cdp",
			"qcom,sunp", "qcom,cdp";
	qcom,board-id = <0x10001 0>;
};

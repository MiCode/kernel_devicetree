/dts-v1/;
/plugin/;

#include "pitti-qrd-90fps.dtsi"

/ {
	model = "Qualcomm Technologies, Inc. Pitti QRD 90fps Display";
	compatible = "qcom,pitti-qrd", "qcom,pitti", "qcom,qrd";
	qcom,msm-id = <623 0x10000>;
	qcom,board-id = <11 2>;
};

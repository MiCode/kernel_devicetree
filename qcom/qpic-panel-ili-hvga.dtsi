&soc {
	qcom,mdss_lcdc_ili_hvga {
		compatible = "qcom,mdss-qpic-panel";
		label = "ili9488 hvga lcdc panel";
		qcom,mdss-pan-res = <320 480>;
		qcom,mdss-pan-bpp = <18>;
		qcom,refresh_rate = <60>;
	};
};

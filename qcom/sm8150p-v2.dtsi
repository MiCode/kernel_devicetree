// SPDX-License-Identifier: BSD-3-Clause
/*
 * Copyright (c) 2024 Qualcomm Innovation Center, Inc. All rights reserved.
 */

#include "sm8150-v2.dtsi"

/ {
	model = "Qualcomm Technologies, Inc. SM8150P v2";
	qcom,msm-name = "SM8150P v2";
	qcom,msm-id = <361 0x20000>;
};

/dts-v1/;

#include "sdxnightjar.dtsi"
#include "sdxnightjar-mtp.dtsi"

/ {
	model = "Qualcomm Technologies, Inc. SDX NIGHTJAR MTP";
	compatible = "qcom,sdxnightjar-mtp",
		   "qcom,sdxnightjar", "qcom,mtp";
	qcom,board-id = <8 0>;
};

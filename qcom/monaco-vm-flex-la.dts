/dts-v1/;

#include "monaco-vm.dtsi"
#include "monaco-vm-flex-la.dtsi"

/ {
	model = "Qualcomm Technologies, Inc. Monaco Flex Single LA Virtual Machine";
	qcom,msm-name = "SA_MONACO_FLEX_IVI";
	compatible = "qcom,monaco", "qcom,quinvm";
	qcom,msm-id = <695 0x10000>;
	qcom,board-id = <0 0x1000001>;
};

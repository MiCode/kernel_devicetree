// SPDX-License-Identifier: BSD-3-Clause
/*
 * Copyright (c) 2024 Qualcomm Innovation Center, Inc. All rights reserved.
 */
/dts-v1/;

#include "canoe-oemvm.dtsi"
#include "canoe-oemvm-rcm.dtsi"

/ {
	model = "Qualcomm Technologies, Inc. Canoe OEMVM RCM";
	compatible = "qcom,canoe-rcm", "qcom,canoe", "qcom,canoep-rcm", "qcom,canoep",
			   "qcom,rcm";
	qcom,board-id = <0x15 0>;
};

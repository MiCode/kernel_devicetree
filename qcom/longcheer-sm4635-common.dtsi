/* longcheer-sm4635-common.dtsi */
&usb2_phy0 {
	qcom,param-override-seq = <
			0x86 0x6c
			0xcb 0x70
			0x1e 0x74
			0x03 0x78>;
	qcom,param-override-seq-no-panel = <
			0x82 0x6c
			0xcb 0x70
			0x1e 0x74
			0x03 0x78>;
};

// Add by Longcheer
&soc {
	mtdoops_pmsg@0x80D00000 {
		compatible = "xiaomi,mtdoops_pmsg";
		reg = <0x80D00000 0x00200000>;
		console-size = <0x80000>;
		pmsg-size = <0x100000>;
	};
};

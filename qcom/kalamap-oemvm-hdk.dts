/dts-v1/;

#include "kalamap-oemvm.dtsi"
#include "kalamap-oemvm-hdk.dtsi"

/ {
	model = "Qualcomm Technologies, Inc. KalamaP OEMVM HDK";
	compatible = "qcom,kalamap-hdk", "qcom,kalamap", "qcom,hdk";
	qcom,board-id = <0x1001f 0>;
};

/dts-v1/;
/plugin/;

#include "cliffs-atp.dtsi"
#include "cliffs-pm7550ba.dtsi"

/ {
	model = "Qualcomm Technologies, Inc. Cliffs ATP";
	compatible = "qcom,cliffs-atp", "qcom,cliffs", "qcom,atp";
	qcom,msm-id = <614 0x10000>, <632 0x10000>;
	qcom,board-id = <33 0>;
};

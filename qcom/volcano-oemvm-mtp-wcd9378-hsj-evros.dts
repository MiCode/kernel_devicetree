/dts-v1/;

#include "volcano-oemvm.dtsi"

/ {
	model = "Qualcomm Technologies, Inc. Volcano6I OEMVM MTP + WCD9378 HSJ + SN220T + Evros";
	compatible = "qcom,volcano-mtp", "qcom,volcano", "qcom,mtp";
	qcom,board-id = <8 10>;
};


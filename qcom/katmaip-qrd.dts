// SPDX-License-Identifier: BSD-3-Clause
/*
 * Copyright (c) 2025 Qualcomm Innovation Center, Inc. All rights reserved.
 */

/dts-v1/;

#include "katmaip.dtsi"
#include "yupikp-iot-qrd.dtsi"

/ {
	model = "Qualcomm Technologies, Inc. KATMAIP QRD";
	compatible = "qcom,yupikp-iot-qrd", "qcom,yupikp-iot", "qcom,qrd";
	qcom,board-id = <0x1000B 0>;
};

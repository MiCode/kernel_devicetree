// SPDX-License-Identifier: BSD-3-Clause
/*
 * Copyright (c) 2024 Qualcomm Innovation Center, Inc. All rights reserved.
 */

#include "canoe-v2.dtsi"

/ {
	model = "Qualcomm Technologies, Inc. CanoeP v2 SoC";
	compatible = "qcom,canoep";
	qcom,msm-id = <661 0x20000>;
};

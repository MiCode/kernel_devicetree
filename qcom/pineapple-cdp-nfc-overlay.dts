/dts-v1/;
/plugin/;

#include "pineapple-cdp-nfc.dtsi"

/ {
	model = "Qualcomm Technologies, Inc. Pineapple CDP ST54L NFC";
	compatible = "qcom,pineapple-cdp", "qcom,pineapple", "qcom,pineapplep-cdp", "qcom,pineapplep", "qcom,cdp";
	qcom,msm-id = <557 0x10000>, <557 0x20000>, <577 0x10000>, <577 0x20000>;
	qcom,board-id = <0x50001 0>;
};

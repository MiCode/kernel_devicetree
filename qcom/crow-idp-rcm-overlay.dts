/dts-v1/;
/plugin/;

#include "crow-idp-rcm.dtsi"
#include "crow-idp-pm7550ba.dtsi"

/ {
	model = "Qualcomm Technologies, Inc. Crow IDP RCM";
	compatible = "qcom,crow-idp", "qcom,crow", "qcom,idp";
	qcom,msm-id = <608 0x10000>, <644 0x10000>;
	qcom,board-id = <34 4>;
};

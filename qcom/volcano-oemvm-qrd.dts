/dts-v1/;

#include "volcano-oemvm.dtsi"
#include "volcano-oemvm-qrd.dtsi"

/ {
	model = "Qualcomm Technologies, Inc. Volcano OEMVM QRD";
	compatible = "qcom,volcano-qrd", "qcom,volcano", "qcom,qrd";
	qcom,board-id = <11 0>;
};

// SPDX-License-Identifier: BSD-3-Clause
/*
 * Copyright (c) 2024 Qualcomm Innovation Center, Inc. All rights reserved.
 */

/dts-v1/;

#include "ravelin-vm.dtsi"
#include "ravelin-vm-idp-wcn3988.dtsi"

/ {
	model = "Qualcomm Technologies, Inc. Ravelin SVM IDP + WCN3988";
	compatible = "qcom,ravelin-idp", "qcom,ravelin", "qcom,idp";
	qcom,board-id = <34 1>;
};

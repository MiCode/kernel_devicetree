/dts-v1/;

#include "crow-vm.dtsi"
#include "crow-vm-rumi.dtsi"

/ {
	model = "Qualcomm Technologies, Inc. Crow SVM RUMI";
	compatible = "qcom,crow-rumi", "qcom,crow", "qcom,rumi";
	qcom,board-id = <15 0>;
};

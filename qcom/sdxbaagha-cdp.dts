/dts-v1/;

#include "sdxbaagha.dtsi"
#include "sdxbaagha-cdp.dtsi"

/ {
	model = "Qualcomm Technologies, Inc. SDXBAAGHA CDP";
	compatible = "qcom,sdxbaagha-cdp",
		"qcom,sdxbaagha", "qcom,cdp";
	qcom,board-id = <0x01 0>;
};

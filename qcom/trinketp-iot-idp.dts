/dts-v1/;

#include "trinketp-iot.dtsi"
#include "trinketp-iot-idp.dtsi"

/ {
	model = "Qualcomm Technologies, Inc. TRINKETP IOT IDP SoC";
	compatible = "qcom,trinketp-iot";
	qcom,board-id = <34 0>;
};

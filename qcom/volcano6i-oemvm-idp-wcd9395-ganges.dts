/dts-v1/;
/plugin/;

#include "volcano-oemvm.dtsi"
#include "volcano6i-oemvm-idp-wcd9395-ganges.dtsi"

/ {
	model = "Qualcomm Technologies, Inc. Volcano6I OEMVM IDP + WCD9395 HSJ + Ganges";
	compatible = "qcom,volcano-idp", "qcom,volcano", "qcom,idp";
	qcom,board-id = <34 2>;
};

#include <dt-bindings/clock/qcom,gcc-cliffs.h>
#include <dt-bindings/gpio/gpio.h>

&soc {
	pcie0: qcom,pcie@1c00000 {
		compatible = "qcom,pci-msm";

		reg = <0x01c00000 0x3000>,
			<0x01c06000 0x2000>,
			<0x60000000 0xf1d>,
			<0x60000f20 0xa8>,
			<0x60001000 0x1000>,
			<0x60100000 0x100000>,
			<0x01D07000 0x4000>;
		reg-names = "parf", "phy", "dm_core", "elbi", "iatu", "conf",
				"pcie_sm";

		cell-index = <0>;
		linux,pci-domain = <0>;

		#address-cells = <3>;
		#size-cells = <2>;
		ranges = <0x01000000 0x0 0x60200000 0x60200000 0x0 0x100000>,
			<0x02000000 0x0 0x60300000 0x60300000 0x0 0x3d00000>;

		interrupts = <GIC_SPI 140 IRQ_TYPE_LEVEL_HIGH
				GIC_SPI 149 IRQ_TYPE_LEVEL_HIGH
				GIC_SPI 150 IRQ_TYPE_LEVEL_HIGH
				GIC_SPI 151 IRQ_TYPE_LEVEL_HIGH
				GIC_SPI 152 IRQ_TYPE_LEVEL_HIGH>;

		interrupt-names = "int_global_int", "int_a", "int_b", "int_c",
				"int_d";

		msi-map = <0x0 &gic_its 0x1400 0x1>,
			<0x100 &gic_its 0x1401 0x1>; /* 32 event IDs */

		perst-gpio = <&tlmm 33 GPIO_ACTIVE_HIGH>;
		wake-gpio = <&tlmm 81 GPIO_ACTIVE_HIGH>;
		pinctrl-names = "default", "sleep";
		pinctrl-0 = <&pcie0_perst_default
				&pcie0_clkreq_default
				&pcie0_wake_default>;
		pinctrl-1 = <&pcie0_perst_default
				&pcie0_clkreq_sleep
				&pcie0_wake_default>;

		gdsc-phy-vdd-supply = <&gcc_pcie_0_phy_gdsc>;


		clocks = <&gcc GCC_CNOC_PCIE_SF_AXI_CLK>;
		clock-names = "gcc_cnoc_pcie_sf_axi_clk";
		clock-frequency = <0>;
		clock-suppressible = <1>;

		qcom,bw-scale = /* Gen1 */
				<RPMH_REGULATOR_LEVEL_LOW_SVS
				RPMH_REGULATOR_LEVEL_LOW_SVS
				19200000
				/* Gen2 */
				RPMH_REGULATOR_LEVEL_LOW_SVS
				RPMH_REGULATOR_LEVEL_LOW_SVS
				19200000
				/* Gen3 */
				RPMH_REGULATOR_LEVEL_LOW_SVS
				RPMH_REGULATOR_LEVEL_LOW_SVS
				100000000>;

		interconnect-names = "icc_path";
		interconnects = <&pcie_anoc MASTER_PCIE_0_PCIE_CRM_HW_0
				&mc_virt SLAVE_EBI1_PCIE_CRM_HW_0>;

		qcom,pcie-clkreq-gpio = <118>;
		resets = <&gcc GCC_PCIE_0_BCR>,
			<&gcc GCC_PCIE_0_PHY_BCR>;
		reset-names = "pcie_0_core_reset",
				"pcie_0_phy_reset";

		dma-coherent;
		qcom,smmu-sid-base = <0x1400>;
		iommu-map = <0x0 &apps_smmu 0x1400 0x1>,
			<0x100 &apps_smmu 0x1401 0x1>;

		qcom,boot-option = <0x1>;
		qcom,aux-clk-freq = <20>; /* 19.2 MHz */
		qcom,drv-supported;
		qcom,drv-l1ss-timeout-us = <5000>;
		qcom,l1-2-th-scale = <2>;
		qcom,l1-2-th-value = <150>;
		qcom,slv-addr-space-size = <0x4000000>;
		qcom,ep-latency = <10>;
		qcom,num-parf-testbus-sel = <0xb9>;

		qcom,pcie-clkreq-offset = <0x2c48>;

		qcom,pcie-phy-ver = <107>;
		qcom,phy-status-offset = <0x214>;
		qcom,phy-status-bit = <6>;
		qcom,phy-power-down-offset = <0x240>;

		qcom,phy-sequence = <0x0240 0x03 0x0
				0x00c0 0x01 0x0
				0x00cc 0x62 0x0
				0x00d0 0x02 0x0
				0x0060 0xf8 0x0
				0x0064 0x01 0x0
				0x0000 0x93 0x0
				0x0004 0x01 0x0
				0x00e0 0x90 0x0
				0x00e4 0x82 0x0
				0x00f4 0x07 0x0
				0x0070 0x02 0x0
				0x0010 0x02 0x0
				0x0074 0x16 0x0
				0x0014 0x16 0x0
				0x0078 0x36 0x0
				0x0018 0x36 0x0
				0x0110 0x08 0x0
				0x00bc 0x0a 0x0
				0x0120 0x42 0x0
				0x0080 0x04 0x0
				0x0084 0x0d 0x0
				0x0020 0x0a 0x0
				0x0024 0x1a 0x0
				0x0088 0x41 0x0
				0x0028 0x34 0x0
				0x0090 0xab 0x0
				0x0094 0xaa 0x0
				0x0098 0x01 0x0
				0x0030 0x55 0x0
				0x0034 0x55 0x0
				0x0038 0x01 0x0
				0x0140 0x14 0x0
				0x0164 0x34 0x0
				0x003c 0x01 0x0
				0x001c 0x04 0x0
				0x0174 0x16 0x0
				0x01bc 0x0f 0x0
				0x0170 0xa0 0x0
				0x11a4 0x38 0x0
				0x10dc 0x11 0x0
				0x1160 0xbf 0x0
				0x1164 0xbf 0x0
				0x1168 0xb7 0x0
				0x116c 0xea 0x0
				0x115c 0x3f 0x0
				0x1174 0x5c 0x0
				0x1178 0x9c 0x0
				0x117c 0x1a 0x0
				0x1180 0x89 0x0
				0x1170 0xdc 0x0
				0x1188 0x94 0x0
				0x118c 0x5b 0x0
				0x1190 0x1a 0x0
				0x1194 0x89 0x0
				0x10cc 0x00 0x0
				0x1008 0x09 0x0
				0x1014 0x05 0x0
				0x104c 0x08 0x0
				0x1050 0x08 0x0
				0x10d8 0x0f 0x0
				0x1118 0x1c 0x0
				0x10f8 0x07 0x0
				0x11f8 0x08 0x0
				0x1600 0x00 0x0
				0x0e84 0x15 0x0
				0x0e90 0x3f 0x0
				0x0ee4 0x02 0x0
				0x0e40 0x09 0x0
				0x0e3c 0x15 0x0
				0x19a4 0x38 0x0
				0x18dc 0x11 0x0
				0x1960 0xbf 0x0
				0x1964 0xbf 0x0
				0x1968 0xb7 0x0
				0x196c 0xea 0x0
				0x195c 0x3f 0x0
				0x1974 0x5c 0x0
				0x1978 0x9c 0x0
				0x197c 0x1a 0x0
				0x1980 0x89 0x0
				0x1970 0xdc 0x0
				0x1988 0x94 0x0
				0x198c 0x5b 0x0
				0x1990 0x1a 0x0
				0x1994 0x89 0x0
				0x18cc 0x00 0x0
				0x1808 0x09 0x0
				0x1814 0x05 0x0
				0x184c 0x08 0x0
				0x1850 0x08 0x0
				0x18d8 0x0f 0x0
				0x1918 0x1c 0x0
				0x18f8 0x07 0x0
				0x19f8 0x08 0x0
				0x1684 0x15 0x0
				0x1690 0x3f 0x0
				0x16e4 0x02 0x0
				0x1640 0x09 0x0
				0x163c 0x15 0x0
				0x02dc 0x05 0x0
				0x0388 0x77 0x0
				0x0398 0x0b 0x0
				0x06a4 0x1e 0x0
				0x06f4 0x27 0x0
				0x03e0 0x0f 0x0
				0x060c 0x1d 0x0
				0x0614 0x07 0x0
				0x0620 0xc1 0x0
				0x0694 0x00 0x0
				0x03d0 0x8c 0x0
				0x0368 0x17 0x0
				0x0370 0x2e 0x0
				0x0200 0x00 0x0
				0x0244 0x03 0x0>;

		qcom,parf-debug-reg = <0x01b0 0x0024 0x0028 0x0224 0x0500
					0x04d0 0x04d4 0x03c0 0x0630 0x0230
					0x0000>;
		qcom,dbi-debug-reg = <0x0104 0x0110 0x0080 0x01f4 0x0730
					0x0734 0x0738 0x073c>;
		qcom,phy-debug-reg = <0x01cc 0x01d0 0x01d4 0x01d8 0x01dc
					0x01e0 0x01e4 0x01f8 0x0ed0 0x16d0
					0x0edc 0x16dc 0x11e0 0x19e0 0x0a00
					0x1200 0x0a04 0x1204 0x0a08 0x1208
					0x0a0c 0x120c 0x0a10 0x1210 0x0a14
					0x1214 0x0a18 0x1218 0x0c20 0x1420
					0x0214 0x0218 0x021c 0x0220 0x0224
					0x0228 0x022c 0x0230 0x0234 0x0238
					0x023c 0x0600 0x0604>;

		qcom,pcie-sm-branch-offset = <0x1000>;
		qcom,pcie-sm-start-offset = <0x1090>;

		qcom,pcie-sm-seq = <0x1c018081>, <0x70074002>, <0x50028000>,
				<0x28007003>, <0x80804002>, <0x70021c01>,
				<0x18002802>, <0x70005000>, <0x10004000>,
				<0x80814002>, <0x18001c01>, <0x1c018080>,
				<0x0000100>;

		qcom,pcie-sm-branch-seq = <0x4>, <0x1c>, <0x24>, <0x2c>, <0x0>,
					<0x0>, <0x0>;

		qcom,pcie-sm-debug = <0x1040>,	/* PCIE_SMs_SEQ_OVERRIDE_PWR_CTRL_VAL */
				<0x1048>,	/* PCIE_SMs_SEQ_OVERRIDE_PWR_CTRL_MASK */
				<0x1050>,	/* PCIE_SMs_SEQ_OVERRIDE_WAIT_EVENT_VAL */
				<0x1058>,	/* PCIE_SMs_SEQ_OVERRIDE_WAIT_EVENT_MASK */
				<0x1060>,	/* PCIE_SMs_SEQ_OVERRIDE_BR_EVENT_VAL */
				<0x1068>,	/* PCIE_SMs_SEQ_OVERRIDE_BR_EVENT_MASK */
				<0x1070>,	/* PCIE_SMs_SEQ_PWR_CTRL_STATUS */
				<0x1078>,	/* PCIE_SMs_SEQ_WAIT_EVENT_STATUS */
				<0x1080>,	/* PCIE_SMs_SEQ_BR_EVENT_STATUS */
				<0x1088>,	/* PCIE_SMs_SEQ_PC_VAL */
				<0x1090>,	/* PCIE_SMs_SEQ_START */
				<0x1094>,	/* PCIE_SMs_CLKREQ_GATE */
				<0x1098>,	/* PCIE_SMs_CLKREQ_UNGATE */
				<0x109C>;	/* PCIE_SMs_CLKREQ_GATE_REQ_STATUS */

		status = "disabled";

		pcie0_rp: pcie0_rp {
			reg = <0 0 0 0 0>;
		};
	};

	pcie0_msi: qcom,pcie0_msi@0x17110040 {
		compatible = "qcom,pci-msi";
		msi-controller;
		reg = <0x17110040 0x0>;
		interrupt-parent = <&intc>;
		interrupts = <GIC_SPI 768 IRQ_TYPE_EDGE_RISING>,
			<GIC_SPI 769 IRQ_TYPE_EDGE_RISING>,
			<GIC_SPI 770 IRQ_TYPE_EDGE_RISING>,
			<GIC_SPI 771 IRQ_TYPE_EDGE_RISING>,
			<GIC_SPI 772 IRQ_TYPE_EDGE_RISING>,
			<GIC_SPI 773 IRQ_TYPE_EDGE_RISING>,
			<GIC_SPI 774 IRQ_TYPE_EDGE_RISING>,
			<GIC_SPI 775 IRQ_TYPE_EDGE_RISING>,
			<GIC_SPI 776 IRQ_TYPE_EDGE_RISING>,
			<GIC_SPI 777 IRQ_TYPE_EDGE_RISING>,
			<GIC_SPI 778 IRQ_TYPE_EDGE_RISING>,
			<GIC_SPI 779 IRQ_TYPE_EDGE_RISING>,
			<GIC_SPI 780 IRQ_TYPE_EDGE_RISING>,
			<GIC_SPI 781 IRQ_TYPE_EDGE_RISING>,
			<GIC_SPI 782 IRQ_TYPE_EDGE_RISING>,
			<GIC_SPI 783 IRQ_TYPE_EDGE_RISING>,
			<GIC_SPI 784 IRQ_TYPE_EDGE_RISING>,
			<GIC_SPI 785 IRQ_TYPE_EDGE_RISING>,
			<GIC_SPI 786 IRQ_TYPE_EDGE_RISING>,
			<GIC_SPI 787 IRQ_TYPE_EDGE_RISING>,
			<GIC_SPI 788 IRQ_TYPE_EDGE_RISING>,
			<GIC_SPI 789 IRQ_TYPE_EDGE_RISING>,
			<GIC_SPI 790 IRQ_TYPE_EDGE_RISING>,
			<GIC_SPI 791 IRQ_TYPE_EDGE_RISING>,
			<GIC_SPI 792 IRQ_TYPE_EDGE_RISING>,
			<GIC_SPI 793 IRQ_TYPE_EDGE_RISING>,
			<GIC_SPI 794 IRQ_TYPE_EDGE_RISING>,
			<GIC_SPI 795 IRQ_TYPE_EDGE_RISING>,
			<GIC_SPI 796 IRQ_TYPE_EDGE_RISING>,
			<GIC_SPI 797 IRQ_TYPE_EDGE_RISING>,
			<GIC_SPI 798 IRQ_TYPE_EDGE_RISING>,
			<GIC_SPI 799 IRQ_TYPE_EDGE_RISING>;
		status = "disabled";
	};

};

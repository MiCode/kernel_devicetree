// SPDX-License-Identifier: BSD-3-Clause
/*
 * Copyright (c) 2025 Qualcomm Innovation Center, Inc. All rights reserved.
 */

/dts-v1/;

#include "yupikp-iot.dtsi"

/ {
	model = "Qualcomm Technologies, Inc. YUPIKP-IOT SoC";
	compatible = "qcom,yupikp-iot";
	qcom,board-id = <0 0>;
};

/dts-v1/;

#include "qcs605.dtsi"
#include "sdm670-cdp.dtsi"

/ {
	model = "Qualcomm Technologies, Inc. QCS605 PM660 + PM660L CDP";
	compatible = "qcom,qcs605-cdp", "qcom,qcs605", "qcom,cdp";
	qcom,board-id = <1 0>;
	qcom,pmic-id = <0x0001001b 0x0101011a 0x0 0x0>,
		       <0x0001001b 0x0102001a 0x0 0x0>,
		       <0x0001001b 0x0201011a 0x0 0x0>;
};

/*
  this file is for attribution only of popsicle
  And public attribution of xiaomi platforms(like P2)
*/




/* Ganges UWB SPI SE Instance */
&qupv3_se17_spi {
	status = "ok";
	spi_cnss {
		compatible = "qcom,spi-cnss";
		reg = <0>;
		spi-max-freq = <32000000>;
		interrupt-parent = <&tlmm>;
		qcom,irq-gpio = <&tlmm 85 0>;
	};
};
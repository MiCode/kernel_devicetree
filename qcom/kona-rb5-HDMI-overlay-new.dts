/dts-v1/;
/plugin/;

#include "kona-rb5-HDMI.dtsi"

/ {
	model = "Qualcomm Technologies, Inc. Robotics RB5 Platform with HDMI adapter card";
	compatible = "qcom,kona-iot-qrd", "qcom,kona-iot", "qcom,kona-qrd";
	qcom,msm-id = <481 0x0>, <481 0x10000>, <481 0x20000>, <481 0x20001>;
	qcom,board-id = <0x401000b 0x0>;
};

/dts-v1/;
/plugin/;

#include "niobep.dtsi"
#include "niobep-atp.dtsi"

/ {
	model = "Qualcomm Technologies, Inc. NiobeP ATP";
	compatible = "qcom,niobep-atp", "qcom,niobep", "qcom,atp";
	qcom,board-id = <0x10021 0>;
};

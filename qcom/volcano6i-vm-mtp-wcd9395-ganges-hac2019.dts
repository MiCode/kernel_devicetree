/dts-v1/;
/plugin/;

#include "volcano-vm.dtsi"
#include "volcano6i-vm-mtp-wcd9395-ganges-hac2019.dtsi"

/ {
	model = "Qualcomm Technologies, Inc. Volcano6I SVM MTP + WCD9395 HSJ + HAC2019/RFID + Ganges";
	compatible = "qcom,volcano-mtp", "qcom,volcano", "qcom,mtp";
	qcom,board-id = <8 4>;
};


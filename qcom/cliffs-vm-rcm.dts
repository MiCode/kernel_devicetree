/dts-v1/;

#include "cliffs-vm.dtsi"
#include "cliffs-vm-rcm.dtsi"

/ {
	model = "Qualcomm Technologies, Inc. Cliffs SVM RCM";
	compatible = "qcom,cliffs-rcm", "qcom,cliffs", "qcom,rcm";
	qcom,board-id = <21 0>;
};

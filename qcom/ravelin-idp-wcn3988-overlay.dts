/dts-v1/;
/plugin/;

#include "ravelin-idp-wcn3988.dtsi"

/ {
	model = "Qualcomm Technologies, Inc. Ravelin IDP + WCN3988";
	compatible = "qcom,ravelin-idp", "qcom,ravelin", "qcom,idp";
	qcom,msm-id = <568 0x10000>;
	qcom,board-id = <34 1>;
};

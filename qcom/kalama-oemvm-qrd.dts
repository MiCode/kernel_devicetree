/dts-v1/;

#include "kalama-oemvm.dtsi"
#include "kalama-oemvm-qrd.dtsi"

/ {
	model = "Qualcomm Technologies, Inc. Kalama OEMVM QRD";
	compatible = "qcom,kalama-qrd", "qcom,kalama", "qcom,qrd";
	qcom,board-id = <0x1000b 0>;
};

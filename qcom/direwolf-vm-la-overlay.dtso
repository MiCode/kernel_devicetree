// SPDX-License-Identifier: BSD-3-Clause
/*
 * Copyright (c) 2024-2025 Qualcomm Innovation Center, Inc. All rights reserved.
 */

/dts-v1/;
/plugin/;

/ {
	model = "Qualcomm Technologies, Inc. Direwolf Single LA Virtual Machine";
	compatible = "qcom,direwolf", "qcom,quinvm";
	qcom,msm-id = <460 0x10000>;
	qcom,board-id = <0 0x1000001>;
};

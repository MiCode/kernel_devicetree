/dts-v1/;
/plugin/;

#include "pineapplep-sg-v2-hdk.dtsi"

/ {
	model = "Qualcomm Technologies, Inc. PineappleP SG V2 HDK";
	compatible = "qcom,pineapplep-hdk", "qcom,pineapplep", "qcom,hdk";
	qcom,msm-id = <682 0x20000>;
	qcom,board-id = <0x1f 0>;
};

&pcie1 {
	msi-map = <0x0 &gic_its 0x1480 0x1>,
		<0x100 &gic_its 0x1481 0x1>; /* 32 event IDs */
};

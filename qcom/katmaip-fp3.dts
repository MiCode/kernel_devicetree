// SPDX-License-Identifier: BSD-3-Clause
/*
 * Copyright (c) 2025 Qualcomm Innovation Center, Inc. All rights reserved.
 */

/dts-v1/;

#include "katmaip-fp3.dtsi"

/ {
	model = "Qualcomm Technologies, Inc. KATMAIP-FPi3 SoC";
	compatible = "qcom,yupikp-iot";
	qcom,board-id = <0 0>;
};

/dts-v1/;
/plugin/;

#include "crow-atp.dtsi"
#include "crow-pm7550ba.dtsi"

/ {
	model = "Qualcomm Technologies, Inc. Crow ATP";
	compatible = "qcom,crow-atp", "qcom,crow", "qcom,atp";
	qcom,msm-id = <608 0x10000>, <644 0x10000>;
	qcom,board-id = <33 0>;
};

&pm7550ba_eusb2_repeater {
	vdd18-supply = <&L7B>;
	vdd3-supply = <&L17B>;
	status = "ok";
};

&eusb2_phy0 {
	dummy-supply = <&pm7550ba_eusb2_repeater>;
	usb-repeater = <&pm7550ba_eusb2_repeater>;
};

// SPDX-License-Identifier: BSD-3-Clause
/*
 * Copyright (c) 2024 Qualcomm Innovation Center, Inc. All rights reserved.
 */

#include "canoep.dtsi"
#include "canoe-tp.dtsi"

/ {
		model = "Qualcomm Technologies, Inc. CanoeP Alt. Thermal Profile SoC";
		compatible = "qcom,canoep";
		qcom,msm-id = <0x1010295 0x10000>;
};

// SPDX-License-Identifier: BSD-3-Clause
/*
 * Copyright (c) Qualcomm Technologies, Inc. and/or its subsidiaries.
 */

/dts-v1/;
/plugin/;

#include "alor-atp.dtsi"
#include "alor-pm7550ba-pmd802x.dtsi"

/ {
	model = "Qualcomm Technologies, Inc. Alor ATP + Peach WLAN + ST54L + Kundu";
	compatible = "qcom,alor-atp", "qcom,alor", "qcom,atp";
	qcom,msm-id = <685 0x10000>;
	qcom,board-id = <0x10021 0>;
};

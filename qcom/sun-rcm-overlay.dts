// SPDX-License-Identifier: BSD-3-Clause
/*
 * Copyright (c) Qualcomm Technologies, Inc. and/or its subsidiaries.
 */

/dts-v1/;
/plugin/;

#include "sun-rcm.dtsi"

/ {
	model = "Qualcomm Technologies, Inc. Sun RCM";
	compatible = "qcom,sun-rcm", "qcom,sun", "qcom,sunp", "qcom,sunp-rcm", "qcom,rcm";
	qcom,msm-id = <618 0x10000>, <618 0x20000>, <639 0x10000>, <639 0x20000>,
		      <0x100026a 0x10000>, <0x100026a 0x20000>,
		      <0x100027f 0x10000>, <0x100027f 0x20000>,
		      <705 0x10000>, <705 0x20000>, <706 0x10000>, <706 0x20000>,
		      <0x10002c1 0x10000>, <0x10002c1 0x20000>,
		      <0x10002c2 0x10000>, <0x10002c2 0x20000>;
	qcom,board-id = <0x15 0>;
};

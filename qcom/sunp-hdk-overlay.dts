// SPDX-License-Identifier: BSD-3-Clause
/*
 * Copyright (c) Qualcomm Technologies, Inc. and/or its subsidiaries.
 */

/dts-v1/;
/plugin/;

#include "sunp-hdk.dtsi"

/ {
	model = "Qualcomm Technologies, Inc. SunP QRD HDK";
	compatible = "qcom,sunp-hdk", "qcom,sunp", "qcom,hdk";
	qcom,msm-id = <639 0x10000>, <639 0x20000>, <618 0x10000>, <618 0x20000>,
			<0x100026a 0x10000>, <0x100026a 0x20000>,
			<0x100027f 0x10000>, <0x100027f 0x20000>,
		      <705 0x10000>, <705 0x20000>, <706 0x10000>, <706 0x20000>,
			<0x10002c1 0x10000>, <0x10002c1 0x20000>,
			<0x10002c2 0x10000>, <0x10002c2 0x20000>;
	qcom,board-id = <0x1001f 0>;
};

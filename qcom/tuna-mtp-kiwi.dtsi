// SPDX-License-Identifier: BSD-3-Clause
/*
 * Copyright (c) 2024 Qualcomm Innovation Center, Inc. All rights reserved.
 */

#include "tuna-mtp.dtsi"

&S1G {
	regulator-min-microvolt = <806000>;
	regulator-max-microvolt = <1003000>;
	qcom,init-voltage = <852000>;
};

&L3G {
	regulator-always-on;
};

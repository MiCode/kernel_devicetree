#include "waipio-vm.dtsi"

/ {
	model = "Qualcomm Technologies, Inc. Cape SVM";
	compatible = "qcom,cape";
	qcom,msm-id = <530 0x10000>, <531 0x10000>, <540 0x10000>;
};

&tlmm {
	compatible = "qcom,cape-vm-pinctrl";
};

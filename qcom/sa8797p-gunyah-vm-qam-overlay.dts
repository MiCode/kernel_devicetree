/dts-v1/;
/plugin/;

/ {
	model = "Qualcomm Technologies, Inc. SA8797p QAM Gunyah VM";
	compatible = "qcom,sa8797p", "qcom,qam";
	qcom,msm-id = <690 0x10000>, <690 0x20000>;
	qcom,board-id = <0x10025 0x0>;
};

/dts-v1/;

#include "kalama.dtsi"
#include "kalama-mtp.dtsi"

/ {
	model = "Qualcomm Technologies, Inc. Kalama MTP";
	compatible = "qcom,kalama-mtp", "qcom,kalama", "qcom,mtp";
	qcom,board-id = <8 0>;
};

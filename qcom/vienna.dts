// SPDX-License-Identifier: BSD-3-Clause
/*
 * Copyright (c) 2024 Qualcomm Innovation Center, Inc. All rights reserved.
 */

/dts-v1/;

#include "vienna.dtsi"

/ {
	model = "Qualcomm Technologies, Inc. Vienna SoC";
	compatible = "qcom,vienna";
	qcom,board-id = <0 0>;
};


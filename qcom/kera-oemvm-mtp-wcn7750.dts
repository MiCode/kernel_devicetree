// SPDX-License-Identifier: BSD-3-Clause
/*
 * Copyright (c) 2024 Qualcomm Innovation Center, Inc. All rights reserved.
 */

/dts-v1/;

#include "kera-oemvm.dtsi"
#include "kera-oemvm-mtp-wcn7750.dtsi"

/ {
	model = "Qualcomm Technologies, Inc. Kera OEMVM MTP + WCN7750";
	compatible = "qcom,kera-mtp", "qcom,kera", "qcom,kerap-mtp", "qcom,kerap",
			"qcom,mtp";
	qcom,board-id = <0x10008 1>, <0x20008 1>, <0x30008 1>;
};

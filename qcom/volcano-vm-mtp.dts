/dts-v1/;

#include "volcano-vm.dtsi"
#include "volcano-vm-mtp.dtsi"

/ {
	model = "Qualcomm Technologies, Inc. Volcano SVM MTP";
	compatible = "qcom,volcano-mtp", "qcom,volcano", "qcom,mtp";
	qcom,board-id = <8 0>;
};

/dts-v1/;

#include "niobep-vm.dtsi"
#include "niobep-vm-idp.dtsi"

/ {
	model = "Qualcomm Technologies, Inc. NiobeP SVM IDP";
	compatible = "qcom,niobep-idp", "qcom,niobep", "qcom,idp";
	qcom,board-id = <0x10022 0>;
};

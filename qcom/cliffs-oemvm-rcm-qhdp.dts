/dts-v1/;

#include "cliffs-oemvm.dtsi"
#include "cliffs-oemvm-rcm-qhdp.dtsi"

/ {
	model = "Qualcomm Technologies, Inc. Cliffs OEMVM RCM + QHD Plus";
	compatible = "qcom,cliffs-rcm", "qcom,cliffs", "qcom,rcm";
	qcom,board-id = <21 1>;
};

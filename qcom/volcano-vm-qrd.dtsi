&soc {
};

&qupv3_se0_spi {
	status = "ok";
	goodix-berlin@0 {
		compatible = "goodix,gt9916S";
		reg = <0>;
		spi-max-frequency = <1000000>;
		goodix,panel-max-x = <1080>;
		goodix,panel-max-y = <2400>;
		goodix,panel-max-w = <255>;
		goodix,panel-max-p = <4096>;
		goodix,touch-type = "primary";
		goodix,qts_en;
		qts,trusted-touch-mode = "vm_mode";
		qts,touch-environment = "tvm";
		qts,trusted-touch-type = "primary";
		qts,trusted-touch-spi-irq = <598>;
		qts,trusted-touch-io-bases = <0xa80000>;
		qts,trusted-touch-io-sizes = <0x1000>;
		qts,trusted-touch-vm-gpio-list = <&tlmm 0 0 &tlmm 1 0 &tlmm 2 0
						&tlmm 3 0 &tlmm 20 0 &tlmm 19 0x2008>;
	};
};

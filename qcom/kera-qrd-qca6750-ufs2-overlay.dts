// SPDX-License-Identifier: BSD-3-Clause
/*
 * Copyright (c) 2024 Qualcomm Innovation Center, Inc. All rights reserved.
 */

/dts-v1/;
/plugin/;

#include "kera-qrd-qca6750-ufs2.dtsi"
#include "kera-pmiv0102.dtsi"

/ {
	model = "Qualcomm Technologies, Inc. Kera QRD + QCA6750 + UFS2";
	compatible = "qcom,kera-qrd", "qcom,kera", "qcom,kerap-qrd", "qcom,kerap",
			"qcom,qrd";
	qcom,msm-id = <686 0x10000>, <659 0x10000>;
	qcom,board-id = <0x3000B 1>;
};

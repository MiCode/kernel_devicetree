/dts-v1/;

#include "cliffs-vm.dtsi"
#include "cliffs-vm-mtp.dtsi"

/ {
	model = "Qualcomm Technologies, Inc. Cliffs SVM MTP";
	compatible = "qcom,cliffs-mtp", "qcom,cliffs", "qcom,mtp";
	qcom,board-id = <8 0>;
};

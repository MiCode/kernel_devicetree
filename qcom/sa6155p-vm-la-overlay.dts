/dts-v1/;
/plugin/;

/ {
	model = "Qualcomm Technologies, Inc. SA6155P Guest Virtual Machine";
	compatible = "qcom,sa6155p", "qcom,quinvm";
	qcom,msm-id = <377 0x10000>;
	qcom,board-id = <0 0x1000001>;
};

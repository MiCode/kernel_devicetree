/dts-v1/;
/plugin/;

#include "trinket-idp.dtsi"

/ {
	model = "Qualcomm Technologies, Inc. USBC Display IDP";
	compatible = "qcom,trinket-idp", "qcom,trinket", "qcom,idp";
	qcom,msm-id = <394 0x10000>;
	qcom,board-id = <34 5>;
};

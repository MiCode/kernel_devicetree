/dts-v1/;
/plugin/;

#include "kalama-cdp-wsa883x.dtsi"

/ {
	model = "Qualcomm Technologies, Inc. Kalama CDP WSA883x";
	compatible = "qcom,kalama-cdp", "qcom,kalama", "qcom,cdp";
	qcom,msm-id = <519 0x10000>, <536 0x10000>, <519 0x20000>, <536 0x20000>, <600 0x20000>, <601 0x20000>;
	qcom,board-id = <0x1010001 0>;
};

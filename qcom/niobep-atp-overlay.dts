/dts-v1/;
/plugin/;

#include "niobep-atp.dtsi"

/ {
	model = "Qualcomm Technologies, Inc. NiobeP ATP";
	compatible = "qcom,niobep-atp", "qcom,niobep", "qcom,atp";
	qcom,msm-id = <652 0x10000>;
	qcom,board-id = <0x10021 0>;
};

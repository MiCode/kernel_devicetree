// SPDX-License-Identifier: BSD-3-Clause
/*
 * Copyright (c) 2022-2023 Qualcomm Innovation Center, Inc. All rights reserved.
 */

/dts-v1/;
/plugin/;

#include "pineapple-rumi.dtsi"

/ {
	model = "Qualcomm Technologies, Inc. Pineapple RUMI";
	compatible = "qcom,pineapple-rumi", "qcom,pineapple", "qcom,rumi";
	qcom,msm-id = <557 0x10000>, <557 0x20000>;
	qcom,board-id = <15 0>;
};

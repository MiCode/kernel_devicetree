// SPDX-License-Identifier: BSD-3-Clause
/*
 * Copyright (c) 2022-2023 Qualcomm Innovation Center, Inc. All rights reserved.
 */
/dts-v1/;

#include "pineapple-oemvm.dtsi"
#include "pineapple-oemvm-cdp.dtsi"

/ {
	model = "Qualcomm Technologies, Inc. Pineapple OEMVM CDP";
	compatible = "qcom,pineapple-cdp", "qcom,pineapple", "qcom,cdp";
	qcom,board-id = <0x10001 0>;
};

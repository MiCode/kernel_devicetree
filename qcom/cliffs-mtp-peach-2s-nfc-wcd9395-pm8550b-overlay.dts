/dts-v1/;
/plugin/;

#include "cliffs-mtp-peach-2s-nfc-wcd9395.dtsi"
#include "cliffs-pm8550b.dtsi"

/ {
	model = "Qualcomm Technologies, Inc. Cliffs MTP + peach + 2S + NFC + WCD9395 + pm8550b";
	compatible = "qcom,cliffs-mtp", "qcom,cliffs", "qcom,cliffsp-mtp", "qcom,cliffsp", "qcom,mtp";
	qcom,msm-id = <614 0x10000>, <632 0x10000>, <642 0x10000>, <643 0x10000>;
	qcom,board-id = <8 4>;
};

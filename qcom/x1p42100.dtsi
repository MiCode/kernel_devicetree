// SPDX-License-Identifier: BSD-3-Clause
/*
 * Copyright (c) Qualcomm Technologies, Inc. and/or its subsidiaries.
 */

/* X1P42100 is heavily based on X1E80100, with some meaningful differences */
#include "x1e80100.dtsi"
#include "x1p42100-regulators.dtsi"

/delete-node/ &CPU8;
/delete-node/ &CPU9;
/delete-node/ &CPU10;
/delete-node/ &CPU11;
/delete-node/ &cpu_map_cluster2;

/ {
	hypervisor: hypervisor {
		gh_watchdog: qcom,gh-watchdog { };
	};
};

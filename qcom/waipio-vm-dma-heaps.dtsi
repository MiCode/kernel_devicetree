// SPDX-License-Identifier: BSD-3-Clause
/*
 * Copyright (c) 2024 Qualcomm Innovation Center, Inc. All rights reserved.
 */

#include <dt-bindings/arm/msm/qcom_dma_heap_dt_constants.h>

&soc {
	qcom,dma-heaps {
		compatible = "qcom,dma-heaps";

		qcom,tui {
			qcom,dma-heap-name = "qcom,tui";
			qcom,dma-heap-type = <HEAP_TYPE_CARVEOUT>;
			qcom,dynamic-heap;
		};
	};
};

// SPDX-License-Identifier: BSD-3-Clause
/*
 * Copyright (c) 2025 Qualcomm Innovation Center, Inc. All rights reserved.
 */

/dts-v1/;

#include "katmaip.dtsi"

/ {
	model = "Qualcomm Technologies, Inc. KATMAIP SoC";
	compatible = "qcom,yupikp-iot";
	qcom,board-id = <0 0>;
};

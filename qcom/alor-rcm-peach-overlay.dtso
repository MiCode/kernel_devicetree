// SPDX-License-Identifier: BSD-3-Clause
/*
 * Copyright (c) 2025 Qualcomm Innovation Center, Inc. All rights reserved.
 */

/dts-v1/;
/plugin/;

#include "alor-rcm-peach.dtsi"

/ {
	model = "Qualcomm Technologies, Inc. Alor RCM + Peach WLAN + Kundu";
	compatible = "qcom,alor-rcm", "qcom,alor", "qcom,rcm";
	qcom,msm-id = <685 0x10000>;
	qcom,board-id = <0x20015 0>;
};

/dts-v1/;
/plugin/;

#include "blairp-mtp-usbc.dtsi"
#include "holi-mtp-pm7250b.dtsi"

/ {
	model = "Qualcomm Technologies, Inc. Blairp MTP USBC audio";
	compatible = "qcom,blairp-mtp", "qcom,blairp", "qcom,mtp";
	qcom,msm-id = <565 0x10000>;
	qcom,board-id = <8 1>;
};

&pm7250b_charger {
	dpdm-supply = <&usb2_phy0>;
};

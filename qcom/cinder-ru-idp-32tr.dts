/dts-v1/;

#include "cinder-v2-ru.dtsi"
#include "cinder-v2-ru-hireg.dtsi"
#include "cinder-v2-idp.dtsi"
#include "cinder-pmic-32tr-overlay.dtsi"

/ {
	model = "Qualcomm Technologies, Inc. Cinder V2 RU IDP + Multiple PM8150 32TR";
	compatible = "qcom,cinder-idp", "qcom,cinder", "qcom,idp";
	qcom,board-id = <0x22 0x600>;
};

&pm8150_vadc {
	/delete-node/ xo_therm;
};

&thermal_zones {
	/delete-node/ sys-therm-0;
};

&pm8150_adc_tm {
	/delete-node/ xo_therm;
};

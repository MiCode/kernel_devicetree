/dts-v1/;
/plugin/;

/ {
	model = "Qualcomm Technologies, Inc. Lemans IVI ADAS COB Gunyah VM";
	compatible = "qcom,lemans", "qcom,qam";
	qcom,msm-id = <532 0x10000>, <533 0x10000>, <534 0x10000>, <619 0x10000>, <532 0x20000>, <533 0x20000>, <534 0x20000>, <619 0x20000>;
	qcom,board-id = <0x10019 0x0>;
};

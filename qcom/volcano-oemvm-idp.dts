/dts-v1/;

#include "volcano-oemvm.dtsi"
#include "volcano-oemvm-idp.dtsi"

/ {
	model = "Qualcomm Technologies, Inc. Volcano OEMVM idp";
	compatible = "qcom,volcano-idp", "qcom,volcano", "qcom,idp";
	qcom,board-id = <34 0>;
};

/dts-v1/;

#include "ravelin-4gb.dtsi"
#include "ravelin-idp-4gb.dtsi"

/ {
	model = "Qualcomm Technologies, Inc. Ravelin IDP 4GB DDR";
	compatible = "qcom,ravelin-idp", "qcom,ravelin", "qcom,idp";
	qcom,board-id = <0x34 0x600>;
};

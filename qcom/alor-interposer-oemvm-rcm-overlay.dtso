// SPDX-License-Identifier: BSD-3-Clause
/*
 * Copyright (c) 2025 Qualcomm Innovation Center, Inc. All rights reserved.
 */

/dts-v1/;
/plugin/;

#include "canoe-oemvm-avf.dtsi"
#include "canoe-oemvm-rcm-avf.dtsi"

/ {
	model = "Qualcomm Technologies, Inc. Alor Interposer OEMVM RCM";
	compatible = "qcom,alor-rcm", "qcom,alor", "qcom,rcm";
	qcom,msm-id = <704 0x10000>, <704 0x20000>,
			<0x10002C0 0x10000>, <0x10002C0 0x20000>;
	qcom,board-id = <0x15 0>;
};

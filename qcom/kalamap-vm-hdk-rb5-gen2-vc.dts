/dts-v1/;
/plugin/;

#include "kalamap-vm.dtsi"
#include "kalamap-vm-hdk-rb5-gen2-vc.dtsi"

/ {
	model = "Qualcomm Technologies, Inc. KalamaP SVM HDK RB5 Gen2 VC";
	compatible = "qcom,kalamap-hdk", "qcom,kalamap", "qcom,hdk";
	qcom,board-id = <0x1001f 0x6>;
};

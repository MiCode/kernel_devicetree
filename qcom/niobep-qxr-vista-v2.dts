/dts-v1/;
/plugin/;

#include "niobep.dtsi"
#include "niobep-qxr-vista-v2.dtsi"

/ {
	model = "Qualcomm Technologies, Inc. NiobeP QXR Vista V2";
	compatible = "qcom,niobep-qxr", "qcom,niobep", "qcom,qxr";
	qcom,board-id = <0x20026 0x1>;
};

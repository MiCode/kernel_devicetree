/dts-v1/;
/plugin/;

#include "volcano-vm.dtsi"
#include "volcano6i-vm-mtp-ganges.dtsi"

/ {
	model = "Qualcomm Technologies, Inc. Volcano6I SVM MTP + WCD9378 AATC + Ganges";
	compatible = "qcom,volcano-mtp", "qcom,volcano", "qcom,mtp";
	qcom,board-id = <8 3>;
};


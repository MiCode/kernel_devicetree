/dts-v1/;

#include "qcs605-lc.dtsi"
#include "qcs605-lc-cdp.dtsi"

/ {
	model = "Qualcomm Technologies, Inc. QC605 LC Groot + PM8005 CDP";
	compatible = "qcom,qcs605-cdp", "qcom,qcs605", "qcom,cdp";
	qcom,board-id = <1 4>;
};

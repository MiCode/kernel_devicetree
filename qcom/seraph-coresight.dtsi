&soc {
	ddr_cti0: cti@11502f00 {
		compatible = "arm,coresight-cti", "arm,primecell";
		reg = <0x11502f00 0x1000>;

		arm,primecell-periphid = <0x000bb922>;
		coresight-name = "coresight-cti-ddr_cti0";
		qcom,extended_cti;
		clocks = <&aoss_qmp>;
		clock-names = "apb_pclk";
	};

	ddr_cti1: cti@11508f00 {
		compatible = "arm,coresight-cti", "arm,primecell";
		reg = <0x11508f00 0x1000>;

		arm,primecell-periphid = <0x000bb922>;
		coresight-name = "coresight-cti-ddr_cti1";
		qcom,extended_cti;
		clocks = <&aoss_qmp>;
		clock-names = "apb_pclk";
	};

	ddr_lpi_cti: cti@11331000 {
		compatible = "arm,coresight-cti", "arm,primecell";
		reg = <0x11331000 0x1000>;

		arm,primecell-periphid = <0x000bb922>;
		coresight-name = "coresight-cti-lpi_cti";
		status = "disabled";
		qcom,extended_cti;
		clocks = <&aoss_qmp>;
		clock-names = "apb_pclk";
	};

	dlct1_cti: cti@112c3000 {
		compatible = "arm,coresight-cti", "arm,primecell";
		reg = <0x112c3000 0x1000>;

		arm,primecell-periphid = <0x000bb922>;
		coresight-name = "coresight-cti-dlct1_cti";
		qcom,extended_cti;
		clocks = <&aoss_qmp>;
		clock-names = "apb_pclk";
	};

	eva_cti: cti@11441000 {
		compatible = "arm,coresight-cti", "arm,primecell";
		reg = <0x11441000 0x1000>;

		arm,primecell-periphid = <0x000bb922>;
		coresight-name = "coresight-cti-eva_cti";
		qcom,extended_cti;
		clocks = <&aoss_qmp>;
		clock-names = "apb_pclk";
	};

	lpass_cti0: cti@11351000 {
		compatible = "arm,coresight-cti", "arm,primecell";
		reg = <0x11351000 0x1000>;

		arm,primecell-periphid = <0x000bb922>;
		coresight-name = "coresight-cti-lpass_cti0";
		qcom,extended_cti;
		status = "disabled";
		clocks = <&aoss_qmp>;
		clock-names = "apb_pclk";
	};

	lpass_cti1: cti@11342000 {
		compatible = "arm,coresight-cti", "arm,primecell";
		reg = <0x11342000 0x1000>;

		arm,primecell-periphid = <0x000bb922>;
		coresight-name = "coresight-cti-lpass_cti1";
		qcom,extended_cti;
		status = "disabled";
		clocks = <&aoss_qmp>;
		clock-names = "apb_pclk";
	};

	lsr_cti: cti@111b1000 {
		compatible = "arm,coresight-cti", "arm,primecell";
		reg = <0x111b1000 0x1000>;

		arm,primecell-periphid = <0x000bb922>;
		coresight-name = "coresight-cti-lsr_cti";
		qcom,extended_cti;
		clocks = <&aoss_qmp>;
		clock-names = "apb_pclk";
	};

	mdss_cti: cti@11461000 {
		compatible = "arm,coresight-cti", "arm,primecell";
		reg = <0x11461000 0x1000>;

		arm,primecell-periphid = <0x000bb922>;
		coresight-name = "coresight-cti-mdss_cti";
		qcom,extended_cti;
		clocks = <&aoss_qmp>;
		clock-names = "apb_pclk";
	};

	soccp_cti: cti@11381000 {
		compatible = "arm,coresight-cti", "arm,primecell";
		reg = <0x11381000 0x1000>;

		arm,primecell-periphid = <0x000bb922>;
		coresight-name = "coresight-cti-soccp_cti";
		qcom,extended_cti;
		clocks = <&aoss_qmp>;
		clock-names = "apb_pclk";
	};

	wpss_cti0: cti@111a2000 {
		compatible = "arm,coresight-cti", "arm,primecell";
		reg = <0x111a2000 0x1000>;

		arm,primecell-periphid = <0x000bb922>;
		coresight-name = "coresight-cti-wpss_cti0";
		qcom,extended_cti;
		clocks = <&aoss_qmp>;
		clock-names = "apb_pclk";
	};

	wpss_cti1: cti@111ab000 {
		compatible = "arm,coresight-cti", "arm,primecell";
		reg = <0x111ab000 0x1000>;

		arm,primecell-periphid = <0x000bb922>;
		coresight-name = "coresight-cti-wpss_cti1";
		qcom,extended_cti;
		clocks = <&aoss_qmp>;
		clock-names = "apb_pclk";
	};

	iris_dl_cti: cti@11031000 {
		compatible = "arm,coresight-cti", "arm,primecell";
		reg = <0x11031000 0x1000>;

		arm,primecell-periphid = <0x000bb922>;
		coresight-name = "coresight-cti-iris_dl_cti";
		qcom,extended_cti;
		clocks = <&aoss_qmp>;
		clock-names = "apb_pclk";
	};

	aop_rvss: cti@11321000 {
		compatible = "arm,coresight-cti", "arm,primecell";
		reg = <0x11321000 0x1000>;

		arm,primecell-periphid = <0x000bb922>;
		coresight-name = "coresight-cti-aop_rvss";
		status = "disabled";
		clocks = <&aoss_qmp>;
		clock-names = "apb_pclk";
	};

	riscv_cti: cti@1282b000 {
		compatible = "arm,coresight-cti", "arm,primecell";
		reg = <0x1282b000 0x1000>;

		arm,primecell-periphid = <0x000bb922>;
		coresight-name = "coresight-cti-riscv_cti";
		status = "disabled";
		clocks = <&aoss_qmp>;
		clock-names = "apb_pclk";
	};

	ddrss_shrm2: cti@11511000 {
		compatible = "arm,coresight-cti", "arm,primecell";
		reg = <0x11511000 0x1000>;

		arm,primecell-periphid = <0x000bb922>;
		coresight-name = "coresight-cti-ddrss_shrm2";
		status = "disabled";
		clocks = <&aoss_qmp>;
		clock-names = "apb_pclk";
	};

	turing_dl_cti_0: cti@11187000 {
		compatible = "arm,coresight-cti", "arm,primecell";
		reg = <0x11187000 0x1000>;

		arm,primecell-periphid = <0x000bb922>;
		coresight-name = "coresight-cti-turing_dl_cti_0";
		qcom,extended_cti;
		clocks = <&aoss_qmp>;
		clock-names = "apb_pclk";
	};

	dlmm_cti0: cti@11409000 {
		compatible = "arm,coresight-cti", "arm,primecell";
		reg = <0x11409000 0x1000>;

		arm,primecell-periphid = <0x000bb922>;
		coresight-name = "coresight-cti-dlmm_cti0";
		qcom,extended_cti;
		clocks = <&aoss_qmp>;
		clock-names = "apb_pclk";
	};

	swao_cti: cti@11300000 {
		compatible = "arm,coresight-cti", "arm,primecell";
		reg = <0x11300000 0x1000>;

		arm,primecell-periphid = <0x000bb922>;
		coresight-name = "coresight-cti-swao_cti";
		qcom,extended_cti;
		clocks = <&aoss_qmp>;
		clock-names = "apb_pclk";
	};

	gpu_dl: cti@11101000 {
		compatible = "arm,coresight-cti", "arm,primecell";
		reg = <0x11101000 0x1000>;

		arm,primecell-periphid = <0x000bb922>;
		coresight-name = "coresight-cti-gpu_dl";
		qcom,extended_cti;
		clocks = <&aoss_qmp>;
		clock-names = "apb_pclk";
	};

	gpu_cortex_m3: cti@11162000 {
		compatible = "arm,coresight-cti", "arm,primecell";
		reg = <0x11162000 0x1000>;

		arm,primecell-periphid = <0x000bb922>;
		coresight-name = "coresight-cti-gpu_cortex_m3";
		status = "disabled";
		clocks = <&aoss_qmp>;
		clock-names = "apb_pclk";
	};

	gpu_isdb_cti: cti@11161000 {
		compatible = "arm,coresight-cti", "arm,primecell";
		reg = <0x11161000 0x1000>;

		arm,primecell-periphid = <0x000bb922>;
		coresight-name = "coresight-cti-gpu_isdb_cti";
		status = "disabled";
		clocks = <&aoss_qmp>;
		clock-names = "apb_pclk";
	};

	apss_cti0: cti@128e0000 {
		compatible = "arm,coresight-cti", "arm,primecell";
		reg = <0x128e0000 0x1000>;

		arm,primecell-periphid = <0x000bb922>;
		coresight-name = "coresight-cti-apss_cti0";

		clocks = <&aoss_qmp>;
		clock-names = "apb_pclk";
	};

	apss_cti1: cti@128f0000 {
		compatible = "arm,coresight-cti", "arm,primecell";
		reg = <0x128f0000 0x1000>;

		arm,primecell-periphid = <0x000bb922>;
		coresight-name = "coresight-cti-apss_cti1";

		clocks = <&aoss_qmp>;
		clock-names = "apb_pclk";
	};

	apss_cti2: cti@12900000 {
		compatible = "arm,coresight-cti", "arm,primecell";
		reg = <0x12900000 0x1000>;

		arm,primecell-periphid = <0x000bb922>;
		coresight-name = "coresight-cti-apss_cti2";

		clocks = <&aoss_qmp>;
		clock-names = "apb_pclk";
	};

	apss_atb_cti: cti@12862000 {
		compatible = "arm,coresight-cti", "arm,primecell";
		reg = <0x12862000 0x1000>;

		arm,primecell-periphid = <0x000bb922>;
		coresight-name = "coresight-cti-apss_atb_cti";
		qcom,extended_cti;
		clocks = <&aoss_qmp>;
		clock-names = "apb_pclk";
	};

	qdss_cti: cti@10010000 {
		compatible = "arm,coresight-cti", "arm,primecell";
		reg = <0x10010000 0x1000>;

		arm,primecell-periphid = <0x000bb922>;
		coresight-name = "coresight-cti-qdss_cti";
		qcom,extended_cti;
		clocks = <&aoss_qmp>;
		clock-names = "apb_pclk";
	};

	ddr_ch02_dl_cti_0: cti@11521000 {
		compatible = "arm,coresight-cti", "arm,primecell";
		reg = <0x11521000 0x1000>;

		arm,primecell-periphid = <0x000bb922>;
		coresight-name = "coresight-cti-ddr_ch02_dl_cti_0";
		qcom,extended_cti;
		clocks = <&aoss_qmp>;
		clock-names = "apb_pclk";
	};

	cti0: cti@1142a000 {
		compatible = "arm,coresight-cti", "arm,primecell";
		reg = <0x1142a000 0x1000>;

		arm,primecell-periphid = <0x000bb922>;
		coresight-name = "coresight-cti-cti0";
		qcom,extended_cti;
		clocks = <&aoss_qmp>;
		clock-names = "apb_pclk";
	};

	lpass_lpi_cti1: cti@11341000 {
		compatible = "arm,coresight-cti", "arm,primecell";
		reg = <0x11341000 0x1000>;

		arm,primecell-periphid = <0x000bb922>;
		coresight-name = "coresight-cti-lpass_lpi_cti1";
		status = "disabled";
		clocks = <&aoss_qmp>;
		clock-names = "apb_pclk";
	};

	lpass_q6_cti: cti@1134b000 {
		compatible = "arm,coresight-cti", "arm,primecell";
		reg = <0x1134b000 0x1000>;

		arm,primecell-periphid = <0x000bb922>;
		coresight-name = "coresight-cti-lpass_q6_cti";
		status = "disabled";
		clocks = <&aoss_qmp>;
		clock-names = "apb_pclk";
	};

	turing_q6_cti: cti@11193000 {
		compatible = "arm,coresight-cti", "arm,primecell";
		reg = <0x11193000 0x1000>;

		arm,primecell-periphid = <0x000bb922>;
		coresight-name = "coresight-cti-turing_q6_cti";

		clocks = <&aoss_qmp>;
		clock-names = "apb_pclk";
	};

	tmess_cpu: cti@114d1000 {
		compatible = "arm,coresight-cti", "arm,primecell";
		reg = <0x114d1000 0x1000>;

		arm,primecell-periphid = <0x000bb922>;
		coresight-name = "coresight-cti-tmess_cpu";

		clocks = <&aoss_qmp>;
		clock-names = "apb_pclk";
	};

	tmess_cti_0: cti@114c3000 {
		compatible = "arm,coresight-cti", "arm,primecell";
		reg = <0x114c3000 0x1000>;

		arm,primecell-periphid = <0x000bb922>;
		coresight-name = "coresight-cti-tmess_cti_0";
		qcom,extended_cti;
		status = "disabled";
		clocks = <&aoss_qmp>;
		clock-names = "apb_pclk";
	};

	ipcb_tgu: tgu@1130e000 {
		compatible = "arm,primecell";
		arm,primecell-periphid = <0x000bb999>;
		reg = <0x1130e000 0x1000>;
		reg-names = "tgu-base";
		tgu-steps = <3>;
		tgu-conditions = <4>;
		tgu-regs = <4>;
		tgu-timer-counters = <8>;

		coresight-name = "coresight-tgu-ipcb";

		clocks = <&aoss_qmp>;
		clock-names = "apb_pclk";
	};

	spmi_tgu0: tgu@1130f000 {
		compatible = "arm,primecell";
		arm,primecell-periphid = <0x000bb999>;

		reg = <0x1130f000 0x1000>;
		reg-names = "tgu-base";

		tgu-steps = <3>;
		tgu-conditions = <4>;
		tgu-regs = <9>;
		tgu-timer-counters = <8>;

		coresight-name = "coresight-tgu-spmi0";

		clocks = <&aoss_qmp>;
		clock-names = "apb_pclk";
	};

	spmi_tgu1: tgu@11310000 {
		compatible = "arm,primecell";
		arm,primecell-periphid = <0x000bb999>;

		reg = <0x11310000 0x1000>;
		reg-names = "tgu-base";

		tgu-steps = <3>;
		tgu-conditions = <4>;
		tgu-regs = <9>;
		tgu-timer-counters = <8>;

		coresight-name = "coresight-tgu-spmi1";

		clocks = <&aoss_qmp>;
		clock-names = "apb_pclk";
	};

	csr: csr@10001000 {
		compatible = "qcom,coresight-csr";
		reg = <0x10001000 0x1000>;
		reg-names = "csr-base";

		coresight-name = "coresight-csr";
		qcom,hwctrl-set-support;
		qcom,set-byte-cntr-support;

		qcom,blk-size = <1>;
	};

	swao_csr: csr@11311000 {
		compatible = "qcom,coresight-csr";
		reg = <0x11311000 0x1000>,
			  <0x113110f8 0x70>;
		reg-names = "csr-base", "msr-base";

		coresight-name = "coresight-swao-csr";
		qcom,timestamp-support;
		qcom,msr-support;

		clocks = <&aoss_qmp>;
		clock-names = "apb_pclk";

		qcom,blk-size = <1>;
	};

	etm0 {
		compatible = "arm,primecell";
		arm,primecell-periphid = <0x000bb95d>;
		reg = <0x12040000 0x1000>;
		cpu = <&CPU0>;

		coresight-name = "coresight-etm0";
		qcom,skip-power-up;

		clocks = <&aoss_qmp>;
		clock-names = "apb_pclk";
		atid = <1>;
		out-ports {
			port {
				etm0_out_funnel_etm: endpoint {
				remote-endpoint = <&funnel_etm_in_etm0>;
				};
			};
		};
	};

	etm1 {
		compatible = "arm,primecell";
		arm,primecell-periphid = <0x000bb95d>;
		reg = <0x12140000 0x1000>;
		cpu = <&CPU1>;

		coresight-name = "coresight-etm1";
		qcom,skip-power-up;

		clocks = <&aoss_qmp>;
		clock-names = "apb_pclk";
		atid = <2>;
		out-ports {
			port {
				etm1_out_funnel_etm: endpoint {
				remote-endpoint = <&funnel_etm_in_etm1>;
				};
			};
		};
	};

	etm2 {
		compatible = "arm,primecell";
		arm,primecell-periphid = <0x000bb95d>;
		reg = <0x12240000 0x1000>;
		cpu = <&CPU2>;

		coresight-name = "coresight-etm2";
		qcom,skip-power-up;

		clocks = <&aoss_qmp>;
		clock-names = "apb_pclk";
		atid = <3>;
		out-ports {
			port {
				etm2_out_funnel_etm: endpoint {
					remote-endpoint = <&funnel_etm_in_etm2>;
				};
			};
		};
	};

	etm3 {
		compatible = "arm,primecell";
		arm,primecell-periphid = <0x000bb95d>;
		reg = <0x12340000 0x1000>;
		cpu = <&CPU3>;

		coresight-name = "coresight-etm3";
		qcom,skip-power-up;

		clocks = <&aoss_qmp>;
		clock-names = "apb_pclk";
		atid = <4>;
		out-ports {
			port {
				etm3_out_funnel_etm: endpoint {
				remote-endpoint = <&funnel_etm_in_etm3>;
				};
			};
		};
	};

	etm4 {
		compatible = "arm,primecell";
		arm,primecell-periphid = <0x000bb95d>;
		reg = <0x12440000 0x1000>;
		cpu = <&CPU4>;

		coresight-name = "coresight-etm4";
		qcom,skip-power-up;
		clocks = <&aoss_qmp>;
		clock-names = "apb_pclk";
		atid = <5>;
		out-ports {
			port {
				etm4_out_funnel_etm: endpoint {
				remote-endpoint = <&funnel_etm_in_etm4>;
				};
			};
		};
	};

	funnel_etm:funnel@12800000 {
		compatible = "arm,primecell";
		arm,primecell-periphid = <0x000bb908>;

		reg = <0x12800000 0x1000>;
		reg-names = "funnel-base";

		coresight-name = "coresight-funnel-etm";

		clocks = <&aoss_qmp>;
		clock-names = "apb_pclk";

		out-ports {
			port {
				funnel_etm_out_funnel_apss: endpoint {
					remote-endpoint =
					<&funnel_apss_in_funnel_etm>;
				};
			};
		};

		in-ports {
			#address-cells = <1>;
			#size-cells = <0>;

			port@0 {
				reg = <0>;
				funnel_etm_in_etm0: endpoint {
					remote-endpoint =
					<&etm0_out_funnel_etm>;
				};
			};

			port@1 {
				reg = <1>;
				funnel_etm_in_etm1: endpoint {
				remote-endpoint =
					<&etm1_out_funnel_etm>;
				};
			};

			port@2 {
				reg = <2>;
				funnel_etm_in_etm2: endpoint {
				remote-endpoint =
					<&etm2_out_funnel_etm>;
				};
			};

			port@3 {
				reg = <3>;
				funnel_etm_in_etm3: endpoint {
				remote-endpoint =
					<&etm3_out_funnel_etm>;
				};
			};

			port@4 {
				reg = <4>;
				funnel_etm_in_etm4: endpoint {
				remote-endpoint =
					<&etm4_out_funnel_etm>;
				};
			};

		};
	};

	tpdm_llm_silver: tpdm@128a0000 {
		compatible = "arm,primecell";
		arm,primecell-periphid = <0x000bb968>;
		reg = <0x128a0000 0x1000>;
		reg-names = "tpdm-base";

		coresight-name = "coresight-tpdm-llm-silver";

		clocks = <&aoss_qmp>;
		clock-names = "apb_pclk";

		atid = <66>;
		out-ports {
			port {
				tpdm_llm_silver_out_tpda_apss: endpoint {
					remote-endpoint =
					<&tpda_apss_in_tpdm_llm_silver>;
				};
			};
		};
	};

	tpdm_llm_cmb: tpdm@12860000 {
		compatible = "arm,primecell";
		arm,primecell-periphid = <0x000bb968>;
		reg = <0x12860000 0x1000>;
		reg-names = "tpdm-base";

		coresight-name = "coresight-tpdm-llm-cmb";

		clocks = <&aoss_qmp>;
		clock-names = "apb_pclk";

		atid = <66>;
		out-ports {
			port {
				tpdm_llm_cmb_out_tpda_apss: endpoint {
					remote-endpoint =
					<&tpda_apss_in_tpdm_llm_cmb>;
				};
			};
		};
	};

	tpdm_llm_dsb: tpdm@12861000 {
		compatible = "arm,primecell";
		arm,primecell-periphid = <0x000bb968>;
		reg = <0x12861000 0x1000>;
		reg-names = "tpdm-base";

		coresight-name = "coresight-tpdm-llm-dsb";

		clocks = <&aoss_qmp>;
		clock-names = "apb_pclk";

		atid = <66>;
		out-ports {
			port {
				tpdm_llm_dsb_out_tpda_apss: endpoint {
					remote-endpoint =
					<&tpda_apss_in_tpdm_llm_dsb>;
				};
			};
		};
	};

	tpda_apss: tpda@12863000 {
		compatible = "arm,primecell";
		arm,primecell-periphid = <0x000bb969>;

		reg = <0x12863000 0x1000>;
		reg-names = "tpda-base";

		qcom,tpda-atid = <66>;
		qcom,dsb-elem-size = <4 32>;

		qcom,cmb-elem-size = <0 32>,
				<3 64>;
		coresight-name = "coresight-tpda-apss";

		clocks = <&aoss_qmp>;
		clock-names = "apb_pclk";

		in-ports {

			#address-cells = <1>;
			#size-cells = <0>;

			port@0 {
				reg = <0>;
				tpda_apss_in_tpdm_llm_silver: endpoint {
					remote-endpoint =
					<&tpdm_llm_silver_out_tpda_apss>;
				};
			};

			port@3 {
				reg = <3>;
				tpda_apss_in_tpdm_llm_cmb: endpoint {
					remote-endpoint =
					<&tpdm_llm_cmb_out_tpda_apss>;
				};
			};

			port@4 {
				reg = <4>;
				tpda_apss_in_tpdm_llm_dsb: endpoint {
					remote-endpoint =
					<&tpdm_llm_dsb_out_tpda_apss>;
				};
			};


		};

		out-ports {

			port {
				tpda_apss_out_funnel_apss: endpoint {
					remote-endpoint =
					<&funnel_apss_in_tpda_apss>;
				};
			};
		};
	};

	funnel_apss: funnel@12810000 {
		compatible = "arm,primecell";
		arm,primecell-periphid = <0x000bb908>;

		reg = <0x12810000 0x1000>;
		reg-names = "funnel-base";

		coresight-name = "coresight-funnel-apss";

		clocks = <&aoss_qmp>;
		clock-names = "apb_pclk";

		in-ports {
			#address-cells = <1>;
			#size-cells = <0>;

			port@0 {
				reg = <0>;
				funnel_apss_in_funnel_etm: endpoint {
					remote-endpoint =
					<&funnel_etm_out_funnel_apss>;
				};
			};

			port@3 {
				reg = <3>;
				funnel_apss_in_tpda_apss: endpoint {
					remote-endpoint =
					<&tpda_apss_out_funnel_apss>;
				};
			};
		};

		out-ports {

			port {
				funnel_apss_out_funnel_in1: endpoint {
					remote-endpoint =
					<&funnel_in1_in_funnel_apss>;
				};
			};
		};
	};

	tpdm_sdcc5_1: tpdm@11420000 {
		compatible = "arm,primecell";
		arm,primecell-periphid = <0x000bb968>;
		reg = <0x11420000 0x1000>;
		reg-names = "tpdm-base";

		coresight-name = "coresight-tpdm-sdcc5-1";

		atid = <101>;
		clocks = <&aoss_qmp>;
		clock-names = "apb_pclk";
		status = "disabled";

		out-ports {
			port {
				tpdm_sdcc5_1_out_tpda_dlwest: endpoint {
					remote-endpoint =
					<&tpda_dlwest_in_tpdm_sdcc5_1>;
				};
			};
		};
	};

	tpdm_sdcc5_2: tpdm@11421000 {
		compatible = "arm,primecell";
		arm,primecell-periphid = <0x000bb968>;
		reg = <0x11421000 0x1000>;
		reg-names = "tpdm-base";

		atid = <101>;
		coresight-name = "coresight-tpdm-sdcc5-2";

		clocks = <&aoss_qmp>;
		clock-names = "apb_pclk";
		status = "disabled";

		out-ports {
			port {
				tpdm_sdcc5_2_out_tpda_dlwest: endpoint {
					remote-endpoint =
					<&tpda_dlwest_in_tpdm_sdcc5_2>;
				};
			};
		};
	};

	tpdm_tmess_dsb: tpdm@114c1000 {
		compatible = "arm,primecell";
		arm,primecell-periphid = <0x000bb968>;
		reg = <0x114c1000 0x1000>;
		reg-names = "tpdm-base";

		atid = <85>;
		coresight-name = "coresight-tpdm-tmess-dsb";

		clocks = <&aoss_qmp>;
		clock-names = "apb_pclk";

		out-ports {
			port {
				tpdm_tmess_dsb_out_tpda_tmess: endpoint {
					remote-endpoint =
					<&tpda_tmess_in_tpdm_tmess_dsb>;
				};
			};
		};
	};

	tpdm_tmess_dl: tpdm@114c2000 {
		compatible = "arm,primecell";
		arm,primecell-periphid = <0x000bb968>;
		reg = <0x114c2000 0x1000>;
		reg-names = "tpdm-base";

		atid = <85>;
		coresight-name = "coresight-tpdm-tmess-dl";

		clocks = <&aoss_qmp>;
		clock-names = "apb_pclk";

		out-ports {
			port {
				tpdm_tmess_dl_out_tpda_tmess: endpoint {
					remote-endpoint =
					<&tpda_tmess_in_tpdm_tmess_dl>;
				};
			};
		};
	};

	tpdm_tmess_irq: tpdm@114c0000 {
		compatible = "arm,primecell";
		arm,primecell-periphid = <0x000bb968>;
		reg = <0x114c0000 0x1000>;
		reg-names = "tpdm-base";

		atid = <85>;

		coresight-name = "coresight-tpdm-tmess-irq";

		clocks = <&aoss_qmp>;
		clock-names = "apb_pclk";

		out-ports {
			port {
				tpdm_tmess_irq_out_tpda_tmess: endpoint {
					remote-endpoint =
					<&tpda_tmess_in_tpdm_tmess_irq>;
				};
			};
		};
	};

	tpda_tmess: tpda@114c5000 {
		compatible = "arm,primecell";
		arm,primecell-periphid = <0x000bb969>;

		qcom,tpda-atid = <85>;
		qcom,dsb-elem-size = <4 64>;
		qcom,cmb-elem-size = <2 32>,
				     <3 32>,
				     <4 64>;
		reg = <0x114c5000 0x1000>;
		reg-names = "tpda-base";

		coresight-name = "coresight-tpda-tmess";

		clocks = <&aoss_qmp>;
		clock-names = "apb_pclk";

		in-ports {

			#address-cells = <1>;
			#size-cells = <0>;

			port@2 {
				reg = <2>;
				tpda_tmess_in_tpdm_tmess_irq: endpoint {
					remote-endpoint =
					<&tpdm_tmess_irq_out_tpda_tmess>;
				};
			};

			port@3 {
				reg = <3>;
				tpda_tmess_in_tpdm_tmess_dsb: endpoint {
					remote-endpoint =
					<&tpdm_tmess_dsb_out_tpda_tmess>;
				};
			};

			port@4 {
				reg = <4>;
				tpda_tmess_in_tpdm_tmess_dl: endpoint {
				remote-endpoint =
					<&tpdm_tmess_dl_out_tpda_tmess>;
				};
			};
		};

		out-ports {
			#address-cells = <1>;
			#size-cells = <0>;

			port@0 {
				reg = <0>;
				tpda_tmess_out_funnel_tmess: endpoint {
					remote-endpoint =
					<&funnel_tmess_in_tpda_tmess>;
				};
			};
		};
	};

	funnel_tmess: funnel@114c6000 {
		compatible = "arm,primecell";
		arm,primecell-periphid = <0x000bb908>;

		reg = <0x114c6000 0x1000>;
		reg-names = "funnel-base";

		coresight-name = "coresight-funnel-tmess";

		clocks = <&aoss_qmp>;
		clock-names = "apb_pclk";

		in-ports {
			#address-cells = <1>;
			#size-cells = <0>;

			port@0 {
				reg = <0>;
				funnel_tmess_in_tpda_tmess: endpoint {
					remote-endpoint =
					<&tpda_tmess_out_funnel_tmess>;
				};
			};

		};

		out-ports {
			port {
				funnel_tmess_out_funnel_in1: endpoint {
					remote-endpoint =
					<&funnel_in1_in_funnel_tmess>;
				};
			};
		};
	};

	audio_etm0 {
		compatible = "qcom,coresight-remote-etm";

		coresight-name = "coresight-audio-etm0";
		qcom,inst-id = <5>;
		atid = <40 41>;

		out-ports {
			port {
				audio_etm0_out_funnel_lpass_lpi0: endpoint {
					remote-endpoint =
					<&funnel_lpass_lpi0_in_audio_etm0>;
				};
			};
		};
	};

	lpass_stm: lpass_stm {
		compatible = "qcom,coresight-dummy";
		coresight-name = "coresight-lpass-stm";
		qcom,dummy-source;

		atid = <25>;

		out-ports {
			port {
				lpass_stm_out_funnel_lpass_lpi1: endpoint {
					remote-endpoint =
					<&funnel_lpass_lpi1_in_lpass_stm>;
				};
			};
		};
	};

	tpdm_lpass_lpi: tpdm@11346000 {
		compatible = "qcom,coresight-dummy";
		qcom,dummy-source;

		coresight-name = "coresight-tpdm-lpass-lpi";
		atid = <26>;

		out-ports {
			port {
				tpdm_lpass_lpi_out_funnel_lpass_lpi1: endpoint {
					remote-endpoint =
					<&funnel_lpass_lpi1_in_tpdm_lpass_lpi>;
				};
			};
		};
	};

	tpdm_lpass_rscc: tpdm@11352000 {
		compatible = "arm,primecell";
		arm,primecell-periphid = <0x000bb968>;
		reg = <0x11352000 0x1000>;
		reg-names = "tpdm-base";

		coresight-name = "coresight-tpdm-lpass-rscc";

		atid = <55>;
		clocks = <&aoss_qmp>;
		clock-names = "apb_pclk";
		status = "disabled";

		out-ports {
			port {
				tpdm_lpass_rscc_out_tpda_lpass_rscc: endpoint {
					remote-endpoint =
					<&tpda_lpass_rscc_in_tpdm_lpass_rscc>;
				};
			};
		};
	};

	tpdm_lpass_audio: tpdm@11354000 {
		compatible = "arm,primecell";
		arm,primecell-periphid = <0x000bb968>;
		reg = <0x11354000 0x1000>;
		reg-names = "tpdm-base";

		coresight-name = "coresight-tpdm-lpass-audio";

		atid = <56>;
		clocks = <&aoss_qmp>;
		clock-names = "apb_pclk";
		status = "disabled";

		out-ports {
			port {
				tpdm_lpass_audio_out_tpda_lpass_audio: endpoint {
					remote-endpoint =
					<&tpda_lpass_audio_in_tpdm_lpass_audio>;
				};
			};
		};
	};

	tpdm_lpass_crdl: tpdm@11044000 {
		compatible = "arm,primecell";
		arm,primecell-periphid = <0x000bb968>;
		reg = <0x11044000 0x1000>;
		reg-names = "tpdm-base";

		coresight-name = "coresight-tpdm-lpass-crdl";

		atid = <78>;
		clocks = <&aoss_qmp>;
		clock-names = "apb_pclk";
		status = "disabled";

		out-ports {
			port {
				tpdm_lpass_crdl_out_funnel_lpass_cx: endpoint {
					remote-endpoint =
					<&funnel_lpass_cx_in_tpdm_lpass_crdl>;
				};
			};
		};
	};

	funnel_lpass_cx: funnel@11046000 {
		compatible = "arm,coresight-static-funnel";
		coresight-name = "coresight-funnel-lpass_cx";

		in-ports {
			#address-cells = <1>;
			#size-cells = <0>;

			port@0 {
				reg = <0>;
				funnel_lpass_cx_in_tpdm_lpass_crdl: endpoint {
					remote-endpoint =
					<&tpdm_lpass_crdl_out_funnel_lpass_cx>;
				};
			};

		};

		out-ports {
			port {
				funnel_lpass_cx_out_tpda_dlct0: endpoint {
					remote-endpoint =
					<&tpda_dlct0_in_funnel_lpass_cx>;
				};
			};
		};
	};


	tpda_lpass_audio: tpda@11355000 {
		compatible = "arm,primecell";
		arm,primecell-periphid = <0x000bb969>;

		qcom,tpda-atid = <56>;
		qcom,dsb-elem-size = <0 32>;
		reg = <0x11355000 0x1000>;
		reg-names = "tpda-base";

		coresight-name = "coresight-tpda-lpass-audio";
		status = "disabled";
		clocks = <&aoss_qmp>;
		clock-names = "apb_pclk";

		in-ports {

			#address-cells = <1>;
			#size-cells = <0>;

			port@0 {
				reg = <0>;
				tpda_lpass_audio_in_tpdm_lpass_audio: endpoint {
					remote-endpoint =
					<&tpdm_lpass_audio_out_tpda_lpass_audio>;
				};
			};
		};

		out-ports {
			#address-cells = <1>;
			#size-cells = <0>;

			port@0 {
				reg = <0>;
				tpda_lpass_audio_out_funnel_lpass_lpi1: endpoint {
					remote-endpoint =
					<&funnel_lpass_lpi1_in_tpda_lpass_audio>;
				};
			};
		};
	};


	tpda_lpass_rscc: tpda@11353000 {
		compatible = "arm,primecell";
		arm,primecell-periphid = <0x000bb969>;

		qcom,tpda-atid = <55>;
		qcom,cmb-elem-size = <0 32>;
		reg = <0x11353000 0x1000>;
		reg-names = "tpda-base";
		status = "disabled";
		coresight-name = "coresight-tpda-lpass-rscc";

		clocks = <&aoss_qmp>;
		clock-names = "apb_pclk";

		in-ports {

			#address-cells = <1>;
			#size-cells = <0>;

			port@0 {
				reg = <0>;
				tpda_lpass_rscc_in_tpdm_lpass_rscc: endpoint {
					remote-endpoint =
					<&tpdm_lpass_rscc_out_tpda_lpass_rscc>;
				};
			};
		};

		out-ports {
			#address-cells = <1>;
			#size-cells = <0>;

			port@0 {
				reg = <0>;
				tpda_lpass_rscc_out_funnel_lpass_lpi1: endpoint {
					remote-endpoint =
					<&funnel_lpass_lpi1_in_tpda_lpass_rscc>;
				};
			};
		};
	};


	funnel_lpass_lpi_1: funnel@11350000 {
		compatible = "arm,coresight-static-funnel";
		coresight-name = "coresight-funnel-lpass_lpi_1";

		in-ports {
			#address-cells = <1>;
			#size-cells = <0>;

			port@0 {
				reg = <0>;
				funnel_lpass_lpi1_in_lpass_stm: endpoint {
					remote-endpoint =
					<&lpass_stm_out_funnel_lpass_lpi1>;
				};
			};

			port@1 {
				reg = <1>;
				funnel_lpass_lpi1_in_tpdm_lpass_lpi: endpoint {
					remote-endpoint =
					<&tpdm_lpass_lpi_out_funnel_lpass_lpi1>;
				};
			};

			port@4 {
				reg = <4>;
				funnel_lpass_lpi1_in_tpda_lpass_rscc: endpoint {
					remote-endpoint =
					<&tpda_lpass_rscc_out_funnel_lpass_lpi1>;
				};
			};

			port@5 {
				reg = <5>;
				funnel_lpass_lpi1_in_tpda_lpass_audio: endpoint {
					remote-endpoint =
					<&tpda_lpass_audio_out_funnel_lpass_lpi1>;
				};
			};

		};

		out-ports {
			port {
				funnel_lpass_lpi1_out_funnel_lpass_lpi0: endpoint {
					remote-endpoint =
					<&funnel_lpass_lpi0_in_funnel_lpass_lpi1>;
				};
			};
		};
	};

	funnel_lpass_lpi_0: funnel@11344000 {
		compatible = "arm,coresight-static-funnel";
		coresight-name = "coresight-funnel-lpass_lpi_0";

		in-ports {
			#address-cells = <1>;
			#size-cells = <0>;

			port@0 {
				reg = <0>;
				funnel_lpass_lpi0_in_audio_etm0: endpoint {
					remote-endpoint =
					<&audio_etm0_out_funnel_lpass_lpi0>;
				};
			};

			port@7 {
				reg = <7>;
				funnel_lpass_lpi0_in_funnel_lpass_lpi1: endpoint {
					remote-endpoint =
					<&funnel_lpass_lpi1_out_funnel_lpass_lpi0>;
				};
			};


		};

		out-ports {
			port {
				funnel_lpass_lpi0_out_funnel_aoss: endpoint {
					remote-endpoint =
					<&funnel_aoss_in_funnel_lpass_lpi0>;
				};
			};
		};
	};

	tpdm_qm: tpdm@111d0000 {
		compatible = "arm,primecell";
		arm,primecell-periphid = <0x000bb968>;
		reg = <0x111d0000 0x1000>;
		reg-names = "tpdm-base";

		status = "disabled";
		coresight-name = "coresight-tpdm-qm";

		clocks = <&aoss_qmp>;
		clock-names = "apb_pclk";

		atid = <78>;
		out-ports {
			port {
				tpdm_qm_out_tpda_dlct0: endpoint {
					remote-endpoint =
					<&tpda_dlct0_in_tpdm_qm>;
				};
			};
		};
	};

	tpdm_gcc: tpdm@1102c000 {
		compatible = "arm,primecell";
		arm,primecell-periphid = <0x000bb968>;
		reg = <0x1102c000 0x1000>;
		reg-names = "tpdm-base";

		coresight-name = "coresight-tpdm-gcc";

		clocks = <&aoss_qmp>;
		clock-names = "apb_pclk";

		atid = <78>;
		out-ports {
			port {
				tpdm_gcc_out_tpda_dlct0: endpoint {
					remote-endpoint =
					<&tpda_dlct0_in_tpdm_gcc>;
				};
			};
		};
	};

	tpdm_pcie: tpdm@11470000 {
		compatible = "arm,primecell";
		arm,primecell-periphid = <0x000bb968>;
		reg = <0x11470000 0x1000>;
		reg-names = "tpdm-base";

		coresight-name = "coresight-tpdm-pcie";

		clocks = <&aoss_qmp>;
		clock-names = "apb_pclk";
		status = "disabled";
		atid = <88>;
		out-ports {
			port {
				tpdm_pcie_out_tpda_pcie: endpoint {
					remote-endpoint =
					<&tpda_pcie_in_tpdm_pcie>;
				};
			};
		};
	};

	tpda_pcie: tpda@11471000 {
		compatible = "arm,primecell";
		arm,primecell-periphid = <0x000bb969>;

		qcom,tpda-atid = <88>;
		qcom,cmb-elem-size = <0 32>;
		reg = <0x11471000 0x1000>;
		reg-names = "tpda-base";

		coresight-name = "coresight-tpda-pcie";

		clocks = <&aoss_qmp>;
		clock-names = "apb_pclk";

		in-ports {

			#address-cells = <1>;
			#size-cells = <0>;

			port@0 {
				reg = <0>;
				tpda_pcie_in_tpdm_pcie: endpoint {
					remote-endpoint =
					<&tpdm_pcie_out_tpda_pcie>;
				};
			};
		};

		out-ports {
			#address-cells = <1>;
			#size-cells = <0>;

			port@0 {
				reg = <0>;
				tpda_pcie_out_funnel_in0: endpoint {
					remote-endpoint =
					<&funnel_in0_in_tpda_pcie>;
				};
			};
		};
	};

	tpdm_vsense: tpdm@11040000 {
		compatible = "arm,primecell";
		arm,primecell-periphid = <0x000bb968>;
		reg = <0x11040000 0x1000>;
		reg-names = "tpdm-base";

		status = "disabled";
		coresight-name = "coresight-tpdm-vsense";

		clocks = <&aoss_qmp>;
		clock-names = "apb_pclk";

		atid = <78>;
		out-ports {
			port {
				tpdm_vsense_out_tpda_dlct0: endpoint {
					remote-endpoint =
					<&tpda_dlct0_in_tpdm_vsense>;
				};
			};
		};
	};

	tpdm_ipa: tpdm@11422000 {
		compatible = "arm,primecell";
		arm,primecell-periphid = <0x000bb968>;
		reg = <0x11422000 0x1000>;
		reg-names = "tpdm-base";

		status = "disabled";
		coresight-name = "coresight-tpdm-ipa";

		clocks = <&aoss_qmp>;
		clock-names = "apb_pclk";

		atid = <78>;
		out-ports {
			port {
				tpdm_ipa_out_tpda_dlct0: endpoint {
					remote-endpoint =
					<&tpda_dlct0_in_tpdm_ipa>;
				};
			};
		};
	};

	tpdm_lpicc: tpdm@11330000 {
		compatible = "arm,primecell";
		arm,primecell-periphid = <0x000bb968>;
		reg = <0x11330000 0x1000>;
		reg-names = "tpdm-base";

		coresight-name = "coresight-tpdm-lpicc";
		status = "disabled";

		clocks = <&aoss_qmp>;
		clock-names = "apb_pclk";

		atid = <27>;
		out-ports {
			port {
				tpdm_lpicc_out_tpda_lpi: endpoint {
					remote-endpoint =
					<&tpda_lpi_in_tpdm_lpicc>;
				};
			};
		};
	};

	tpda_lpi: tpda@11332000 {
		compatible = "arm,primecell";
		arm,primecell-periphid = <0x000bb969>;

		qcom,tpda-atid = <27>;
		qcom,dsb-elem-size = <0 32>;
		reg = <0x11332000 0x1000>;
		reg-names = "tpda-base";
		status = "disabled";
		coresight-name = "coresight-tpda-lpi";

		clocks = <&aoss_qmp>;
		clock-names = "apb_pclk";

		in-ports {

			#address-cells = <1>;
			#size-cells = <0>;

			port@0 {
				reg = <0>;
				tpda_lpi_in_tpdm_lpicc: endpoint {
					remote-endpoint =
					<&tpdm_lpicc_out_tpda_lpi>;
				};
			};
		};

		out-ports {
			#address-cells = <1>;
			#size-cells = <0>;

			port@0 {
				reg = <0>;
				tpda_lpi_out_funnel_ddr_lpi: endpoint {
					remote-endpoint =
					<&funnel_ddr_lpi_in_tpda_lpi>;
				};
			};
		};
	};

	funnel_ddr_lpi: funnel@11333000 {
		compatible = "arm,primecell";
		arm,primecell-periphid = <0x000bb908>;

		reg = <0x11333000 0x1000>;
		reg-names = "funnel-base";

		coresight-name = "coresight-funnel-ddr_lpi";

		clocks = <&aoss_qmp>;
		clock-names = "apb_pclk";

		in-ports {
			#address-cells = <1>;
			#size-cells = <0>;

			port@0 {
				reg = <0>;
				funnel_ddr_lpi_in_tpda_lpi: endpoint {
					remote-endpoint =
					<&tpda_lpi_out_funnel_ddr_lpi>;
				};
			};
		};

		out-ports {
			#address-cells = <1>;
			#size-cells = <0>;

			port@0 {
				reg = <0>;
				funnel_ddr_lpi_out_funnel_aoss: endpoint {
					remote-endpoint =
					<&funnel_aoss_in_funnel_ddr_lpi>;
				};
			};
		};
	};

	tpdm_llcc0: tpdm@11540000 {
		compatible = "arm,primecell";
		arm,primecell-periphid = <0x000bb968>;
		reg = <0x11540000 0x1000>;
		reg-names = "tpdm-base";

		coresight-name = "coresight-tpdm-llcc0";
		status = "disabled";

		clocks = <&aoss_qmp>;
		clock-names = "apb_pclk";

		atid = <99>;
		out-ports {
			port {
				tpdm_llcc0_out_tpda_llcc: endpoint {
					remote-endpoint =
					<&tpda_llcc_in_tpdm_llcc0>;
				};
			};
		};
	};

	tpdm_llcc1: tpdm@11541000 {
		compatible = "arm,primecell";
		arm,primecell-periphid = <0x000bb968>;
		reg = <0x11541000 0x1000>;
		reg-names = "tpdm-base";

		coresight-name = "coresight-tpdm-llcc1";
		status = "disabled";

		clocks = <&aoss_qmp>;
		clock-names = "apb_pclk";

		atid = <99>;
		out-ports {
			port {
				tpdm_llcc1_out_tpda_llcc: endpoint {
					remote-endpoint =
					<&tpda_llcc_in_tpdm_llcc1>;
				};
			};
		};
	};

	tpda_llcc: tpda@11509000 {
		compatible = "arm,primecell";
		arm,primecell-periphid = <0x000bb969>;

		qcom,tpda-atid = <99>;
		qcom,cmb-elem-size = <0 32>,
				     <1 32>;
		reg = <0x11509000 0x1000>;
		reg-names = "tpda-base";

		coresight-name = "coresight-tpda-llcc";

		clocks = <&aoss_qmp>;
		clock-names = "apb_pclk";

		in-ports {

			#address-cells = <1>;
			#size-cells = <0>;

			port@0 {
				reg = <0>;
				tpda_llcc_in_tpdm_llcc0: endpoint {
					remote-endpoint =
					<&tpdm_llcc0_out_tpda_llcc>;
				};
			};

			port@1 {
				reg = <1>;
				tpda_llcc_in_tpdm_llcc1: endpoint {
					remote-endpoint =
					<&tpdm_llcc1_out_tpda_llcc>;
				};
			};

		};

		out-ports {
			#address-cells = <1>;
			#size-cells = <0>;

			port@0 {
				reg = <0>;
				tpda_llcc_out_funnel_ddr_dl1: endpoint {
					remote-endpoint =
					<&funnel_ddr_dl1_in_tpda_llcc>;
				};
			};
		};
	};

	tpdm_ddr0: tpdm@11500000 {
		compatible = "arm,primecell";
		arm,primecell-periphid = <0x000bb968>;
		reg = <0x11500000 0x1000>;
		reg-names = "tpdm-base";

		coresight-name = "coresight-tpdm-ddr0";
		status = "disabled";

		clocks = <&aoss_qmp>;
		clock-names = "apb_pclk";

		atid = <78>;
		out-ports {
			port {
				tpdm_ddr0_out_funnel_ddr_dl0: endpoint {
					remote-endpoint =
					<&funnel_ddr_dl0_in_tpdm_ddr0>;
				};
			};
		};
	};

	tpdm_ddr_ch02: tpdm@11520000 {
		compatible = "arm,primecell";
		arm,primecell-periphid = <0x000bb968>;
		reg = <0x11520000 0x1000>;
		reg-names = "tpdm-base";

		coresight-name = "coresight-tpdm-ddr-ch02";

		clocks = <&aoss_qmp>;
		clock-names = "apb_pclk";

		atid = <78>;
		out-ports {
			port {
				tpdm_ddr_ch02_out_funnel_ddr_ch02: endpoint {
					remote-endpoint =
					<&funnel_ddr_ch02_in_tpdm_ddr_ch02>;
				};
			};
		};
	};

	tpdm_ddr_dpm: tpdm@11501000 {
		compatible = "arm,primecell";
		arm,primecell-periphid = <0x000bb968>;
		reg = <0x11501000 0x1000>;
		reg-names = "tpdm-base";

		coresight-name = "coresight-tpdm-ddr-dpm";
		status = "disabled";
		clocks = <&aoss_qmp>;
		clock-names = "apb_pclk";

		atid = <78>;
		out-ports {
			port {
				tpdm_ddr_dpm_out_funnel_ddr_dl0: endpoint {
					remote-endpoint =
					<&funnel_ddr_dl0_in_tpdm_ddr_dpm>;
				};
			};
		};
	};

	funnel_ddr_ch02: funnel@11522000 {
		compatible = "arm,primecell";
		arm,primecell-periphid = <0x000bb908>;

		reg = <0x11522000 0x1000>;
		reg-names = "funnel-base";

		coresight-name = "coresight-funnel-ddr_ch02";

		clocks = <&aoss_qmp>;
		clock-names = "apb_pclk";

		in-ports {
			#address-cells = <1>;
			#size-cells = <0>;

			port@0 {
				reg = <0>;
				funnel_ddr_ch02_in_tpdm_ddr_ch02: endpoint {
					remote-endpoint =
					<&tpdm_ddr_ch02_out_funnel_ddr_ch02>;
				};
			};
		};

		out-ports {
			#address-cells = <1>;
			#size-cells = <0>;

			port@0 {
				reg = <0>;
				funnel_ddr_ch02_out_funnel_ddr_dl0: endpoint {
					remote-endpoint =
					<&funnel_ddr_dl0_in_funnel_ddr_ch02>;
				};
			};
		};
	};

	funnel_ddr_dl1: funnel@1150a000 {
		compatible = "arm,primecell";
		arm,primecell-periphid = <0x000bb908>;

		reg = <0x1150a000 0x1000>;
		reg-names = "funnel-base";

		coresight-name = "coresight-funnel-ddr_dl1";

		clocks = <&aoss_qmp>;
		clock-names = "apb_pclk";

		in-ports {

			#address-cells = <1>;
			#size-cells = <0>;

			port@0 {
				reg = <0>;
				funnel_ddr_dl1_in_tpda_llcc: endpoint {
					remote-endpoint =
					<&tpda_llcc_out_funnel_ddr_dl1>;
				};
			};
		};

		out-ports {
			#address-cells = <1>;
			#size-cells = <0>;

			port@0 {
				reg = <0>;
				funnel_ddr_dl1_out_funnel_ddr_dl0: endpoint {
					remote-endpoint =
					<&funnel_ddr_dl0_in_funnel_ddr_dl1>;
				};
			};


		};
	};


	funnel_ddr_dl0: funnel@11503000 {
		compatible = "arm,primecell";
		arm,primecell-periphid = <0x000bb908>;

		reg = <0x11503000 0x1000>;
		reg-names = "funnel-base";

		coresight-name = "coresight-funnel-ddr_dl0";

		clocks = <&aoss_qmp>;
		clock-names = "apb_pclk";

		in-ports {

			#address-cells = <1>;
			#size-cells = <0>;

			port@0 {
				reg = <0>;
				funnel_ddr_dl0_in_funnel_ddr_ch02: endpoint {
					remote-endpoint =
					<&funnel_ddr_ch02_out_funnel_ddr_dl0>;
				};
			};

			port@2 {
				reg = <2>;
				funnel_ddr_dl0_in_tpdm_ddr0: endpoint {
					remote-endpoint =
					<&tpdm_ddr0_out_funnel_ddr_dl0>;
				};
			};

			port@3 {
				reg = <3>;
				funnel_ddr_dl0_in_tpdm_ddr_dpm: endpoint {
					remote-endpoint =
					<&tpdm_ddr_dpm_out_funnel_ddr_dl0>;
				};
			};

			port@4 {
				reg = <4>;
				funnel_ddr_dl0_in_funnel_ddr_dl1: endpoint {
					remote-endpoint =
					<&funnel_ddr_dl1_out_funnel_ddr_dl0>;
				};
			};


		};

		out-ports {
			#address-cells = <1>;
			#size-cells = <0>;

			port@0 {
				reg = <0>;
				funnel_ddr_dl0_out_tpda_dlct0_4: endpoint {
					remote-endpoint =
					<&tpda_dlct0_4_in_funnel_ddr_dl0>;
					source = <&tpdm_ddr_ch02>;
				};
			};

			port@1 {
				reg = <1>;
				funnel_ddr_dl0_out_tpda_dlct0_6: endpoint {
					remote-endpoint =
					<&tpda_dlct0_6_in_funnel_ddr_dl0>;
					source = <&tpdm_ddr0>;
				};
			};

			port@2 {
				reg = <2>;
				funnel_ddr_dl0_out_tpda_dlct0_7: endpoint {
					remote-endpoint =
					<&tpda_dlct0_7_in_funnel_ddr_dl0>;
					source = <&tpdm_ddr_dpm>;
				};
			};

			port@3 {
				reg = <3>;
				funnel_ddr_dl0_out_funnel_dlct0: endpoint {
					remote-endpoint =
					<&funnel_dlct0_in_funnel_ddr_dl0>;
					source = <&tpda_llcc>;
				};
			};



		};
	};

	tpdm_soccp: tpdm@11380000 {
		compatible = "arm,primecell";
		arm,primecell-periphid = <0x000bb968>;
		reg = <0x11380000 0x1000>;
		reg-names = "tpdm-base";

		coresight-name = "coresight-tpdm-soccp";

		atid = <78>;
		clocks = <&aoss_qmp>;
		clock-names = "apb_pclk";
		status = "disabled";

		out-ports {
			port {
				tpdm_soccp_out_funnel_soccp: endpoint {
					remote-endpoint =
					<&funnel_soccp_in_tpdm_soccp>;
				};
			};
		};
	};

	funnel_soccp: funnel@11382000 {
		compatible = "arm,primecell";
		arm,primecell-periphid = <0x000bb908>;
		reg = <0x11382000 0x1000>;
		reg-names = "funnel-base";

		coresight-name = "coresight-funnel-soccp";

		clocks = <&aoss_qmp>;
		clock-names = "apb_pclk";

		in-ports {
			#address-cells = <1>;
			#size-cells = <0>;

			port@0 {
				reg = <0>;
				funnel_soccp_in_tpdm_soccp: endpoint {
					remote-endpoint =
					<&tpdm_soccp_out_funnel_soccp>;
				};
			};

		};

		out-ports {
			port {
				funnel_soccp_out_tpda_dlct1: endpoint {
					remote-endpoint =
					<&tpda_dlct1_in_funnel_soccp>;
				};
			};
		};

	};

	tpdm_gpu: tpdm@11100000 {
		compatible = "arm,primecell";
		arm,primecell-periphid = <0x000bb968>;
		reg = <0x11100000 0x1000>;
		reg-names = "tpdm-base";

		status = "disabled";
		coresight-name = "coresight-tpdm-gpu";
		atid = <78>;
		clocks = <&aoss_qmp>;
		clock-names = "apb_pclk";

		out-ports {
			port {
				tpdm_gpu_out_funnel_gpu_dl: endpoint {
					remote-endpoint =
					<&funnel_gpu_dl_in_tpdm_gpu>;
				};
			};
		};
	};

	funnel_gpu_dl: funnel@11102000 {
		compatible = "arm,primecell";
		arm,primecell-periphid = <0x000bb908>;

		reg = <0x11102000 0x1000>;
		reg-names = "funnel-base";

		coresight-name = "coresight-funnel-gpu_dl";

		clocks = <&aoss_qmp>;
		clock-names = "apb_pclk";

		in-ports {
			#address-cells = <1>;
			#size-cells = <0>;

			port@0 {
				reg = <0>;
				funnel_gpu_dl_in_tpdm_gpu: endpoint {
					remote-endpoint =
					<&tpdm_gpu_out_funnel_gpu_dl>;
				};
			};
		};

		out-ports {
			#address-cells = <1>;
			#size-cells = <0>;
			port@0 {
				reg = <0>;
				funnel_gpu_dl_out_tpda_dlct0: endpoint {
					remote-endpoint =
					<&tpda_dlct0_in_funnel_gpu_dl>;
				};
			};
		};
	};

	tpdm_dlct0_dsb: tpdm@11428000 {
		compatible = "arm,primecell";
		arm,primecell-periphid = <0x000bb968>;
		reg = <0x11428000 0x1000>;
		reg-names = "tpdm-base";

		coresight-name = "coresight-tpdm-dlct0-dsb";
		atid = <78>;
		clocks = <&aoss_qmp>;
		clock-names = "apb_pclk";

		out-ports {
			port {
				tpdm_dlct0_dsb_out_tpda_dlct0: endpoint {
					remote-endpoint =
					<&tpda_dlct0_in_tpdm_dlct0_dsb>;
				};
			};
		};
	};

	tpdm_ipcc: tpdm@11429000 {
		compatible = "arm,primecell";
		arm,primecell-periphid = <0x000bb968>;
		reg = <0x11429000 0x1000>;
		reg-names = "tpdm-base";

		coresight-name = "coresight-tpdm-ipcc";
		atid = <78>;
		clocks = <&aoss_qmp>;
		clock-names = "apb_pclk";

		out-ports {
			port {
				tpdm_ipcc_out_tpda_dlct0: endpoint {
					remote-endpoint =
					<&tpda_dlct0_in_tpdm_ipcc>;
				};
			};
		};
	};

	tpda_dlct0: tpda@1142c000 {
		compatible = "arm,primecell";
		arm,primecell-periphid = <0x000bb969>;

		qcom,tpda-atid = <78>;

		qcom,dsb-elem-size = <0 32>,
				<4 32>,
				<6 32>,
				<19 32>,
				<22 32>,
				<23 32>,
				<26 32>,
				<29 32>;

		qcom,cmb-elem-size = <6 32>,
				<7 64>,
				<13 64>,
				<15 64>,
				<24 32>,
				<30 64>;

		reg = <0x1142c000 0x1000>;
		reg-names = "tpda-base";

		coresight-name = "coresight-tpda-dl-center0";

		clocks = <&aoss_qmp>;
		clock-names = "apb_pclk";

		in-ports {

			#address-cells = <1>;
			#size-cells = <0>;

			port@0 {
				reg = <0>;
				tpda_dlct0_in_funnel_lpass_cx: endpoint {
					remote-endpoint =
					<&funnel_lpass_cx_out_tpda_dlct0>;
				};
			};

			port@4 {
				reg = <4>;
				tpda_dlct0_4_in_funnel_ddr_dl0: endpoint {
					remote-endpoint =
					<&funnel_ddr_dl0_out_tpda_dlct0_4>;
				};
			};

			port@6 {
				reg = <6>;
				tpda_dlct0_6_in_funnel_ddr_dl0: endpoint {
					remote-endpoint =
					<&funnel_ddr_dl0_out_tpda_dlct0_6>;
				};
			};

			port@7 {
				reg = <7>;
				tpda_dlct0_7_in_funnel_ddr_dl0: endpoint {
					remote-endpoint =
					<&funnel_ddr_dl0_out_tpda_dlct0_7>;
				};
			};

			port@d {
				reg = <13>;
				tpda_dlct0_13_in_funnel_dlct2: endpoint {
					remote-endpoint =
					<&funnel_dlct2_out_tpda_dlct0_13>;
				};
			};

			port@e {
				reg = <14>;
				tpda_dlct0_14_in_funnel_dlct2: endpoint {
					remote-endpoint =
					<&funnel_dlct2_out_tpda_dlct0_14>;
				};
			};

			port@f {
				reg = <15>;
				tpda_dlct0_15_in_funnel_dlct2: endpoint {
					remote-endpoint =
					<&funnel_dlct2_out_tpda_dlct0_15>;
				};
			};

			port@13 {
				reg = <19>;
				tpda_dlct0_in_funnel_gpu_dl: endpoint {
					remote-endpoint =
					<&funnel_gpu_dl_out_tpda_dlct0>;
				};
			};

			port@16 {
				reg = <22>;
				tpda_dlct0_in_tpdm_qm: endpoint {
					remote-endpoint =
					<&tpdm_qm_out_tpda_dlct0>;
				};
			};

			port@17 {
				reg = <23>;
				tpda_dlct0_in_tpdm_gcc: endpoint {
					remote-endpoint =
					<&tpdm_gcc_out_tpda_dlct0>;
				};
			};

			port@18 {
				reg = <24>;
				tpda_dlct0_in_tpdm_vsense: endpoint {
					remote-endpoint =
					<&tpdm_vsense_out_tpda_dlct0>;
				};
			};

			port@1a {
				reg = <26>;
				tpda_dlct0_in_tpdm_ipa: endpoint {
					remote-endpoint =
					<&tpdm_ipa_out_tpda_dlct0>;
				};
			};

			port@1d {
				reg = <29>;
				tpda_dlct0_in_tpdm_dlct0_dsb: endpoint {
					remote-endpoint =
					<&tpdm_dlct0_dsb_out_tpda_dlct0>;
				};
			};

			port@1e {
				reg = <30>;
				tpda_dlct0_in_tpdm_ipcc: endpoint {
					remote-endpoint =
					<&tpdm_ipcc_out_tpda_dlct0>;
				};
			};



		};

		out-ports {
			#address-cells = <1>;
			#size-cells = <0>;

			port@0 {
				reg = <0>;
				tpda_dlct0_out_funnel_dlct0: endpoint {
					remote-endpoint =
					<&funnel_dlct0_in_tpda_dlct0>;
				};
			};
		};
	};

	funnel_dlct0: funnel@1142d000 {
		compatible = "arm,primecell";
		arm,primecell-periphid = <0x000bb908>;
		reg = <0x1142d000 0x1000>;
		reg-names = "funnel-base";

		coresight-name = "coresight-funnel-dlct0";

		clocks = <&aoss_qmp>;
		clock-names = "apb_pclk";

		in-ports {
			#address-cells = <1>;
			#size-cells = <0>;

			port@0 {
				reg = <0>;
				funnel_dlct0_in_tpda_dlct0: endpoint {
					remote-endpoint =
					<&tpda_dlct0_out_funnel_dlct0>;
				};
			};

			port@2 {
				reg = <2>;
				funnel_dlct0_in_funnel_ddr_dl0: endpoint {
					remote-endpoint =
					<&funnel_ddr_dl0_out_funnel_dlct0>;
				};
			};

			port@4 {
				reg = <4>;
				funnel_dlct0_in_funnel_turing: endpoint {
					remote-endpoint =
					<&funnel_turing_out_funnel_dlct0>;
				};
			};


		};

		out-ports {
			port {
				funnel_dlct0_out_funnel_in1: endpoint {
					remote-endpoint =
					<&funnel_in1_in_funnel_dlct0>;
				};
			};
		};

	};

	tpdm_turing: tpdm@11180000 {
		compatible = "arm,primecell";
		arm,primecell-periphid = <0x000bb968>;
		reg = <0x11180000 0x1000>;
		reg-names = "tpdm-base";

		coresight-name = "coresight-tpdm-turing";

		clocks = <&aoss_qmp>;
		clock-names = "apb_pclk";
		atid = <87>;

		out-ports {
			port {
				tpdm_turing_out_tpda_turing: endpoint {
					remote-endpoint =
					<&tpda_turing_in_tpdm_turing>;
				};
			};
		};
	};

	tpdm_turing_llm: tpdm@11181000 {
		compatible = "qcom,coresight-dummy";
		coresight-name = "coresight-tpdm-turing-llm";
		qcom,dummy-source;

		atid = <87>;

		out-ports {
			port {
				tpdm_turing_llm_out_tpda_turing: endpoint {
					remote-endpoint =
					<&tpda_turing_in_tpdm_turing_llm>;
				};
			};
		};
	};

	tpdm_turing_llm2: tpdm@11182000 {
		compatible = "qcom,coresight-dummy";
		coresight-name = "coresight-tpdm-turing-llm2";
		qcom,dummy-source;

		atid = <87>;

		out-ports {
			port {
				tpdm_turing_llm2_out_tpda_turing: endpoint {
					remote-endpoint =
					<&tpda_turing_in_tpdm_turing_llm2>;
				};
			};
		};
	};


	tpdm_turing_cmsr: tpdm@11183000 {
		compatible = "qcom,coresight-dummy";
		coresight-name = "coresight-tpdm-turing-cmsr";
		qcom,dummy-source;

		atid = <87>;

		out-ports {
			port {
				tpdm_turing_cmsr_out_tpda_turing: endpoint {
					remote-endpoint =
					<&tpda_turing_in_tpdm_turing_cmsr>;
				};
			};
		};
	};

	tpdm_turing_cmsr_q6: tpdm@11184000 {
		compatible = "qcom,coresight-dummy";
		coresight-name = "coresight-tpdm-turing-cmsr-q6";
		qcom,dummy-source;

		atid = <87>;

		out-ports {
			port {
				tpdm_turing_cmsr_q6_out_tpda_turing: endpoint {
					remote-endpoint =
					<&tpda_turing_in_tpdm_turing_cmsr_q6>;
				};
			};
		};
	};

	tpdm_dpm1: tpdm@11185000 {
		compatible = "arm,primecell";
		arm,primecell-periphid = <0x000bb968>;
		reg = <0x11185000 0x1000>;
		reg-names = "tpdm-base";

		coresight-name = "coresight-tpdm-dpm1";
		status = "disabled";
		clocks = <&aoss_qmp>;
		clock-names = "apb_pclk";
		atid = <87>;

		out-ports {
			port {
				tpdm_dpm1_out_tpda_turing: endpoint {
					remote-endpoint =
					<&tpda_turing_in_tpdm_dpm1>;
				};
			};
		};
	};

	tpdm_dpm2: tpdm@11186000 {
		compatible = "arm,primecell";
		arm,primecell-periphid = <0x000bb968>;
		reg = <0x11186000 0x1000>;
		reg-names = "tpdm-base";

		coresight-name = "coresight-tpdm-dpm2";
		status = "disabled";
		clocks = <&aoss_qmp>;
		clock-names = "apb_pclk";

		atid = <87>;
		out-ports {
			port {
				tpdm_dpm2_out_tpda_turing: endpoint {
					remote-endpoint =
					<&tpda_turing_in_tpdm_dpm2>;
				};
			};
		};
	};

	tpda_turing: tpda@11188000 {
		compatible = "arm,primecell";
		arm,primecell-periphid = <0x000bb969>;

		reg = <0x11188000 0x1000>;
		reg-names = "tpda-base";

		qcom,tpda-atid = <87>;
		qcom,dsb-elem-size = <0 32>;
		qcom,cmb-elem-size = <1 32>,
					<2 32>,
					<3 32>,
					<4 32>,
					<5 64>,
					<6 64>;
		coresight-name = "coresight-tpda-turing";

		clocks = <&aoss_qmp>;
		clock-names = "apb_pclk";

		in-ports {

			#address-cells = <1>;
			#size-cells = <0>;

			port@0 {
				reg = <0>;
				tpda_turing_in_tpdm_turing: endpoint {
					remote-endpoint =
					<&tpdm_turing_out_tpda_turing>;
				};
			};

			port@1 {
				reg = <1>;
				tpda_turing_in_tpdm_turing_llm: endpoint {
					remote-endpoint =
					<&tpdm_turing_llm_out_tpda_turing>;
				};
			};

			port@2 {
				reg = <2>;
				tpda_turing_in_tpdm_turing_llm2: endpoint {
					remote-endpoint =
					<&tpdm_turing_llm2_out_tpda_turing>;
				};
			};

			port@3 {
				reg = <3>;
				tpda_turing_in_tpdm_turing_cmsr: endpoint {
					remote-endpoint =
					<&tpdm_turing_cmsr_out_tpda_turing>;
				};
			};

			port@4 {
				reg = <4>;
				tpda_turing_in_tpdm_turing_cmsr_q6: endpoint {
					remote-endpoint =
					<&tpdm_turing_cmsr_q6_out_tpda_turing>;
				};
			};

			port@5 {
				reg = <5>;
				tpda_turing_in_tpdm_dpm1: endpoint {
					remote-endpoint =
					<&tpdm_dpm1_out_tpda_turing>;
				};
			};

			port@6 {
				reg = <6>;
				tpda_turing_in_tpdm_dpm2: endpoint {
					remote-endpoint =
					<&tpdm_dpm2_out_tpda_turing>;
				};
			};
		};

		out-ports {
			#address-cells = <1>;
			#size-cells = <0>;

			port@0 {
				reg = <0>;
				tpda_turing_out_funnel_turing: endpoint {
					remote-endpoint =
					<&funnel_turing_in_tpda_turing>;
				};
			};
		};
	};

	turing_etm0: turing_etm0 {
		compatible = "qcom,coresight-remote-etm";

		coresight-name = "coresight-turing-etm0";
		qcom,inst-id = <13>;

		atid = <38 39>;

		out-ports {
			port {
				turing_etm0_out_funnel_turing_dup: endpoint {
					remote-endpoint =
						<&funnel_turing_dup_in_turing_etm0>;
				};
			};
		};
	};

	funnel_turing_dup: funnel@1098a000 {
		compatible = "arm,primecell";
		arm,primecell-periphid = <0x000bb908>;

		reg = <0x1098a000 0x1000>,
			<0x11189000 0x1000>;
		reg-names = "funnel-base-dummy", "funnel-base-real";

		coresight-name = "coresight-funnel-turing_dup";

		qcom,duplicate-funnel;
		clocks = <&aoss_qmp>;
		clock-names = "apb_pclk";

		in-ports {
			#address-cells = <1>;
			#size-cells = <0>;
			port@3 {
				reg = <3>;
				funnel_turing_dup_in_turing_etm0: endpoint {
					remote-endpoint =
					<&turing_etm0_out_funnel_turing_dup>;
				};
			};
		};

		out-ports {
			port {
				funnel_turing_dup_out_funnel_turing: endpoint {
					remote-endpoint =
					<&funnel_turing_in_funnel_turing_dup>;
				};
			};
		};
	};

	funnel_turing: funnel@11189000 {
		compatible = "arm,primecell";
		arm,primecell-periphid = <0x000bb908>;

		reg = <0x11189000 0x1000>;
		reg-names = "funnel-base";

		coresight-name = "coresight-funnel-turing";

		clocks = <&aoss_qmp>;
		clock-names = "apb_pclk";

		in-ports {
			#address-cells = <1>;
			#size-cells = <0>;

			port@0 {
				reg = <0>;
				funnel_turing_in_tpda_turing: endpoint {
					remote-endpoint =
					<&tpda_turing_out_funnel_turing>;
				};
			};

			port@4 {
				reg = <4>;
				funnel_turing_in_funnel_turing_dup: endpoint {
					remote-endpoint =
					<&funnel_turing_dup_out_funnel_turing>;
				};
			};
		};

		out-ports {
			#address-cells = <1>;
			#size-cells = <0>;

			port@0 {
				reg = <0>;
				funnel_turing_out_funnel_dlct0: endpoint {
					remote-endpoint =
					<&funnel_dlct0_in_funnel_turing>;
				};
			};
		};
	};

	tpdm_mxc: tpdm@111c1000 {
		compatible = "arm,primecell";
		arm,primecell-periphid = <0x000bb968>;
		reg = <0x111c1000 0x1000>;
		reg-names = "tpdm-base";

		status = "disabled";
		coresight-name = "coresight-tpdm-mxc";
		atid = <79>;
		clocks = <&aoss_qmp>;
		clock-names = "apb_pclk";

		out-ports {
			port {
				tpdm_mxc_out_funnel_dlct2: endpoint {
					remote-endpoint =
					<&funnel_dlct2_in_tpdm_mxc>;
				};
			};
		};
	};

	tpdm_cx: tpdm@111c0000 {
		compatible = "arm,primecell";
		arm,primecell-periphid = <0x000bb968>;
		reg = <0x111c0000 0x1000>;
		reg-names = "tpdm-base";

		status = "disabled";
		coresight-name = "coresight-tpdm-cx";
		atid = <79>;
		clocks = <&aoss_qmp>;
		clock-names = "apb_pclk";

		out-ports {
			port {
				tpdm_cx_out_funnel_dlct2: endpoint {
					remote-endpoint =
					<&funnel_dlct2_in_tpdm_cx>;
				};
			};
		};
	};

	tpdm_mxa: tpdm@111c2000 {
		compatible = "arm,primecell";
		arm,primecell-periphid = <0x000bb968>;
		reg = <0x111c2000 0x1000>;
		reg-names = "tpdm-base";

		status = "disabled";
		coresight-name = "coresight-tpdm-mxa";
		atid = <79>;
		clocks = <&aoss_qmp>;
		clock-names = "apb_pclk";

		out-ports {
			port {
				tpdm_mxa_out_funnel_dlct2: endpoint {
					remote-endpoint =
					<&funnel_dlct2_in_tpdm_mxa>;
				};
			};
		};
	};

	funnel_dlct2: funnel@111c3000 {
		compatible = "arm,primecell";
		arm,primecell-periphid = <0x000bb908>;
		reg = <0x111c3000 0x1000>;
		reg-names = "funnel-base";

		coresight-name = "coresight-funnel-dlct2";

		clocks = <&aoss_qmp>;
		clock-names = "apb_pclk";

		in-ports {
			#address-cells = <1>;
			#size-cells = <0>;

			port@2 {
				reg = <2>;
				funnel_dlct2_in_tpdm_mxc: endpoint {
					remote-endpoint =
					<&tpdm_mxc_out_funnel_dlct2>;
				};
			};

			port@3 {
				reg = <3>;
				funnel_dlct2_in_tpdm_cx: endpoint {
					remote-endpoint =
					<&tpdm_cx_out_funnel_dlct2>;
				};
			};

			port@4 {
				reg = <4>;
				funnel_dlct2_in_tpdm_mxa: endpoint {
					remote-endpoint =
					<&tpdm_mxa_out_funnel_dlct2>;
				};
			};
		};

		out-ports {
			#address-cells = <1>;
			#size-cells = <0>;

			port@0 {
				funnel_dlct2_out_tpda_dlct0_14: endpoint {
					remote-endpoint =
					<&tpda_dlct0_14_in_funnel_dlct2>;
					source = <&tpdm_mxc>;
				};
			};

			port@1 {
				funnel_dlct2_out_tpda_dlct0_13: endpoint {
					remote-endpoint =
					<&tpda_dlct0_13_in_funnel_dlct2>;
					source = <&tpdm_cx>;
				};
			};

			port@2 {
				funnel_dlct2_out_tpda_dlct0_15: endpoint {
					remote-endpoint =
					<&tpda_dlct0_15_in_funnel_dlct2>;
					source = <&tpdm_mxa>;
				};
			};


		};

	};

	tpdm_dlct1_2: tpdm@112c2000 {
		compatible = "arm,primecell";
		arm,primecell-periphid = <0x000bb968>;
		reg = <0x112c2000 0x1000>;
		reg-names = "tpdm-base";

		coresight-name = "coresight-tpdm-dlct1_2";
		atid = <78>;
		clocks = <&aoss_qmp>;
		clock-names = "apb_pclk";

		out-ports {
			port {
				tpdm_dlct1_2_out_tpda_dlct1: endpoint {
					remote-endpoint =
					<&tpda_dlct1_in_tpdm_dlct1_2>;
				};
			};
		};
	};

	tpdm_dlct1_0: tpdm@112c0000 {
		compatible = "arm,primecell";
		arm,primecell-periphid = <0x000bb968>;
		reg = <0x112c0000 0x1000>;
		reg-names = "tpdm-base";

		coresight-name = "coresight-tpdm-dlct1_0";
		atid = <78>;
		clocks = <&aoss_qmp>;
		clock-names = "apb_pclk";

		out-ports {
			port {
				tpdm_dlct1_0_out_tpda_dlct1: endpoint {
					remote-endpoint =
					<&tpda_dlct1_in_tpdm_dlct1_0>;
				};
			};
		};
	};

	tpdm_dlct1_1: tpdm@112c1000 {
		compatible = "arm,primecell";
		arm,primecell-periphid = <0x000bb968>;
		reg = <0x112c1000 0x1000>;
		reg-names = "tpdm-base";

		coresight-name = "coresight-tpdm-dlct1_1";
		atid = <78>;
		clocks = <&aoss_qmp>;
		clock-names = "apb_pclk";

		out-ports {
			port {
				tpdm_dlct1_1_out_tpda_dlct1: endpoint {
					remote-endpoint =
					<&tpda_dlct1_in_tpdm_dlct1_1>;
				};
			};
		};
	};


	tpda_dlct1: tpda@112c4000 {
		compatible = "arm,primecell";
		arm,primecell-periphid = <0x000bb969>;
		reg = <0x112c4000 0x1000>;
		reg-names = "tpda-base";

		coresight-name = "coresight-tpda-dlct1";

		qcom,cmb-elem-size = <26 64>,
					<27 32>;
		qcom,dsb-elem-size = <0 32>,
					<5 32>,
					<25 32>;

		clocks = <&aoss_qmp>;
		clock-names = "apb_pclk";

		qcom,tpda-atid = <78>;
		in-ports {
			#address-cells = <1>;
			#size-cells = <0>;

			port@0 {
				reg = <0>;
				tpda_dlct1_in_funnel_soccp:endpoint {
					remote-endpoint =
					<&funnel_soccp_out_tpda_dlct1>;
				};
			};

			port@5 {
				reg = <5>;
				tpda_dlct1_in_funnel_wpss:endpoint {
					remote-endpoint =
					<&funnel_wpss_out_tpda_dlct1>;
				};
			};

			port@19 {
				reg = <25>;
				tpda_dlct1_in_tpdm_dlct1_0:endpoint {
					remote-endpoint =
					<&tpdm_dlct1_0_out_tpda_dlct1>;
				};
			};

			port@1a {
				reg = <26>;
				tpda_dlct1_in_tpdm_dlct1_1:endpoint {
					remote-endpoint =
					<&tpdm_dlct1_1_out_tpda_dlct1>;
				};
			};

			port@1b {
				reg = <27>;
				tpda_dlct1_in_tpdm_dlct1_2:endpoint {
					remote-endpoint =
					<&tpdm_dlct1_2_out_tpda_dlct1>;
				};
			};


		};

		out-ports {
			port {
				tpda_dlct1_out_funnel_dlct1: endpoint {
					remote-endpoint =
					<&funnel_dlct1_in_tpda_dlct1>;
				};

			};
		};
	};

	funnel_dlct1: funnel@112c5000 {
		compatible = "arm,primecell";
		arm,primecell-periphid = <0x000bb908>;
		reg = <0x112c5000 0x1000>;
		reg-names = "funnel-base";

		coresight-name = "coresight-funnel-dlct1";

		clocks = <&aoss_qmp>;
		clock-names = "apb_pclk";

		in-ports {
			#address-cells = <1>;
			#size-cells = <0>;

			port@0 {
				reg = <0>;
				funnel_dlct1_in_tpda_dlct1: endpoint {
					remote-endpoint =
					<&tpda_dlct1_out_funnel_dlct1>;
				};
			};

			port@4 {
				reg = <4>;
				funnel_dlct1_in_funnel_wpss: endpoint {
					remote-endpoint =
					<&funnel_wpss_out_funnel_dlct1>;
				};
			};

		};

		out-ports {
			port {
				funnel_dlct1_out_funnel_in1: endpoint {
					remote-endpoint =
					<&funnel_in1_in_funnel_dlct1>;
				};
			};
		};

	};

	tpdm_dlwest_dsb: tpdm@11438000 {
		compatible = "arm,primecell";
		arm,primecell-periphid = <0x000bb968>;
		reg = <0x11438000 0x1000>;
		reg-names = "tpdm-base";

		coresight-name = "coresight-tpdm-dlwest-dsb";

		atid = <101>;
		clocks = <&aoss_qmp>;
		clock-names = "apb_pclk";
		status = "disabled";

		out-ports {
			port {
				tpdm_dlwest_dsb_out_tpda_dlwest: endpoint {
					remote-endpoint =
					<&tpda_dlwest_in_tpdm_dlwest_dsb>;
				};
			};
		};
	};

	tpda_dlwest: tpda@11439000 {
		compatible = "arm,primecell";
		arm,primecell-periphid = <0x000bb969>;
		reg = <0x11439000 0x1000>;
		reg-names = "tpda-base";

		coresight-name = "coresight-tpda-dlwest";

		qcom,cmb-elem-size = <1 32>,
					<2 32>;
		qcom,dsb-elem-size = <3 32>;
		qcom,tpda-atid = <101>;
		clocks = <&aoss_qmp>;
		clock-names = "apb_pclk";

		in-ports {
			#address-cells = <1>;
			#size-cells = <0>;

			port@1 {
				reg = <1>;
				tpda_dlwest_in_tpdm_sdcc5_1:endpoint {
					remote-endpoint =
					<&tpdm_sdcc5_1_out_tpda_dlwest>;
				};
			};

			port@2 {
				reg = <2>;
				tpda_dlwest_in_tpdm_sdcc5_2:endpoint {
					remote-endpoint =
					<&tpdm_sdcc5_2_out_tpda_dlwest>;
				};
			};

			port@3 {
				reg = <3>;
				tpda_dlwest_in_tpdm_dlwest_dsb:endpoint {
					remote-endpoint =
					<&tpdm_dlwest_dsb_out_tpda_dlwest>;
				};
			};


		};

		out-ports {
			port {
				tpda_dlwest_out_funnel_dlwest: endpoint {
					remote-endpoint =
					<&funnel_dlwest_in_tpda_dlwest>;
				};

			};
		};
	};

	funnel_dlwest: funnel@1143a000 {
		compatible = "arm,primecell";
		arm,primecell-periphid = <0x000bb908>;
		reg = <0x1143a000 0x1000>;
		reg-names = "funnel-base";

		coresight-name = "coresight-funnel-dlwest";

		clocks = <&aoss_qmp>;
		clock-names = "apb_pclk";

		in-ports {
			#address-cells = <1>;
			#size-cells = <0>;

			port@0 {
				reg = <0>;
				funnel_dlwest_in_tpda_dlwest: endpoint {
					remote-endpoint =
					<&tpda_dlwest_out_funnel_dlwest>;
				};
			};

		};

		out-ports {
			port {
				funnel_dlwest_out_funnel_in1: endpoint {
					remote-endpoint =
					<&funnel_in1_in_funnel_dlwest>;
				};
			};
		};

	};

	tpdm_mdss: tpdm@11460000 {
		compatible = "arm,primecell";
		arm,primecell-periphid = <0x000bb968>;
		reg = <0x11460000 0x1000>;
		reg-names = "tpdm-base";

		coresight-name = "coresight-tpdm-mdss";

		status = "disabled";
		clocks = <&aoss_qmp>;
		clock-names = "apb_pclk";

		atid = <81>;
		out-ports {
			port {
				tpdm_mdss_out_funnel_mdss: endpoint {
					remote-endpoint =
					<&funnel_mdss_in_tpdm_mdss>;
				};
			};
		};
	};

	funnel_mdss: funnel@11462000 {
		compatible = "arm,primecell";
		arm,primecell-periphid = <0x000bb908>;
		reg = <0x11462000 0x1000>;
		reg-names = "funnel-base";

		coresight-name = "coresight-funnel-mdss";

		clocks = <&aoss_qmp>;
		clock-names = "apb_pclk";

		in-ports {
			#address-cells = <1>;
			#size-cells = <0>;

			port@0 {
				reg = <0>;
				funnel_mdss_in_tpdm_mdss: endpoint {
					remote-endpoint =
					<&tpdm_mdss_out_funnel_mdss>;
				};
			};

		};

		out-ports {
			port {
				funnel_mdss_out_tpda_dlmm: endpoint {
					remote-endpoint =
					<&tpda_dlmm_in_funnel_mdss>;
				};
			};
		};

	};

	tpdm_video: tpdm@11030000 {
		compatible = "arm,primecell";
		arm,primecell-periphid = <0x000bb968>;
		reg = <0x11030000 0x1000>;
		reg-names = "tpdm-base";

		coresight-name = "coresight-tpdm-video";

		status = "disabled";
		clocks = <&aoss_qmp>;
		clock-names = "apb_pclk";

		atid = <81>;
		out-ports {
			port {
				tpdm_video_out_funnel_video: endpoint {
					remote-endpoint =
					<&funnel_video_in_tpdm_video>;
				};
			};
		};
	};

	funnel_video: funnel@11032000 {
		compatible = "arm,primecell";
		arm,primecell-periphid = <0x000bb908>;

		reg = <0x11032000 0x1000>;
		reg-names = "funnel-base";

		coresight-name = "coresight-funnel-video";

		clocks = <&aoss_qmp>;
		clock-names = "apb_pclk";

		in-ports {
			#address-cells = <1>;
			#size-cells = <0>;

			port@0 {
				reg = <0>;
				funnel_video_in_tpdm_video: endpoint {
					remote-endpoint =
					<&tpdm_video_out_funnel_video>;
				};
			};
		};

		out-ports {
			#address-cells = <1>;
			#size-cells = <0>;

			port@0 {
				reg = <0>;
				funnel_video_out_tpda_dlmm: endpoint {
					remote-endpoint =
					<&tpda_dlmm_in_funnel_video>;
				};
			};
		};
	};

	tpdm_eva: tpdm@11440000 {
		compatible = "arm,primecell";
		arm,primecell-periphid = <0x000bb968>;
		reg = <0x11440000 0x1000>;
		reg-names = "tpdm-base";

		coresight-name = "coresight-tpdm-eva";

		clocks = <&aoss_qmp>;
		clock-names = "apb_pclk";

		atid = <81>;
		out-ports {
			port {
				tpdm_eva_out_funnel_eva: endpoint {
					remote-endpoint =
					<&funnel_eva_in_tpdm_eva>;
				};
			};
		};
	};

	funnel_eva: funnel@11442000 {
		compatible = "arm,primecell";
		arm,primecell-periphid = <0x000bb908>;

		reg = <0x11442000 0x1000>;
		reg-names = "funnel-base";

		coresight-name = "coresight-funnel-eva";

		clocks = <&aoss_qmp>;
		clock-names = "apb_pclk";

		in-ports {
			#address-cells = <1>;
			#size-cells = <0>;

			port@0 {
				reg = <0>;
				funnel_eva_in_tpdm_eva: endpoint {
					remote-endpoint =
					<&tpdm_eva_out_funnel_eva>;
				};
			};
		};

		out-ports {
			#address-cells = <1>;
			#size-cells = <0>;

			port@0 {
				reg = <0>;
				funnel_eva_out_tpda_dlmm: endpoint {
					remote-endpoint =
					<&tpda_dlmm_in_funnel_eva>;
				};
			};
		};
	};

	tpdm_lsr: tpdm@111b0000 {
		compatible = "arm,primecell";
		arm,primecell-periphid = <0x000bb968>;
		reg = <0x111b0000 0x1000>;
		reg-names = "tpdm-base";

		coresight-name = "coresight-tpdm-lsr";

		clocks = <&aoss_qmp>;
		clock-names = "apb_pclk";

		atid = <81>;
		out-ports {
			port {
				tpdm_lsr_out_funnel_lsr: endpoint {
					remote-endpoint =
					<&funnel_lsr_in_tpdm_lsr>;
				};
			};
		};
	};

	funnel_lsr: funnel@111b2000 {
		compatible = "arm,primecell";
		arm,primecell-periphid = <0x000bb908>;

		reg = <0x111b2000 0x1000>;
		reg-names = "funnel-base";

		coresight-name = "coresight-funnel-lsr";

		clocks = <&aoss_qmp>;
		clock-names = "apb_pclk";

		in-ports {
			#address-cells = <1>;
			#size-cells = <0>;

			port@0 {
				reg = <0>;
				funnel_lsr_in_tpdm_lsr: endpoint {
					remote-endpoint =
					<&tpdm_lsr_out_funnel_lsr>;
				};
			};
		};

		out-ports {
			#address-cells = <1>;
			#size-cells = <0>;

			port@0 {
				reg = <0>;
				funnel_lsr_out_tpda_dlmm: endpoint {
					remote-endpoint =
					<&tpda_dlmm_in_funnel_lsr>;
				};
			};
		};
	};

	wpss_etm: wpss_etm0 {
		compatible = "qcom,coresight-remote-etm";

		coresight-name = "coresight-wpss-etm0";
		qcom,inst-id = <3>;
		atid = <44>;

		out-ports {
			port {
				wpss_etm0_out_funnel_wpss: endpoint {
					remote-endpoint =
						<&funnel_wpss_in_wpss_etm0>;
				};
			};
		};
	};

	tpdm_wpss_dsb: tpdm@111a0000 {
		compatible = "arm,primecell";
		arm,primecell-periphid = <0x000bb968>;
		reg = <0x111a0000 0x1000>;
		reg-names = "tpdm-base";

		coresight-name = "coresight-tpdm-wpss";

		clocks = <&aoss_qmp>;
		clock-names = "apb_pclk";

		atid = <78>;
		out-ports {
			port {
				tpdm_wpss_dsb_out_funnel_wpss: endpoint {
					remote-endpoint =
					<&funnel_wpss_in_tpdm_wpss_dsb>;
				};
			};
		};
	};


	funnel_wpss: funnel@111a3000 {
		compatible = "arm,primecell";
		arm,primecell-periphid = <0x000bb908>;

		reg = <0x111a3000 0x1000>;
		reg-names = "funnel-base";

		coresight-name = "coresight-funnel-wpss";

		clocks = <&aoss_qmp>;
		clock-names = "apb_pclk";

		in-ports {
			#address-cells = <1>;
			#size-cells = <0>;

			port@0 {
				reg = <0>;
				funnel_wpss_in_tpdm_wpss_dsb: endpoint {
					remote-endpoint =
					<&tpdm_wpss_dsb_out_funnel_wpss>;
				};
			};

			port@2 {
				reg = <2>;
				funnel_wpss_in_wpss_etm0: endpoint {
					remote-endpoint =
					<&wpss_etm0_out_funnel_wpss>;
				};
			};
		};

		out-ports {
			#address-cells = <1>;
			#size-cells = <0>;

			port@0 {
				reg = <0>;
				funnel_wpss_out_tpda_dlct1: endpoint {
					remote-endpoint =
					<&tpda_dlct1_in_funnel_wpss>;
					source = <&tpdm_wpss_dsb>;
				};
			};

			port@1 {
				reg = <1>;
				funnel_wpss_out_funnel_dlct1: endpoint {
					remote-endpoint =
					<&funnel_dlct1_in_funnel_wpss>;
					source = <&wpss_etm>;
				};
			};

		};
	};

	tpdm_dlmm_dsb: tpdm@11408000 {
		compatible = "arm,primecell";
		arm,primecell-periphid = <0x000bb968>;
		reg = <0x11408000 0x1000>;
		reg-names = "tpdm-base";

		coresight-name = "coresight-dlmm-dsb";

		clocks = <&aoss_qmp>;
		clock-names = "apb_pclk";

		atid = <81>;
		out-ports {
			port {
				tpdm_dlmm_dsb_out_tpda_dlmm: endpoint {
					remote-endpoint =
					<&tpda_dlmm_in_tpdm_dlmm_dsb>;
				};
			};
		};
	};

	tpda_dlmm: tpda@1140b000 {
		compatible = "arm,primecell";
		arm,primecell-periphid = <0x000bb969>;

		reg = <0x1140b000 0x1000>;
		reg-names = "tpda-base";

		qcom,cmb-elem-size = <2 32>;
		qcom,dsb-elem-size = <0 32>,
					<8 32>,
					<9 32>,
					<13 32>;
		coresight-name = "coresight-tpda-dlmm";

		clocks = <&aoss_qmp>;
		clock-names = "apb_pclk";
		qcom,tpda-atid = <81>;

		in-ports {

			#address-cells = <1>;
			#size-cells = <0>;

			port@0 {
				reg = <0>;
				tpda_dlmm_in_funnel_video: endpoint {
					remote-endpoint =
					<&funnel_video_out_tpda_dlmm>;
				};
			};

			port@2 {
				reg = <2>;
				tpda_dlmm_in_funnel_mdss: endpoint {
					remote-endpoint =
					<&funnel_mdss_out_tpda_dlmm>;
				};
			};

			port@8 {
				reg = <8>;
				tpda_dlmm_in_funnel_eva: endpoint {
					remote-endpoint =
					<&funnel_eva_out_tpda_dlmm>;
				};
			};

			port@9 {
				reg = <9>;
				tpda_dlmm_in_funnel_lsr: endpoint {
					remote-endpoint =
					<&funnel_lsr_out_tpda_dlmm>;
				};
			};

			port@d {
				reg = <13>;
				tpda_dlmm_in_tpdm_dlmm_dsb: endpoint {
					remote-endpoint =
					<&tpdm_dlmm_dsb_out_tpda_dlmm>;
				};
			};



		};

		out-ports {
			#address-cells = <1>;
			#size-cells = <0>;

			port@0 {
				reg = <0>;
				tpda_dlmm_out_funnel_dlmm: endpoint {
					remote-endpoint =
					<&funnel_dlmm_in_tpda_dlmm>;
				};
			};
		};
	};

	funnel_dlmm: funnel@1140c000 {
		compatible = "arm,primecell";
		arm,primecell-periphid = <0x000bb908>;

		reg = <0x1140c000 0x1000>;
		reg-names = "funnel-base";

		coresight-name = "coresight-funnel-multimedia";

		clocks = <&aoss_qmp>;
		clock-names = "apb_pclk";

		in-ports {

			#address-cells = <1>;
			#size-cells = <0>;

			port@0 {
				reg = <0>;
				funnel_dlmm_in_tpda_dlmm: endpoint {
					remote-endpoint =
					<&tpda_dlmm_out_funnel_dlmm>;
				};
			};

		};

		out-ports {
			#address-cells = <1>;
			#size-cells = <0>;

			port@0 {
				reg = <0>;
				funnel_multimedia_out_funnel_in1: endpoint {
					remote-endpoint =
					<&funnel_in1_in_funnel_multimedia>;
				};
			};
		};
	};

	funnel_in1: funnel@10042000 {
		compatible = "arm,primecell";
		arm,primecell-periphid = <0x000bb908>;
		reg = <0x10042000 0x1000>;
		reg-names = "funnel-base";

		coresight-name = "coresight-funnel-in1";

		clocks = <&aoss_qmp>;
		clock-names = "apb_pclk";

		in-ports {
			#address-cells = <1>;
			#size-cells = <0>;

			port@0 {
				reg = <0>;
				funnel_in1_in_funnel_tmess: endpoint {
					remote-endpoint =
					<&funnel_tmess_out_funnel_in1>;
				};
			};

			port@1 {
				reg = <1>;
				funnel_in1_in_funnel_dlwest: endpoint {
					remote-endpoint =
					<&funnel_dlwest_out_funnel_in1>;
				};
			};

			port@4 {
				reg = <4>;
				funnel_in1_in_funnel_apss: endpoint {
					remote-endpoint =
					<&funnel_apss_out_funnel_in1>;
				};
			};

			port@5 {
				reg = <5>;
				funnel_in1_in_funnel_dlct1: endpoint {
					remote-endpoint =
					<&funnel_dlct1_out_funnel_in1>;
				};
			};

			port@6 {
				reg = <6>;
				funnel_in1_in_funnel_dlct0: endpoint {
					remote-endpoint =
					<&funnel_dlct0_out_funnel_in1>;
				};
			};

			port@7 {
				reg = <7>;
				funnel_in1_in_funnel_multimedia: endpoint {
					remote-endpoint =
					<&funnel_multimedia_out_funnel_in1>;
				};
			};


		};

		out-ports {
			port {
				funnel_in1_out_funnel_merge: endpoint {
					remote-endpoint =
					<&funnel_merge_in_funnel_in1>;
				};
			};
		};
	};

	tpdm_dcc: tpdm@10003000 {
		compatible = "arm,primecell";
		arm,primecell-periphid = <0x000bb968>;
		reg = <0x10003000 0x1000>;
		reg-names = "tpdm-base";

		coresight-name = "coresight-dcc";

		clocks = <&aoss_qmp>;
		clock-names = "apb_pclk";

		atid = <64>;
		out-ports {
			port {
				tpdm_dcc_out_tpda_qdss: endpoint {
					remote-endpoint =
					<&tpda_qdss_in_tpdm_dcc>;
				};
			};
		};
	};

	tpdm_qdss_spdm: tpdm@1000f000 {
		compatible = "arm,primecell";
		arm,primecell-periphid = <0x000bb968>;
		reg = <0x1000f000 0x1000>;
		reg-names = "tpdm-base";

		coresight-name = "coresight-qdss-spdm";

		clocks = <&aoss_qmp>;
		clock-names = "apb_pclk";

		atid = <64>;
		out-ports {
			port {
				tpdm_qdss_spdm_out_tpda_qdss: endpoint {
					remote-endpoint =
					<&tpda_qdss_in_tpdm_qdss_spdm>;
				};
			};
		};
	};

	tpda_qdss: tpda@10004000 {
		compatible = "arm,primecell";
		arm,primecell-periphid = <0x000bb969>;

		reg = <0x10004000 0x1000>;
		reg-names = "tpda-base";

		qcom,cmb-elem-size = <0 32>,
					<1 32>;
		coresight-name = "coresight-tpda-qdss";

		clocks = <&aoss_qmp>;
		clock-names = "apb_pclk";
		qcom,tpda-atid = <64>;

		in-ports {

			#address-cells = <1>;
			#size-cells = <0>;

			port@0 {
				reg = <0>;
				tpda_qdss_in_tpdm_dcc: endpoint {
					remote-endpoint =
					<&tpdm_dcc_out_tpda_qdss>;
				};
			};

			port@1 {
				reg = <1>;
				tpda_qdss_in_tpdm_qdss_spdm: endpoint {
					remote-endpoint =
					<&tpdm_qdss_spdm_out_tpda_qdss>;
				};
			};

		};

		out-ports {
			#address-cells = <1>;
			#size-cells = <0>;

			port@0 {
				reg = <0>;
				tpda_qdss_out_funnel_in0: endpoint {
					remote-endpoint =
					<&funnel_in0_in_tpda_qdss>;
				};
			};
		};
	};

	stm: stm@10002000 {
		compatible = "arm,primecell";
		arm,primecell-periphid = <0x000bb962>;
		reg = <0x10002000 0x1000>,
			<0x16280000 0x180000>;
		reg-names = "stm-base", "stm-stimulus-base";

		atid = <16>;
		coresight-name = "coresight-stm";

		clocks = <&aoss_qmp>;
		clock-names = "apb_pclk";

		out-ports {
			port {
				stm_out_funnel_in0: endpoint {
					remote-endpoint =
					<&funnel_in0_in_stm>;
				};
			};
		};
	};

	funnel_in0: funnel@10041000 {
		compatible = "arm,primecell";
		arm,primecell-periphid = <0x000bb908>;
		reg = <0x10041000 0x1000>;
		reg-names = "funnel-base";

		coresight-name = "coresight-funnel-in0";

		clocks = <&aoss_qmp>;
		clock-names = "apb_pclk";

		in-ports {
			#address-cells = <1>;
			#size-cells = <0>;

			port@5 {
				reg = <5>;
				funnel_in0_in_tpda_pcie: endpoint {
					remote-endpoint =
					<&tpda_pcie_out_funnel_in0>;
				};
			};

			port@6 {
				reg = <6>;
				funnel_in0_in_tpda_qdss: endpoint {
					remote-endpoint =
					<&tpda_qdss_out_funnel_in0>;
				};
			};

			port@7 {
				reg = <7>;
				funnel_in0_in_stm: endpoint {
					remote-endpoint =
					<&stm_out_funnel_in0>;
				};
			};

		};

		out-ports {
			port {
				funnel_in0_out_funnel_merge: endpoint {
					remote-endpoint =
					<&funnel_merge_in_funnel_in0>;
				};
			};
		};
	};

	funnel_merge: funnel@10045000 {
		compatible = "arm,primecell";
		arm,primecell-periphid = <0x000bb908>;
		reg = <0x10045000 0x1000>;
		reg-names = "funnel-base";

		coresight-name = "coresight-funnel-merge";

		clocks = <&aoss_qmp>;
		clock-names = "apb_pclk";

		in-ports {
			#address-cells = <1>;
			#size-cells = <0>;

			port@0 {
				reg = <0>;
				funnel_merge_in_funnel_in0: endpoint {
					remote-endpoint =
					<&funnel_in0_out_funnel_merge>;
				};
			};

			port@1 {
				reg = <1>;
				funnel_merge_in_funnel_in1: endpoint {
					remote-endpoint =
					<&funnel_in1_out_funnel_merge>;
				};
			};

		};

		out-ports {
			port {
				funnel_merge_out_funnel_aoss: endpoint {
					remote-endpoint =
					<&funnel_aoss_in_funnel_merge>;
				};
			};
		};
	};


	replicator_qdss: replicator@10046000 {
		compatible = "arm,primecell";
		arm,primecell-periphid = <0x000bb909>;
		reg = <0x10046000 0x1000>;
		reg-names = "replicator-base";

		coresight-name = "coresight-replicator_qdss";

		clocks = <&aoss_qmp>;
		clock-names = "apb_pclk";

		in-ports {
			port {
				replicator_qdss_in_replicator_swao: endpoint {
					remote-endpoint =
					<&replicator_swao_out_replicator_qdss>;
				};
			};
		};

		out-ports {
			#address-cells = <1>;
			#size-cells = <0>;

			port@0 {
				replicator_qdss_out_replicator_etr: endpoint {
					remote-endpoint =
					<&replicator_etr_in_replicator_qdss>;
				};
			};
		};
	};

	replicator_etr: replicator@1004e000 {
		compatible = "arm,primecell";
		arm,primecell-periphid = <0x000bb909>;
		reg = <0x1004e000 0x1000>;
		reg-names = "replicator-base";

		coresight-name = "coresight-replicator_etr";

		clocks = <&aoss_qmp>;
		clock-names = "apb_pclk";

		in-ports {
			port {
				replicator_etr_in_replicator_qdss: endpoint {
					remote-endpoint =
					<&replicator_qdss_out_replicator_etr>;
				};
			};
		};

		out-ports {
			#address-cells = <1>;
			#size-cells = <0>;

			port@0 {
				reg = <0>;
				replicator_etr_out_tmc_etr: endpoint {
					remote-endpoint =
					<&tmc_etr_in_replicator_etr>;
				};
			};

			port@1 {
				reg = <1>;
				replicator_etr_out_tmc_etr1: endpoint {
					remote-endpoint =
					<&tmc_etr1_in_replicator_etr>;
				};
			};
		};
	};

	tmc_etr: tmc@10048000 {
		compatible = "arm,primecell";
		arm,primecell-periphid = <0x000bb961>;
		reg = <0x10048000 0x1000>;
		reg-names = "tmc-base";

		qcom,iommu-dma = "bypass";
		iommus = <&apps_smmu 0x00c0 0x20>;

		qcom,iommu-dma-addr-pool = <0x0 0xffc00000>;

		qcom,sw-usb;
		dma-coherent;
		coresight-name = "coresight-tmc-etr";

		coresight-csr = <&csr>;
		csr-atid-offset = <0xf8>;
		csr-irqctrl-offset = <0x6c>;
		byte-cntr-name = "byte-cntr";
		byte-cntr-class-name = "coresight-tmc-etr-stream";

		interrupts = <GIC_SPI 270 IRQ_TYPE_EDGE_RISING>;
		interrupt-names = "byte-cntr-irq";

		arm,scatter-gather;
		clocks = <&aoss_qmp>;
		clock-names = "apb_pclk";

		in-ports {
			port {
				tmc_etr_in_replicator_etr: endpoint {
					remote-endpoint =
					<&replicator_etr_out_tmc_etr>;
				};
			};
		};
	};

	tmc_etr1: tmc@1004f000 {
		compatible = "arm,primecell";
		arm,primecell-periphid = <0x000bb961>;
		reg = <0x1004f000 0x1000>;
		reg-names = "tmc-base";

		coresight-name = "coresight-tmc-etr1";

		iommus = <&apps_smmu 0x0100 0>;
		qcom,iommu-dma-addr-pool = <0x0 0xffc00000>;

		coresight-csr = <&csr>;
		csr-atid-offset = <0x108>;
		csr-irqctrl-offset = <0x70>;
		byte-cntr-name = "byte-cntr1";
		byte-cntr-class-name = "coresight-tmc-etr1-stream";

		interrupts = <GIC_SPI 269 IRQ_TYPE_EDGE_RISING>;
		interrupt-names = "byte-cntr-irq";

		arm,scatter-gather;
		clocks = <&aoss_qmp>;
		clock-names = "apb_pclk";

		in-ports {
			port {
				tmc_etr1_in_replicator_etr: endpoint {
					remote-endpoint =
					<&replicator_etr_out_tmc_etr1>;
				};
			};
		};
	};

	tpdm_aoss_prio0: tpdm@11309000 {
		compatible = "arm,primecell";
		arm,primecell-periphid = <0x000bb968>;
		reg = <0x11309000 0x1000>;
		reg-names = "tpdm-base";

		coresight-name = "coresight-aoss-prio0";

		clocks = <&aoss_qmp>;
		clock-names = "apb_pclk";

		atid = <71>;
		out-ports {
			port {
				tpdm_aoss_prio0_out_tpda_aoss: endpoint {
					remote-endpoint =
					<&tpda_aoss_in_tpdm_aoss_prio0>;
				};
			};
		};
	};

	tpdm_aoss_prio1: tpdm@1130a000 {
		compatible = "arm,primecell";
		arm,primecell-periphid = <0x000bb968>;
		reg = <0x1130a000 0x1000>;
		reg-names = "tpdm-base";

		coresight-name = "coresight-aoss-prio1";

		clocks = <&aoss_qmp>;
		clock-names = "apb_pclk";

		atid = <71>;
		out-ports {
			port {
				tpdm_aoss_prio1_out_tpda_aoss: endpoint {
					remote-endpoint =
					<&tpda_aoss_in_tpdm_aoss_prio1>;
				};
			};
		};
	};

	tpdm_aoss_prio2: tpdm@1130b000 {
		compatible = "arm,primecell";
		arm,primecell-periphid = <0x000bb968>;
		reg = <0x1130b000 0x1000>;
		reg-names = "tpdm-base";

		coresight-name = "coresight-aoss-prio2";

		clocks = <&aoss_qmp>;
		clock-names = "apb_pclk";

		atid = <71>;
		out-ports {
			port {
				tpdm_aoss_prio2_out_tpda_aoss: endpoint {
					remote-endpoint =
					<&tpda_aoss_in_tpdm_aoss_prio2>;
				};
			};
		};
	};

	tpdm_aoss_prio3: tpdm@1130c000 {
		compatible = "arm,primecell";
		arm,primecell-periphid = <0x000bb968>;
		reg = <0x1130c000 0x1000>;
		reg-names = "tpdm-base";

		coresight-name = "coresight-aoss-prio3";

		clocks = <&aoss_qmp>;
		clock-names = "apb_pclk";

		atid = <71>;
		out-ports {
			port {
				tpdm_aoss_prio3_out_tpda_aoss: endpoint {
					remote-endpoint =
					<&tpda_aoss_in_tpdm_aoss_prio3>;
				};
			};
		};
	};

	tpdm_aoss_dsb: tpdm@1130d000 {
		compatible = "arm,primecell";
		arm,primecell-periphid = <0x000bb968>;
		reg = <0x1130d000 0x1000>;
		reg-names = "tpdm-base";

		coresight-name = "coresight-aoss-dsb";

		clocks = <&aoss_qmp>;
		clock-names = "apb_pclk";

		atid = <71>;
		out-ports {
			port {
				tpdm_aoss_dsb_out_tpda_aoss: endpoint {
					remote-endpoint =
					<&tpda_aoss_in_tpdm_aoss_dsb>;
				};
			};
		};
	};

	tpda_aoss: tpda@11308000 {
		compatible = "arm,primecell";
		arm,primecell-periphid = <0x000bb969>;

		reg = <0x11308000 0x1000>;
		reg-names = "tpda-base";

		qcom,cmb-elem-size = <0 64>,
					<1 64>,
					<2 64>,
					<3 64>;
		qcom,dsb-elem-size = <4 32>;
		coresight-name = "coresight-tpda-aoss";

		clocks = <&aoss_qmp>;
		clock-names = "apb_pclk";
		qcom,tpda-atid = <71>;

		in-ports {

			#address-cells = <1>;
			#size-cells = <0>;

			port@0 {
				reg = <0>;
				tpda_aoss_in_tpdm_aoss_prio0: endpoint {
					remote-endpoint =
					<&tpdm_aoss_prio0_out_tpda_aoss>;
				};
			};

			port@1 {
				reg = <1>;
				tpda_aoss_in_tpdm_aoss_prio1: endpoint {
					remote-endpoint =
					<&tpdm_aoss_prio1_out_tpda_aoss>;
				};
			};

			port@2 {
				reg = <2>;
				tpda_aoss_in_tpdm_aoss_prio2: endpoint {
					remote-endpoint =
					<&tpdm_aoss_prio2_out_tpda_aoss>;
				};
			};

			port@3 {
				reg = <3>;
				tpda_aoss_in_tpdm_aoss_prio3: endpoint {
					remote-endpoint =
					<&tpdm_aoss_prio3_out_tpda_aoss>;
				};
			};

			port@4 {
				reg = <4>;
				tpda_aoss_in_tpdm_aoss_dsb: endpoint {
					remote-endpoint =
					<&tpdm_aoss_dsb_out_tpda_aoss>;
				};
			};


		};

		out-ports {
			#address-cells = <1>;
			#size-cells = <0>;

			port@0 {
				reg = <0>;
				tpda_aoss_out_funnel_aoss: endpoint {
					remote-endpoint =
					<&funnel_aoss_in_tpda_aoss>;
				};
			};
		};
	};

	funnel_aoss: funnel@11304000 {
		compatible = "arm,primecell";
		arm,primecell-periphid = <0x000bb908>;
		reg = <0x11304000 0x1000>;
		reg-names = "funnel-base";

		coresight-name = "coresight-funnel-aoss";

		clocks = <&aoss_qmp>;
		clock-names = "apb_pclk";

		in-ports {
			#address-cells = <1>;
			#size-cells = <0>;

			port@3 {
				reg = <3>;
				funnel_aoss_in_funnel_ddr_lpi: endpoint {
					remote-endpoint =
					<&funnel_ddr_lpi_out_funnel_aoss>;
				};
			};

			port@5 {
				reg = <5>;
				funnel_aoss_in_funnel_lpass_lpi0: endpoint {
					remote-endpoint =
					<&funnel_lpass_lpi0_out_funnel_aoss>;
				};
			};

			port@6 {
				reg = <6>;
				funnel_aoss_in_tpda_aoss: endpoint {
					remote-endpoint =
					<&tpda_aoss_out_funnel_aoss>;
				};
			};

			port@7 {
				reg = <7>;
				funnel_aoss_in_funnel_merge: endpoint {
					remote-endpoint =
					<&funnel_merge_out_funnel_aoss>;
				};
			};

		};

		out-ports {
			port {
				funnel_aoss_out_tmc_etf: endpoint {
					remote-endpoint =
					<&tmc_etf_in_funnel_aoss>;
				};
			};
		};
	};

	tmc_etf: tmc@11305000 {
		compatible = "arm,primecell";
		arm,primecell-periphid = <0x000bb961>;
		reg = <0x11305000 0x1000>;
		reg-names = "tmc-base";

		coresight-name = "coresight-tmc-etf";

		clocks = <&aoss_qmp>;
		clock-names = "apb_pclk";

		in-ports {
			port {
				tmc_etf_in_funnel_aoss: endpoint {
					remote-endpoint =
					<&funnel_aoss_out_tmc_etf>;
				};
			};
		};

		out-ports {
			port {
				tmc_etf_out_replicator_swao: endpoint {
					remote-endpoint =
					<&replicator_swao_in_tmc_etf>;
				};
			};
		};
	};

	replicator_swao: replicator@11306000 {
		compatible = "arm,primecell";
		arm,primecell-periphid = <0x000bb909>;
		reg = <0x11306000 0x1000>;
		reg-names = "replicator-base";

		coresight-name = "coresight-replicator_swao";

		qcom,replicator-loses-context;
		clocks = <&aoss_qmp>;
		clock-names = "apb_pclk";

		in-ports {
			port {
				replicator_swao_in_tmc_etf: endpoint {
					remote-endpoint =
					<&tmc_etf_out_replicator_swao>;
				};
			};
		};

		out-ports {
			#address-cells = <1>;
			#size-cells = <0>;

			port@0 {
				replicator_swao_out_replicator_qdss: endpoint {
					remote-endpoint =
					<&replicator_qdss_in_replicator_swao>;
				};
			};

			port@1 {
				reg = <1>;
				replicator_swao_out_eud: endpoint {
					remote-endpoint =
					  <&eud_in_replicator_swao>;
				};
			};
		};
	};

	dummy_eud: dummy_sink {
		compatible = "qcom,coresight-dummy";

		coresight-name = "coresight-eud";

		qcom,dummy-sink;
		in-ports {
			port {
				eud_in_replicator_swao: endpoint {
					remote-endpoint =
						<&replicator_swao_out_eud>;
				};
			};
		};
	};
};

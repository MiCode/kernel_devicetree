#include "crow-idp.dtsi"

&qupv3_se13_i2c {
	status = "ok";
	wcd_usbss: wcd939x_i2c@e {
		compatible = "qcom,wcd939x-i2c";
		reg = <0xe>;
		vdd-usb-cp-supply = <&L7B>;
	};
};

&usb0 {
	qcom,wcd_usbss = <&wcd_usbss>;
};

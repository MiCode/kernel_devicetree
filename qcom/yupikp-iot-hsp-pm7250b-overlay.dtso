// SPDX-License-Identifier: BSD-3-Clause
/*
 * Copyright (c) 2025 Qualcomm Innovation Center, Inc. All rights reserved.
 */

/dts-v1/;
/plugin/;

#include "yupikp-iot-hsp-pm7250b.dtsi"

/ {
	model = "Qualcomm Technologies, Inc. YupikP IOT HSP + PM7250B";
	compatible = "qcom,yupikp-iot-idp", "qcom,yupikp-iot", "qcom,idp";
	qcom,msm-id = <498 0x10000>, <575 0x10000>, <576 0x10000>;
	qcom,board-id = <34 1>;
};

// SPDX-License-Identifier: BSD-3-Clause
/*
 * Copyright (c) 2024 Qualcomm Innovation Center, Inc. All rights reserved.
 */

/dts-v1/;
/plugin/;

#include "kera-mtp-wcn7750-ufs4.dtsi"
#include "kera-pm7550ba.dtsi"

/ {
	model = "Qualcomm Technologies, Inc. Kera MTP + WCN7750 + UFS4";
	compatible = "qcom,kera-mtp", "qcom,kera", "qcom,kerap-mtp", "qcom,kerap",
			"qcom,mtp";
	qcom,msm-id = <686 0x10000>, <659 0x10000>;
	qcom,board-id = <0x10008 1>;
};


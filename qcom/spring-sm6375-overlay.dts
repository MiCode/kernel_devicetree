/dts-v1/;
/plugin/;

#include "blair-qrd.dtsi"
#include "holi-qrd-pm7250b.dtsi"
#include "spring-sm6375.dtsi"

/ {
	model = "Qualcomm Technologies, Inc. Spring QRD";
	compatible = "qcom,blair-qrd", "qcom,blair", "qcom,qrd";
	qcom,msm-id = <507 0x10000>, <578 0x10000>;
	qcom,board-id = <0x2000B 0>;
	qcom,pmic-id-size = <4>;
	qcom,pmic-id = <0x2D 0x0 0x2E 0x0>;
};

&pm7250b_charger {
	dpdm-supply = <&usb2_phy0>;
};
#include "fingerprint.dtsi"

&soc {
	/*add simtray status*/
	simtray {
		compatible = "xiaomi,simtray-status";
		status-gpio = <&tlmm 94 0x00>;
	};
};

/dts-v1/;

#include "volcano6i.dtsi"

/ {
	model = "Qualcomm Technologies, Inc. Volcano6I FP1 SoC";
	compatible = "qcom,volcano";
	qcom,msm-id = <0X4000291 0x10000>;
	qcom,board-id = <0 0>;

	chosen {
		softsku-id = "1";
	};
};

&pcie1 {
	status = "disabled";
};


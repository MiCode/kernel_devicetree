/dts-v1/;

#include "cliffs-vm.dtsi"
#include "cliffs-vm-rcm-qhdp-kiwi.dtsi"

/ {
	model = "Qualcomm Technologies, Inc. Cliffs SVM RCM + QHD Plus + kiwi WLAN";
	compatible = "qcom,cliffs-rcm", "qcom,cliffs", "qcom,rcm";
	qcom,board-id = <21 3>;
};

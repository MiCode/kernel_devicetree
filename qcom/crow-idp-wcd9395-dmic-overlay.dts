/dts-v1/;
/plugin/;

#include "crow-idp-wcd9395-dmic.dtsi"
#include "crow-idp-pm8550b.dtsi"

/ {
	model = "Qualcomm Technologies, Inc. Crow IDP + WCD9395 DMIC";
	compatible = "qcom,crow-idp", "qcom,crow", "qcom,idp";
	qcom,msm-id = <608 0x10000>, <644 0x10000>;
	qcom,board-id = <34 2>;
};

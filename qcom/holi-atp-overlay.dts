/dts-v1/;
/plugin/;

#include "holi-atp.dtsi"

/ {
	model = "Qualcomm Technologies, Inc. Holi ATP";
	compatible = "qcom,holi-atp", "qcom,holi", "qcom,atp";
	qcom,msm-id = <454 0x10000>, <472 0x10000>;
	qcom,board-id = <33 0>;
	qcom,pmic-id-size = <4>;
	qcom,pmic-id = <0x36 0x0 0x2E 0x0>;
};

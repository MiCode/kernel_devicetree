// SPDX-License-Identifier: BSD-3-Clause
/*
 * Copyright (c) 2024 Qualcomm Innovation Center, Inc. All rights reserved.
 */

#include "ravelin.dtsi"

/ {

	model = "Qualcomm Technologies, Inc. Ravelin SG";
	compatible = "qcom,ravelin";
	qcom,msm-id = <653 0x10000>;
};

&soc {
	vdd_3v3_eth_r8211: vdd_3v3_eth_r8211 {
		compatible = "regulator-fixed";
		regulator-name = "vdd_3v3_eth_r8211";
		regulator-min-microvolt = <3300000>;
		regulator-max-microvolt = <3300000>;
		gpio = <&tlmm 2 GPIO_ACTIVE_LOW>;
	};

	vdd_3v3_pcie1_vreg: vdd_3v3_pcie1_vreg {
		compatible = "regulator-fixed";
		regulator-name = "vdd_3v3_pcie1_vreg";
		regulator-min-microvolt = <3300000>;
		regulator-max-microvolt = <3300000>;
		gpio = <&tlmm 72 GPIO_ACTIVE_LOW>;
	};

	pcie1_upd_ponrst: pcie1_upd_ponrst {
		compatible = "regulator-fixed";
		regulator-name = "pcie1_upd_ponrst";
		regulator-min-microvolt = <3300000>;
		regulator-max-microvolt = <3300000>;
		gpio = <&tlmm 19 GPIO_ACTIVE_HIGH>;
		regulator-always-on;
		enable-active-high;
	};
};

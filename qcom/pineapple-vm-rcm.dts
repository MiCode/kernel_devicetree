// SPDX-License-Identifier: BSD-3-Clause
/*
 * Copyright (c) 2022-2023 Qualcomm Innovation Center, Inc. All rights reserved.
 */
/dts-v1/;

#include "pineapple-vm.dtsi"
#include "pineapple-vm-rcm.dtsi"

/ {
	model = "Qualcomm Technologies, Inc. Pineapple SVM RCM";
	compatible = "qcom,pineapple-rcm", "qcom,pineapple", "qcom,rcm";
	qcom,board-id = <0x15 0>;
};

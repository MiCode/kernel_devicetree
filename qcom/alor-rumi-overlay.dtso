// SPDX-License-Identifier: BSD-3-Clause
/*
 * Copyright (c) 2024 Qualcomm Innovation Center, Inc. All rights reserved.
 */

/dts-v1/;
/plugin/;

#include "alor-rumi.dtsi"

/ {
	model = "Qualcomm technologies, Inc. ALOR RUMI";
	compatible = "qcom,alor-rumi", "qcom,alor", "qcom,rumi";
	qcom,msm-id = <685 0x10000>;
	qcom,board-id = <15 0>;
};

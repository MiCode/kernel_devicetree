/dts-v1/;

#include "lemans-ivi-adas.dtsi"
#include "lemans-qam-star.dtsi"

/ {
	model = "Qualcomm Technologies, Inc. Lemans IVI ADAS QAM STAR";
	compatible = "qcom,lemans-ivi-adas", "qcom,lemans", "qcom,qam-star", "qcom,lemans-ivi-adas-qam-star";
};


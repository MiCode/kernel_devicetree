// SPDX-License-Identifier: BSD-3-Clause
/*
 * Copyright (c) 2022-2023 Qualcomm Innovation Center, Inc. All rights reserved.
 */
/dts-v1/;

#include "pineapple-oemvm.dtsi"
#include "pineapple-oemvm-mtp.dtsi"

/ {
	model = "Qualcomm Technologies, Inc. Pineapple OEMVM MTP";
	compatible = "qcom,pineapple-mtp", "qcom,pineapple", "qcom,mtp";
	qcom,board-id = <0x10008 0>;
};

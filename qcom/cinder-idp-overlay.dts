/dts-v1/;
/plugin/;

#include "cinder-idp.dtsi"

/ {
	model = "Qualcomm Technologies, Inc. Cinder IDP";
	compatible = "qcom,cinder-idp", "qcom,cinder", "qcom,idp";
	qcom,msm-id = <539 0x10000>;
	qcom,board-id = <0x1 0x0>;
};

/dts-v1/;

#include "direwolf-vm.dtsi"
#include "direwolf-vm-la.dtsi"

/ {
	model = "Qualcomm Technologies, Inc. Direwolf Single LA Virtual Machine";
	compatible = "qcom,direwolf", "qcom,quinvm";
	qcom,board-id = <0 0x1000001>;
};

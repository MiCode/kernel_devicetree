/dts-v1/;
/plugin/;

#include "pineapplep-aim500.dtsi"

/ {
	model = "Qualcomm Technologies, Inc. PineappleP AIM500";
	compatible = "qcom,pineapplep-hdk", "qcom,pineapplep", "qcom,hdk";
	qcom,msm-id = <577 0x10000>, <577 0x20000>;
	qcom,board-id = <0x1001f 1>;
};

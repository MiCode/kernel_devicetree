/dts-v1/;

#include "waipio-oemvm.dtsi"
#include "waipio-oemvm-qrd.dtsi"

/ {
	model = "Qualcomm Technologies, Inc. Waipio OEMVM QRD";
	compatible = "qcom,waipio-qrd", "qcom,waipio", "qcom,qrd";
	qcom,board-id = <0x1000B 0>;
};

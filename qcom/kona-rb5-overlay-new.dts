/dts-v1/;
/plugin/;

#include "kona-iot-v2.1-rb5.dtsi"

/ {
	model = "Qualcomm Technologies, Inc. Robotics RB5 Platform";
	compatible = "qcom,kona-iot-qrd", "qcom,kona-iot", "qcom,kona-qrd";
	qcom,msm-id = <481 0x0>, <481 0x10000>, <481 0x20000>, <481 0x20001>;
	qcom,board-id = <0x301000b 0x0>;
};

/dts-v1/;
/plugin/;

#include "volcano6i-mtp-wcd9395-ganges-hac2019.dtsi"

/ {
	model = "Qualcomm Technologies, Inc. Volcano6I MTP + WCD9395 HSJ + HAC2019/RFID + Ganges + nopmi";
	compatible = "qcom,volcano-mtp", "qcom,volcano", "qcom,volcanop-mtp", "qcom,volcanop", "qcom,mtp";
	qcom,board-id = <8 4>;
	qcom,msm-id = <0X4000291 0x10000>, <0x4000292 0x10000>, <0x8000291 0x10000>, <0x8000292 0x10000>, <0xc000291 0x10000>, <0xc000292 0x10000>, <0x10000291 0x10000>, <0x10000292 0x10000>;
	qcom,pmic-id-size = <8>;
	qcom,pmic-id = <0x0 0x0 0x0 0x0 0x0 0x0 0x0 0x0>;
};

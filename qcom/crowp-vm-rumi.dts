/dts-v1/;

#include "crowp-vm.dtsi"
#include "crowp-vm-rumi.dtsi"

/ {
	model = "Qualcomm Technologies, Inc. CrowP SVM RUMI";
	compatible = "qcom,crowp-rumi", "qcom,crowp", "qcom,rumi";
	qcom,board-id = <15 0>;
};

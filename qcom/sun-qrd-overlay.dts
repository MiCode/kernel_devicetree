// SPDX-License-Identifier: BSD-3-Clause
/*
 * Copyright (c) 2023 Qualcomm Innovation Center, Inc. All rights reserved.
 */

/dts-v1/;
/plugin/;

#include "sun-qrd.dtsi"

/ {
	model = "Qualcomm Technologies, Inc. Sun QRD";
	compatible = "qcom,sun-qrd", "qcom,sun", "qcom,qrd";
	qcom,msm-id = <618 0x10000>;
	qcom,board-id = <11 0>;
};

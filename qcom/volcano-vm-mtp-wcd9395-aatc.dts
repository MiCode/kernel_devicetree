/dts-v1/;

#include "volcano-vm.dtsi"
#include "volcano-vm-mtp-wcd9395-aatc.dtsi"

/ {
	model = "Qualcomm Technologies, Inc. Volcano SVM MTP + WCD9395 AATC";
	compatible = "qcom,volcano-mtp", "qcom,volcano", "qcom,mtp";
	qcom,board-id = <8 1>;
};

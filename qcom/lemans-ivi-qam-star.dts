/dts-v1/;

#include "lemans-ivi.dtsi"
#include "lemans-qam-star.dtsi"

/ {
	model = "Qualcomm Technologies, Inc. Lemans IVI QAM STAR";
	compatible = "qcom,lemans", "qcom,qam-star", "qcom,lemans-ivi", "qcom,lemans-ivi-qam-star";
};


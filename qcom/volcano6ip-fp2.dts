/dts-v1/;

#include "volcano6ip.dtsi"

/ {
	model = "Qualcomm Technologies, Inc. Volcano6IP FP2 SoC";
	compatible = "qcom,volcanop";
	qcom,msm-id = <0X8000292 0x10000>;
	qcom,board-id = <0 0>;

	chosen {
		softsku-id = "2";
	};
};

&pcie1 {
	status = "ok";
};

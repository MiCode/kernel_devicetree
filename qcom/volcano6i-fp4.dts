/dts-v1/;

#include "volcano6i.dtsi"

/ {
	model = "Qualcomm Technologies, Inc. Volcano6I FP4 SoC";
	compatible = "qcom,volcano";
	qcom,msm-id = <0X10000291 0x10000>;
	qcom,board-id = <0 0>;

	chosen {
		softsku-id = "4";
	};
};

&pcie1 {
	status = "ok";
};

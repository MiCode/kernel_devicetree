// SPDX-License-Identifier: BSD-3-Clause
/*
 * Copyright (c) 2024 Qualcomm Innovation Center, Inc. All rights reserved.
 */

/dts-v1/;

#include "kera-vm.dtsi"
#include "kera-vm-mtp-qca6750.dtsi"

/ {
	model = "Qualcomm Technologies, Inc. Kera SVM MTP + QCA6750";
	compatible = "qcom,kera-mtp", "qcom,kera", "qcom,kerap-mtp", "qcom,kerap",
			 "qcom,mtp";
	qcom,board-id = <0x10008 0>, <0x20008 0>, <0x30008 0>;
};

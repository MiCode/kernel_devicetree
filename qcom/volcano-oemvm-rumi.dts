/dts-v1/;

#include "volcano-oemvm.dtsi"
#include "volcano-oemvm-rumi.dtsi"

/ {
	model = "Qualcomm Technologies, Inc. Volcano OEMVM RUMI";
	compatible = "qcom,volcano-rumi", "qcom,volcano", "qcom,rumi";
	qcom,board-id = <15 0>;
};

/dts-v1/;
/plugin/;

#include "amethyst-sm7635.dtsi"


/ {
	model = "Qualcomm Technologies, Inc. Amethyst based on SM7635";
	compatible = "qcom,volcano-mtp", "qcom,volcano", "qcom,volcanop-mtp", "qcom,volcanop", "qcom,mtp";
	qcom,msm-id = <636 0x10000>, <640 0x10000>, <641 0x10000>, <657 0x10000>, <658 0x10000>;
	qcom,board-id = <8 0>;
	xiaomi,miboard-id = <0xC 0>;
};

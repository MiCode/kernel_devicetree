// SPDX-License-Identifier: BSD-3-Clause
/*
 * Copyright (c) 2025 Qualcomm Innovation Center, Inc. All rights reserved.
 */

/dts-v1/;
/plugin/;

#include "vienna-wdp.dtsi"

/ {
	model = "Qualcomm Technologies, Inc. Vienna WDP";
	compatible = "qcom,vienna-wdp", "qcom,vienna", "qcom,wdp";
	qcom,board-id = <0x10024 0x0>;
};

// SPDX-License-Identifier: BSD-3-Clause
/*
 * Copyright (c) 2024 Qualcomm Innovation Center, Inc. All rights reserved.
 */

/dts-v1/;

#include "kera-vm.dtsi"
#include "kera-vm-rcm-wcn7750.dtsi"

/ {
	model = "Qualcomm Technologies, Inc. Kera SVM RCM + WCN7750";
	compatible = "qcom,kera-rcm", "qcom,kera", "qcom,kerap-rcm", "qcom,kerap",
			"qcom,rcm";
	qcom,board-id = <0x10015 1>, <0x20015 1>, <0x30015 1>;
};

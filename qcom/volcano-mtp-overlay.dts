/dts-v1/;
/plugin/;

#include "volcano-mtp.dtsi"
#include "volcano-pmiv0104.dtsi"

/ {
	model = "Qualcomm Technologies, Inc. Volcano MTP";
	compatible = "qcom,volcano-mtp", "qcom,volcano", "qcom,volcanop-mtp", "qcom,volcanop", "qcom,mtp";
	qcom,msm-id = <636 0x10000>, <640 0x10000>, <641 0x10000>, <657 0x10000>, <658 0x10000>;
	qcom,board-id = <8 0>;
};

/dts-v1/;
/plugin/;

#include "kalama-mtp-nfc.dtsi"

/ {
	model = "Qualcomm Technologies, Inc. Kalama MTP ST54K NFC";
	compatible = "qcom,kalama-mtp", "qcom,kalama", "qcom,mtp";
	qcom,msm-id = <519 0x10000>, <536 0x10000>, <519 0x20000>, <536 0x20000>;
	qcom,board-id = <0x1010008 0>;
};

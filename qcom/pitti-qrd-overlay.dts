/dts-v1/;
/plugin/;

#include "pitti-qrd.dtsi"

/ {
	model = "Qualcomm Technologies, Inc. Pitti QRD";
	compatible = "qcom,pitti-qrd", "qcom,pitti", "qcom,qrd";
	qcom,msm-id = <623 0x10000>;
	qcom,board-id = <11 0>;
};

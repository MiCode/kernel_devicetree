/dts-v1/;

#include "khaje.dtsi"
#include "khaje-qrd-nopmi.dtsi"
#include "lx_chg/lx_chg.dtsi"
#include "lx_sensor/lx-sensor.dtsi"

/ {
	model = "Qualcomm Technologies, Inc. KHAJE QRD nopmi";
	compatible = "qcom,khaje-qrd", "qcom,khaje", "qcom,qrd";
	qcom,board-id = <0x1000B 0>;
	qcom,pmic-id = <0x2D 0x0 0x0 0x0>;
};

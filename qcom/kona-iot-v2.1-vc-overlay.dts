/dts-v1/;
/plugin/;

#include "kona-iot-v2.1-vc.dtsi"

/ {
	model = "Qualcomm Technologies, Inc. kona-iot VC";
	compatible = "qcom,kona-iot";
	qcom,msm-id = <481 0x0>, <481 0x10000>, <481 0x20000>, <481 0x20001>, <548 0x20001>;
	qcom,board-id = <0x010020 0x07>;
};

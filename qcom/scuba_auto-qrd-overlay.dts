/dts-v1/;
/plugin/;

#include "scuba_auto.dtsi"

/ {
	model = "Qualcomm Technologies, Inc. SCUBA AUTO QRD";
	compatible = "qcom,sa410m", "qcom,qrd", "qcom,sa410m-qrd";
	qcom,msm-id = <441 0x10000>, <471 0x10000>;
	qcom,board-id = <11 0x500>;
};


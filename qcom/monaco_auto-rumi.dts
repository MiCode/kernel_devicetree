/dts-v1/;
/memreserve/ 0xc0000000 0x00000100;

#include "monaco_auto.dtsi"
#include "monaco_auto-rumi.dtsi"

/ {
	model = "Qualcomm Technologies, Inc. MONACO AUTO RUMI";
	compatible = "qcom,monaco_auto", "qcom,rumi", "qcom,monaco_auto-rumi";
	qcom,board-id = <15 0>;
};

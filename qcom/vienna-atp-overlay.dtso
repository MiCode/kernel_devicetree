// SPDX-License-Identifier: BSD-3-Clause
/*
 * Copyright (c) 2025 Qualcomm Innovation Center, Inc. All rights reserved.
 */

/dts-v1/;
/plugin/;

#include "vienna-atp.dtsi"

/ {
	model = "Qualcomm Technologies, Inc. Vienna ATP";
	compatible = "qcom,vienna-atp", "qcom,vienna", "qcom,atp";
	qcom,board-id = <0x10021 0x0>;
};

// SPDX-License-Identifier: BSD-3-Clause
/*
 * Copyright (c) 2025 Qualcomm Innovation Center, Inc. All rights reserved.
 */

/dts-v1/;

#include "viennap.dtsi"

/ {
	model = "Qualcomm Technologies, Inc. ViennaP SoC";
	compatible = "qcom,viennap";
	qcom,board-id = <0 0>;
};

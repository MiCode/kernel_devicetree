/dts-v1/;
/memreserve/ 0x90f00000 0x00010000;

#include "sdxpinn.dtsi"
#include "sdxpinn-rumi.dtsi"

/ {
	model = "Qualcomm Technologies, Inc. SDXPINN RUMI";
	compatible = "qcom,sdxpinn-rumi", "qcom,sdxpinn", "qcom,rumi";
	qcom,board-id = <15 0x400>;
};

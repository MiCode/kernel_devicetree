/dts-v1/;

#include "pineapplep-vm.dtsi"
#include "pineapplep-vm-hdk.dtsi"

/ {
	model = "Qualcomm Technologies, Inc. PineappleP SVM HDK";
	compatible = "qcom,pineapplep-hdk", "qcom,pineapplep", "qcom,hdk";
	qcom,board-id = <0x1f 0>;
};

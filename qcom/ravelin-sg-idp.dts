// SPDX-License-Identifier: BSD-3-Clause
/*
 * Copyright (c) 2024 Qualcomm Innovation Center, Inc. All rights reserved.
 */

/dts-v1/;

#include "ravelin-sg.dtsi"
#include "ravelin-sg-idp.dtsi"

/ {
	model = "Qualcomm Technologies, Inc. Ravelin SG IDP";
	compatible = "qcom,ravelin-idp", "qcom,ravelin", "qcom,idp";
	qcom,board-id = <34 0>;
};


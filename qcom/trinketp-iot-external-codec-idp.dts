/dts-v1/;

#include "trinketp-iot.dtsi"
#include "trinket-iot-idp.dtsi"

/ {
	model = "Qualcomm Technologies, Inc. TRINKETP IOT Ext Audio Codec IDP";
	compatible = "qcom,trinketp-iot-idp", "qcom,trinketp-iot", "qcom,idp";
	qcom,board-id = <34 1>;
};

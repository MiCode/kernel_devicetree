// SPDX-License-Identifier: BSD-3-Clause
/*
 * Copyright (c) 2022-2025 Qualcomm Innovation Center, Inc. All rights reserved.
 */

#include <dt-bindings/interrupt-controller/irq.h>
#include <dt-bindings/spmi/spmi.h>

qcom,pmr735d@a {
	compatible = "qcom,spmi-pmic";
	reg = <10 SPMI_USID>;
	#address-cells = <1>;
	#size-cells = <0>;

	pmr735d_ecid: pmic-ecid@100 {
		compatible = "qcom,pmic-ecid";
		reg = <0x100>;
		qcom,pmic-name = "pmr735d";
	};

	pmr735d_tz: pmr735d-temp-alarm@a00 {
		compatible = "qcom,spmi-temp-alarm";
		reg = <0xa00>;
		interrupts = <0xa 0xa 0x0 IRQ_TYPE_EDGE_BOTH>;
		#thermal-sensor-cells = <0>;
	};

	pmr735d_gpios: pinctrl@8800 {
		compatible = "qcom,pmr735d-gpio";
		reg = <0x8800>;
		gpio-controller;
		#gpio-cells = <2>;
		interrupt-controller;
		#interrupt-cells = <2>;
	};
};

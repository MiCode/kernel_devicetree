/dts-v1/;
/plugin/;

#include "volcano6i-idp-wcd9395-brahma.dtsi"

/ {
	model = "Qualcomm Technologies, Inc. Volcano6I IDP + WCD9395 HSJ + Brahma";
	compatible = "qcom,volcano-idp", "qcom,volcano", "qcom,volcanop-idp", "qcom,volcanop", "qcom,idp";
	qcom,msm-id = <657 0x10000>, <658 0x10000>;
	qcom,board-id = <34 3>;
};

// SPDX-License-Identifier: BSD-3-Clause
/*
 * Copyright (c) Qualcomm Technologies, Inc. and/or its subsidiaries.
 */

/dts-v1/;

#include "x1p42100.dtsi"

/ {
	model = "Qualcomm Technologies, Inc. X1P42100 SoC";
	compatible = "qcom,x1p42100";
	qcom,board-id = <0 0>;

	qcom,msm-id = <635 0x10000>;
};

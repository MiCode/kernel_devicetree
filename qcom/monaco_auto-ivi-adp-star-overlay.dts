/dts-v1/;
/plugin/;

#include "monaco_auto-adp-star.dtsi"

/ {
	model = "Qualcomm Technologies, Inc. MonacoAU IVI ADP STAR";
	compatible = "qcom,monaco_auto", "qcom,adp-star", "qcom,monaco_auto-ivi", "qcom,monaco_auto-ivi-adp-star";
	qcom,msm-id = <606 0x10000>;
	qcom,board-id = <0x30019 0>;
};

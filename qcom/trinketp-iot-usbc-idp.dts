/dts-v1/;

#include "trinketp-iot.dtsi"
#include "trinketp-iot-idp.dtsi"

/ {
	model = "Qualcomm Technologies, Inc. TRINKETP IOT USBC Audio IDP";
	compatible = "qcom,trinketp-iot-idp", "qcom,trinket-iot", "qcom,idp";
	qcom,board-id = <34 2>;
};

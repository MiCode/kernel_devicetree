/dts-v1/;

#include "direwolf-vm-headless.dtsi"
#include "direwolf-vm-lv-headless-mt.dtsi"

/ {
	model = "Qualcomm Technologies, Inc. Direwolf Multi Headless LV Virtual Machine";
	compatible = "qcom,direwolf", "qcom,quinvm";
	qcom,board-id = <0 0x4000002>;
};

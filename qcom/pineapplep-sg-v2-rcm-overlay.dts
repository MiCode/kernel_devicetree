/dts-v1/;
/plugin/;

#include "pineapplep-sg-v2-rcm.dtsi"

/ {
	model = "Qualcomm Technologies, Inc. PineappleP SG V2 RCM";
	compatible = "qcom,pineapplep-rcm", "qcom,pineapplep", "qcom,rcm";
	qcom,msm-id = <682 0x20000>;
	qcom,board-id = <0x15 0>;
};

/dts-v1/;

#include "crowp-vm.dtsi"
#include "crowp-vm-qrd.dtsi"

/ {
	model = "Qualcomm Technologies, Inc. CrowP VM QRD";
	compatible = "qcom,crowp-qrd", "qcom,crowp", "qcom,qrd";
	qcom,board-id = <11 0>;
};

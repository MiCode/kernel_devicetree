// SPDX-License-Identifier: BSD-3-Clause
/*
 * Copyright (c) Qualcomm Technologies, Inc. and/or its subsidiaries.
 */

/dts-v1/;

#include "kera-vm.dtsi"
#include "kera-vm-atp.dtsi"

/ {
	model = "Qualcomm Technologies, Inc. Kera SVM ATP";
	compatible = "qcom,kera-atp", "qcom,kera", "qcom,kerap-atp", "qcom,kerap",
			"qcom,atp", "qcom,kera-qmb", "qcom,kerap-qna";

	qcom,board-id = <33 0>;
};

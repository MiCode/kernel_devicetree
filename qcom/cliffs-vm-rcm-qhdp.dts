/dts-v1/;

#include "cliffs-vm.dtsi"
#include "cliffs-vm-rcm-qhdp.dtsi"

/ {
	model = "Qualcomm Technologies, Inc. Cliffs SVM RCM + QHD Plus";
	compatible = "qcom,cliffs-rcm", "qcom,cliffs", "qcom,rcm";
	qcom,board-id = <21 1>;
};

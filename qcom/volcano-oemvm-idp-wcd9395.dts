/dts-v1/;

#include "volcano-oemvm.dtsi"
#include "volcano-oemvm-idp-wcd9395.dtsi"

/ {
	model = "Qualcomm Technologies, Inc. Volcano OEMVM IDP + WCD9395";
	compatible = "qcom,volcano-idp", "qcom,volcano", "qcom,idp";
	qcom,board-id = <34 1>;
};

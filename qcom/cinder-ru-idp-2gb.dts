/dts-v1/;

#include "cinder.dtsi"
#include "cinder-ru.dtsi"
#include "cinder-ru-hireg-2gb.dtsi"
#include "cinder-idp.dtsi"

/ {
	model = "Qualcomm Technologies, Inc. Cinder RU IDP 2GB";
	compatible = "qcom,cinder-idp", "qcom,cinder", "qcom,idp";
	qcom,board-id = <0x22 0x400>;
};

&pm8150_vadc {
	/delete-node/ xo_therm;
};

&thermal_zones {
	/delete-node/ sys-therm-0;
};

&pm8150_adc_tm {
	/delete-node/ xo_therm;
};

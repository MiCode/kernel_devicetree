/dts-v1/;

#include "volcano6ip.dtsi"

/ {
	model = "Qualcomm Technologies, Inc. Volcano6IP FP3 SoC";
	compatible = "qcom,volcanop";
	qcom,msm-id = <0Xc000292 0x10000>;
	qcom,board-id = <0 0>;

	chosen {
		softsku-id = "3";
	};
};

&pcie1 {
	status = "ok";
};

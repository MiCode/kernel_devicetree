// SPDX-License-Identifier: BSD-3-Clause
/*
 * Copyright (c) 2024 Qualcomm Innovation Center, Inc. All rights reserved.
 */

/dts-v1/;
/plugin/;

#include "monaco-standalone-idp-v3.dtsi"

/ {
	model = "Qualcomm Technologies, Inc. Monaco standalone IDP V3.0";
	qcom,board-id = <0x030022 0x1>;
};

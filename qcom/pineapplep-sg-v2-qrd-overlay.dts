/dts-v1/;
/plugin/;

#include "pineapplep-sg-v2-qrd.dtsi"

/ {
	model = "Qualcomm Technologies, Inc. PineappleP SG V2 QRD";
	compatible = "qcom,pineapplep-qrd", "qcom,pineapplep", "qcom,qrd";
	qcom,msm-id = <682 0x20000>;
	qcom,board-id = <0x1000B 0>, <0xB 0>;
};

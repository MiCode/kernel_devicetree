// SPDX-License-Identifier: BSD-3-Clause
/*
 * Copyright (c) 2023 Qualcomm Innovation Center, Inc. All rights reserved.
 */

/dts-v1/;

#include "sun-v2.dtsi"

/ {
	model = "Qualcomm Technologies, Inc. Sun v2 SoC";
	compatible = "qcom,sun";
	qcom,board-id = <0 0>;
};

// SPDX-License-Identifier: BSD-3-Clause
/*
 * Copyright (c) 2024 Qualcomm Innovation Center, Inc. All rights reserved.
 */

#include "ipcc-test.dtsi"

&soc {
	/delete-node/ ipcc-self-ping-adsp;
	/delete-node/ ipcc-self-ping-cdsp;
	/delete-node/ ipcc-self-ping-slpi;
};


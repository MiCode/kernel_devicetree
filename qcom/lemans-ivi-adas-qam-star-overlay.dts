/dts-v1/;
/plugin/;

#include "lemans-qam-star.dtsi"

/ {
	model = "Qualcomm Technologies, Inc. Lemans IVI ADAS QAM STAR";
	compatible = "qcom,lemans-ivi-adas", "qcom,lemans", "qcom,qam-star", "qcom,lemans-ivi-adas-qam-star";
	qcom,msm-id = <534 0x10000>;
	qcom,board-id = <0x10025 0>;
};


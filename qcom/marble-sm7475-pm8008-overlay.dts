/dts-v1/;
/plugin/;

#include "marble-sm7475.dtsi"
#include "waipio-pm8008.dtsi"

/ {
	model = "Marble based on Qualcomm Technologies, Inc SM7475";
	compatible = "qcom,ukee-mtp", "qcom,ukee", "qcom,mtp";
	qcom,msm-id = <591 0x10000>;
	qcom,board-id = <0x10008 0>;
	xiaomi,miboard-id = <0xf 0>;
};

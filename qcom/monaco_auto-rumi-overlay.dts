/dts-v1/;
/plugin/;

#include "monaco_auto-rumi.dtsi"

/ {
	model = "Qualcomm Technologies, Inc. MONACO AUTO RUMI";
	compatible = "qcom,monaco_auto", "qcom,rumi", "qcom,monaco_auto-rumi";
	qcom,board-id = <0x1000F 0>;
};

/dts-v1/;
/plugin/;

#include "kalama-cdp-nfc.dtsi"

/ {
	model = "Qualcomm Technologies, Inc. Kalama CDP ST54K NFC";
	compatible = "qcom,kalama-cdp", "qcom,kalama", "qcom,cdp";
	qcom,msm-id = <519 0x10000>, <536 0x10000>, <519 0x20000>, <536 0x20000>, <600 0x20000>, <601 0x20000>;
	qcom,board-id = <0x02010001 0>;
};

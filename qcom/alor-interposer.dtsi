// SPDX-License-Identifier: BSD-3-Clause
/*
 * Copyright (c) 2025 Qualcomm Innovation Center, Inc. All rights reserved.
 */

#include "canoe.dtsi"
#include "alor-interposer-common.dtsi"

/ {
	model = "Qualcomm Technologies, Inc. Alor Interposer";
	compatible = "qcom,alor";
	qcom,msm-id = <704 0x10000>, <0x10002C0 0x10000>;
};


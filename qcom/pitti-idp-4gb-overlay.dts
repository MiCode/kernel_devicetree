/dts-v1/;
/plugin/;

#include "pitti-idp-4gb.dtsi"
#include "pitti-pm7250b.dtsi"

/ {
	model = "Qualcomm Technologies, Inc. Pitti IDP 4GB DDR";
	compatible = "qcom,pitti-idp", "qcom,pitti", "qcom,idp";
	qcom,msm-id = <623 0x10000>;
	qcom,board-id = <34 0x600>;
};

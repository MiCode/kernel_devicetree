/dts-v1/;

#include "volcano-oemvm.dtsi"
#include "volcano-oemvm-mtp.dtsi"

/ {
	model = "Qualcomm Technologies, Inc. Volcano OEMVM MTP";
	compatible = "qcom,volcano-mtp", "qcom,volcano", "qcom,mtp";
	qcom,board-id = <8 0>;
};

/dts-v1/;

#include "crow-oemvm.dtsi"
#include "crow-oemvm-atp.dtsi"

/ {
	model = "Qualcomm Technologies, Inc. Crow OEM VM ATP";
	compatible = "qcom,crow-atp", "qcom,crow", "qcom,atp";
	qcom,board-id = <33 0>;
};

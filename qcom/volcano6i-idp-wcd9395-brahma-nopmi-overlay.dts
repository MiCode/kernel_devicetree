/dts-v1/;
/plugin/;

#include "volcano6i-idp-wcd9395-brahma.dtsi"

/ {
	model = "Qualcomm Technologies, Inc. Volcano6I IDP + WCD9395 HSJ + Brahma + nopmi";
	compatible = "qcom,volcano-idp", "qcom,volcano", "qcom,volcanop-idp", "qcom,volcanop", "qcom,idp";
	qcom,msm-id = <0X4000291 0x10000>, <0x4000292 0x10000>, <0x8000291 0x10000>, <0x8000292 0x10000>, <0xc000291 0x10000>, <0xc000292 0x10000>, <0x10000291 0x10000>, <0x10000292 0x10000>;
	qcom,board-id = <34 3>;
	qcom,pmic-id-size = <8>;
	qcom,pmic-id = <0x0 0x0 0x0 0x0 0x0 0x0 0x0 0x0>;
};

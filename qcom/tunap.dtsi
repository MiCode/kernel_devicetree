// SPDX-License-Identifier: BSD-3-Clause
/*
 * Copyright (c) 2024 Qualcomm Innovation Center, Inc. All rights reserved.
 */

#include "tuna.dtsi"
/ {
	model = "Qualcomm Technologies, Inc. TunaP SoC";
	compatible = "qcom,tunap";
	qcom,msm-id = <694 0x10000>;
};

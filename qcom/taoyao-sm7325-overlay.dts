/dts-v1/;
/plugin/;

#include "taoyao-sm7325-pm7250b.dtsi"

/ {
	model = "taoyao based Qualcomm Technologies, Inc. Yupik IDP + PM7250B";
	compatible = "qcom,yupik-idp", "qcom,yupik", "qcom,idp";
        qcom,msm-id = <475 0x10000>, <515 0x10000>;
        qcom,board-id = <0x1000B 0>;
	xiaomi,board-id = <0xD 0>;
};

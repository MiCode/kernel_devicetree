/dts-v1/;
/plugin/;

#include "kona-iot-v2-rb5.dtsi"

/ {
	model = "Qualcomm Technologies, Inc. kona-iot RB5 v2";
	compatible = "qcom,kona-iot-qrd", "qcom,kona-iot", "qcom,kona-qrd";
	qcom,board-id = <0x305000b 0x0>;
};

/dts-v1/;

#include "yupik-hsp.dtsi"
#include "yupik-idp-hsp.dtsi"

/ {
	model = "Qualcomm Technologies, Inc. Yupik IDP + HSP";
	compatible = "qcom,yupik-idp", "qcom,yupik", "qcom,idp";
	qcom,board-id = <34 1>;
};

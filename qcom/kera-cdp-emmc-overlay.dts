// SPDX-License-Identifier: BSD-3-Clause
/*
 * Copyright (c) Qualcomm Technologies, Inc. and/or its subsidiaries.
 */

/dts-v1/;
/plugin/;

#include "kera-cdp-emmc.dtsi"
#include "kera-pmiv0102.dtsi"

/ {
	model = "Qualcomm Technologies, Inc. Kera CDP + eMMC";
	compatible = "qcom,kera-cdp", "qcom,kera", "qcom,kerap-cdp", "qcom,kerap",
			"qcom,cdp", "qcom,kera-qmb";

	qcom,msm-id = <720 0x10000>;
	qcom,board-id = <0x10001 1>;
};

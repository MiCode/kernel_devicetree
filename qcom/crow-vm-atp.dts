/dts-v1/;

#include "crow-vm.dtsi"
#include "crow-vm-atp.dtsi"

/{
	model = "Qualcomm Technologies, Inc. Crow VM ATP";
	compatible = "qcom,crow-atp", "qcom,crow", "qcom,atp";
	qcom,board-id = <33 0>;
};

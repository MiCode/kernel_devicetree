/dts-v1/;
/plugin/;

#include "kalama-cdp.dtsi"

/ {
	model = "Qualcomm Technologies, Inc. Kalama CDP";
	compatible = "qcom,kalama-cdp", "qcom,kalama", "qcom,cdp";
	qcom,msm-id = <519 0x10000>, <536 0x10000>, <519 0x20000>, <536 0x20000>,
			<600 0x20000>, <601 0x20000>, <603 0x20000>, <604 0x20000>,
			<668 0x20000>, <688 0x20000>;
	qcom,board-id = <0x10001 0>, <0x30001 0>;
};

/dts-v1/;

#include "cliffs-oemvm.dtsi"
#include "cliffs-oemvm-mtp-peach-2s-nfc-wcd9395.dtsi"

/ {
	model = "Qualcomm Technologies, Inc. Cliffs OEMVM MTP + peach + 2S + NFC + WCD9395";
	compatible = "qcom,cliffs-mtp", "qcom,cliffs", "qcom,mtp";
	qcom,board-id = <8 4>;
};

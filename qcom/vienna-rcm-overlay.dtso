// SPDX-License-Identifier: BSD-3-Clause
/*
 * Copyright (c) 2025 Qualcomm Innovation Center, Inc. All rights reserved.
 */

/dts-v1/;
/plugin/;

#include "vienna-rcm.dtsi"

/ {
	model = "Qualcomm Technologies, Inc. Vienna RCM";
	compatible = "qcom,vienna-rcm", "qcom,vienna", "qcom,rcm";
	qcom,board-id = <0x10015 0x0>;
};

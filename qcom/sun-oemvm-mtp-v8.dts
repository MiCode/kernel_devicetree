// SPDX-License-Identifier: BSD-3-Clause
/*
 * Copyright (c) 2024 Qualcomm Innovation Center, Inc. All rights reserved.
 */
/dts-v1/;

#include "sun-oemvm.dtsi"
#include "sun-oemvm-mtp-v8.dtsi"

/ {
	model = "Qualcomm Technologies, Inc. Sun OEMVM MTP-V8";
	compatible = "qcom,sun-mtp", "qcom,sun", "qcom,mtp";
	qcom,board-id = <0x40008 0>;
};

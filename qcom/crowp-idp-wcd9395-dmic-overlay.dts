/dts-v1/;
/plugin/;

#include "crowp-idp-wcd9395-dmic.dtsi"
#include "crow-idp-pm8550b.dtsi"

/ {
	model = "Qualcomm Technologies, Inc. CrowP IDP + WCD9395 DMIC";
	compatible = "qcom,crowp-idp", "qcom,crowp", "qcom,idp";
	qcom,msm-id = <687 0x10000>;
	qcom,board-id = <34 2>;
};

// SPDX-License-Identifier: BSD-3-Clause
/*
 * Copyright (c) 2024 Qualcomm Innovation Center, Inc. All rights reserved.
 */

/dts-v1/;
/plugin/;

#include "kera-pm7550ba.dtsi"
#include "darwin-sm7750.dtsi"
#include "darwin-sm7750-touch.dtsi"
#include "darwin-nfc-common.dtsi"

/ {
	model = "Qualcomm Technologies, Inc. Darwin based on SM7750";
	compatible = "qcom,kera-qrd", "qcom,kera", "qcom,kerap-qrd", "qcom,kerap",
			"qcom,qrd";
	qcom,msm-id = <686 0x10000>, <659 0x10000>;
	qcom,board-id = <0x10008 0>;
	xiaomi,miboard-id = <0x0D 0>;
};

// SPDX-License-Identifier: BSD-3-Clause
/*
 * Copyright (c) 2025 Qualcomm Innovation Center, Inc. All rights reserved.
 */

/dts-v1/;

#include "katmaip-fp2p5.dtsi"

/ {
	model = "Qualcomm Technologies, Inc. KATMAIP-FP2P5 SoC";
	compatible = "qcom,yupikp-iot";
	qcom,board-id = <0 0>;
};

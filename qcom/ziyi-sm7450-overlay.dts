/dts-v1/;
/plugin/;

#include "diwali-qrd.dtsi"

/ {
	model = "Ziyi based on Qualcomm Technologies, Inc. Diwali QRD";
	compatible = "qcom,diwali-qrd", "qcom,diwali", "qcom,qrd";
	qcom,msm-id = <506 0x10000>;
	qcom,board-id = <0x1000B 0>;
        xiaomi,miboard-id = <0x9 0>;
};

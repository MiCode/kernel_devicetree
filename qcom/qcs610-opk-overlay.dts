// SPDX-License-Identifier: BSD-3-Clause
/*
 * Copyright (c) 2025 Qualcomm Innovation Center, Inc. All rights reserved.
 */

/dts-v1/;
/plugin/;

#include "qcs610-opk.dtsi"

/ {
	model = "Qualcomm Technologies, Inc. Openkit Overlay";
	compatible = "qcom,qcs610-opk", "qcom,qcs610", "qcom,opk";
	qcom,msm-id = <401 0x0>;
	qcom,board-id = <32 3>;
};

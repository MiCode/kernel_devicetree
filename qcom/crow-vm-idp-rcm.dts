/dts-v1/;

#include "crow-vm.dtsi"
#include "crow-vm-idp-rcm.dtsi"

/ {
	model = "Qualcomm Technologies, Inc. Crow VM IDP RCM";
	compatible = "qcom,crow-idp", "qcom,crow", "qcom,idp";
	qcom,board-id = <34 4>;
};

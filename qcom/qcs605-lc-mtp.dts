/dts-v1/;

#include "qcs605-lc.dtsi"
#include "qcs605-lc-mtp.dtsi"

/ {
	model = "Qualcomm Technologies, Inc. QC605 LC Groot + PM8005 MTP";
	compatible = "qcom,qcs605-mtp", "qcom,qcs605", "qcom,mtp";
	qcom,board-id = <8 4>;
};

/dts-v1/;
/plugin/;

#include "trinketp-iot-idp.dtsi"

/ {
	model = "Qualcomm Technologies, Inc. TRINKETP IOT IDP Overlay";
	compatible = "qcom,trinketp-iot";
	qcom,msm-id = <468 0x10000>;
	qcom,board-id = <34 0>;
};

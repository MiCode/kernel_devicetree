// SPDX-License-Identifier: BSD-3-Clause
/*
 * Copyright (c) Qualcomm Technologies, Inc. and/or its subsidiaries.
 */

#include "yupik-iot.dtsi"
#include "katmai-cpu-fp2.dtsi"

/ {
	model = "Qualcomm Technologies, Inc. KATMAI SoC";
	compatible = "qcom,yupik-iot";
	qcom,msm-id = <576 0x10000>;
	qcom,softsku-id = <1>;
};

&pcie1 {
	status = "ok";
};

&pcie1_msi {
	status = "ok";
};

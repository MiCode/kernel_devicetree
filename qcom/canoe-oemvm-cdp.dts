// SPDX-License-Identifier: BSD-3-Clause
/*
 * Copyright (c) 2024 Qualcomm Innovation Center, Inc. All rights reserved.
 */
/dts-v1/;

#include "canoe-oemvm.dtsi"
#include "canoe-oemvm-cdp.dtsi"

/ {
	model = "Qualcomm Technologies, Inc. Canoe OEMVM CDP";
	compatible = "qcom,canoe-cdp", "qcom,canoe", "qcom,canoep-cdp",
			"qcom,canoep", "qcom,cdp";
	qcom,board-id = <1 0>;
};

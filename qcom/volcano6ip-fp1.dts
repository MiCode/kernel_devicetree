/dts-v1/;

#include "volcano6ip.dtsi"

/ {
	model = "Qualcomm Technologies, Inc. Volcano6IP FP1 SoC";
	compatible = "qcom,volcanop";
	qcom,msm-id = <0X4000292 0x10000>;
	qcom,board-id = <0 0>;

	chosen {
		softsku-id = "1";
	};
};

&pcie1 {
	status = "disabled";
};

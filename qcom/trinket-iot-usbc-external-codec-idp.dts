/dts-v1/;

#include "trinket-iot.dtsi"
#include "trinket-iot-idp.dtsi"

/ {
	model = "Qualcomm Technologies,Inc. TRINKET IOT USBC Ext Aud Codec IDP";
	compatible = "qcom,trinket-iot-idp", "qcom,trinket-iot", "qcom,idp";
	qcom,board-id = <34 3>;
};

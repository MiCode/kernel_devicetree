// SPDX-License-Identifier: BSD-3-Clause
/*
 * Copyright (c) 2024, Qualcomm Innovation Center, Inc. All rights reserved.
 */

/dts-v1/;
/plugin/;

#include "vienna-rumi.dtsi"

/ {
	model = "Qualcomm Technologies, Inc. Vienna RUMI";
	compatible = "qcom,vienna-rumi", "qcom,vienna", "qcom,rumi";
	qcom,board-id = <15 0 >;
};

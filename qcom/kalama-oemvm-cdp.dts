/dts-v1/;

#include "kalama-oemvm.dtsi"
#include "kalama-oemvm-cdp.dtsi"

/ {
	model = "Qualcomm Technologies, Inc. Kalama OEMVM CDP";
	compatible = "qcom,kalama-cdp", "qcom,kalama", "qcom,cdp";
	qcom,board-id = <0x10001 0>;
};

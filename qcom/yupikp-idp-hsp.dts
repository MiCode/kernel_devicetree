/dts-v1/;

#include "yupikp-hsp.dtsi"
#include "yupikp-idp-hsp.dtsi"

/ {
	model = "Qualcomm Technologies, Inc. YupikP IDP + HSP";
	compatible = "qcom,yupikp-idp", "qcom,yupikp", "qcom,idp";
	qcom,board-id = <34 1>;
};

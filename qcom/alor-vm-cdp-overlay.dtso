// SPDX-License-Identifier: BSD-3-Clause
/*
 * Copyright (c) Qualcomm Technologies, Inc. and/or its subsidiaries.
 */
/dts-v1/;
/plugin/;

#include "alor-vm-avf.dtsi"
#include "alor-vm-cdp-avf.dtsi"

/ {
	model = "Qualcomm Technologies, Inc. Alor SVM CDP";
	compatible = "qcom,alor-cdp", "qcom,alor", "qcom,alorp-cdp",
			"qcom,alorp", "qcom,cdp";
	qcom,board-id = <0x10001 0>;

	host {
	};
};

/dts-v1/;
/plugin/;

#include "sa410m-idp.dtsi"

/ {
	model = "Qualcomm Technologies, Inc. SA410M NAND CCARD";
	compatible = "qcom,sa410m", "qcom,ccard", "qcom,sa410m-ccard";
	qcom,msm-id=<560 0x10000>;
	qcom,board-id = <25 0x1>;
};

&qnand_1 {
	status = "ok";
};

&sdhc_1 {
	status = "disabled";
};

/dts-v1/;
/plugin/;

#include "kalama-mtp.dtsi"
#include "sdxbaagha-external-soc.dtsi"
#include "kalama-baagha.dtsi"

/ {
	model = "KALAMA BAAGHA MTP";
	compatible = "qcom,kalama-mtp", "qcom,kalama", "qcom,mtp";
	qcom,msm-id = <519 0x10000>, <536 0x10000>;
	qcom,board-id = <0x03010008 0x3>;
};

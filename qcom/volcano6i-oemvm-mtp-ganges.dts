/dts-v1/;
/plugin/;

#include "volcano-oemvm.dtsi"
#include "volcano6i-oemvm-mtp-ganges.dtsi"

/ {
	model = "Qualcomm Technologies, Inc. Volcano6I OEMVM MTP + WCD9378 AATC + Ganges";
	compatible = "qcom,volcano-mtp", "qcom,volcano", "qcom,mtp";
	qcom,board-id = <8 3>;
};


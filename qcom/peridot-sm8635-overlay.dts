/dts-v1/;
/plugin/;

#include "peridot-sm8635.dtsi"


/ {
	model = "Qualcomm Technologies, Inc. Peridot based on SM8635";
	compatible = "qcom,cliffs-mtp", "qcom,cliffs", "qcom,mtp";
	qcom,msm-id = <614 0x10000>, <632 0x10000>;
	qcom,board-id = <8 0>;
	xiaomi,miboard-id = <0x8 0>;
};
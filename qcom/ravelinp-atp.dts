// SPDX-License-Identifier: BSD-3-Clause
/*
 * Copyright (c) 2024 Qualcomm Innovation Center, Inc. All rights reserved.
 */

/dts-v1/;

#include "ravelinp.dtsi"
#include "ravelinp-atp.dtsi"

/ {
	model = "Qualcomm Technologies, Inc. RavelinP ATP";
	compatible = "qcom,ravelinp-atp", "qcom,ravelinp", "qcom,atp";
	qcom,board-id = <33 0>;
};

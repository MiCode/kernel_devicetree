/dts-v1/;
/plugin/;

#include "pineapplep-sg-v2-cdp-nfc.dtsi"

/ {
	model = "Qualcomm Technologies, Inc. PineappleP SG V2 CDP ST54L NFC";
	compatible = "qcom,pineapplep-cdp", "qcom,pineapplep", "qcom,cdp";
	qcom,msm-id = <682 0x20000>;
	qcom,board-id = <0x50001 0>;
};

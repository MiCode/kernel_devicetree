/dts-v1/;
/plugin/;

#include "cliffs-rumi.dtsi"

/ {
	model = "Qualcomm Technologies, Inc. Cliffs RUMI";
	compatible = "qcom,cliffs-rumi", "qcom,cliffs", "qcom,rumi";
	qcom,msm-id = <614 0x10000>, <632 0x10000>;
	qcom,board-id = <15 0>;
};

// SPDX-License-Identifier: BSD-3-Clause
/*
 * Copyright (c) 2024 Qualcomm Innovation Center, Inc. All rights reserved.
 */

/dts-v1/;

#include "tuna-oemvm.dtsi"
#include "tuna-oemvm-rcm.dtsi"

/ {
	model = "Qualcomm Technologies, Inc. Tuna OEMVM RCM";
	compatible = "qcom,tuna-rcm", "qcom,tuna", "qcom,tunap-rcm", "qcom,tunap",
			"qcom,rcm";
	qcom,board-id = <21 0>;
};

// SPDX-License-Identifier: BSD-3-Clause
/*
 * Copyright (c) 2024 Qualcomm Innovation Center, Inc. All rights reserved.
 */

/dts-v1/;

#include "canoep-tp.dtsi"

/ {
		model = "Qualcomm Technologies, Inc. CanoeP Alt. Thermal Profile SoC";
		compatible = "qcom,canoep";
		qcom,board-id = <0 0>;
};

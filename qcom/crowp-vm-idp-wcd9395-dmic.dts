/dts-v1/;

#include "crowp-vm.dtsi"
#include "crowp-vm-idp-wcd9395-dmic.dtsi"

/ {
	model = "Qualcomm Technologies, Inc. VM CrowP IDP + WCD9395 DMIC";
	compatible = "qcom,crowp-idp", "qcom,crowp", "qcom,idp";
	qcom,board-id = <34 2>;
};

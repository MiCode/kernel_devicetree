// SPDX-License-Identifier: BSD-3-Clause
/*
 * Copyright (c) Qualcomm Technologies, Inc. and/or its subsidiaries.
 */

/dts-v1/;

#include "kera-vm.dtsi"
#include "kera-vm-cdp-qca6750.dtsi"

/ {
	model = "Qualcomm Technologies, Inc. Kera SVM CDP + QCA6750";
	compatible = "qcom,kera-cdp", "qcom,kera", "qcom,kerap-cdp", "qcom,kerap",
			"qcom,cdp", "qcom,kera-qmb", "qcom,kerap-qna";

	qcom,board-id = <0x10001 0>, <0x20001 0>, <0x30001 0>, <0x40001 0>;
};

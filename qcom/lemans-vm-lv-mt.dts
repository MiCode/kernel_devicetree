/dts-v1/;

#include "lemans-vm.dtsi"
#include "lemans-vm-lv-mt.dtsi"

/ {
	model = "Qualcomm Technologies, Inc. Lemans Multi LV Virtual Machine";
	compatible = "qcom,lemans", "qcom,quinvm";
	qcom,board-id = <0x0 0x2000002>;
};

/dts-v1/;

#include "volcano-vm.dtsi"

/ {
	model = "Qualcomm Technologies, Inc. Volcano SVM MTP + WCD9378 HSJ + SN220T + Evros";
	compatible = "qcom,volcano-mtp", "qcom,volcano", "qcom,mtp";
	qcom,board-id = <8 10>;
};


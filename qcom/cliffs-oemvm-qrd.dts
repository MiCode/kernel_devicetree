/dts-v1/;

#include "cliffs-oemvm.dtsi"
#include "cliffs-oemvm-qrd.dtsi"

/ {
	model = "Qualcomm Technologies, Inc. Cliffs OEMVM QRD";
	compatible = "qcom,cliffs-qrd", "qcom,cliffs", "qcom,qrd";
	qcom,board-id = <11 0>;
};

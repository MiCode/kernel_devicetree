/dts-v1/;
/plugin/;

#include "cliffs-cdp.dtsi"
#include "cliffs-pm7550ba.dtsi"

/ {
	model = "Qualcomm Technologies, Inc. Cliffs CDP";
	compatible = "qcom,cliffs-cdp", "qcom,cliffs", "qcom,cliffsp-cdp", "qcom,cliffsp", "qcom,cdp";
	qcom,msm-id = <614 0x10000>, <632 0x10000>, <642 0x10000>, <643 0x10000>;
	qcom,board-id = <1 0>;
};

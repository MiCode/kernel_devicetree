// SPDX-License-Identifier: BSD-3-Clause
/*
 * Copyright (c) Qualcomm Technologies, Inc. and/or its subsidiaries.
 */

#include "montague.dtsi"

/ {
	model = "Qualcomm Technologies, Inc. MontagueP SoC";
	compatible = "qcom,montaguep";
	qcom,msm-id = <582 0x10000>;
};


/dts-v1/;
/plugin/;

#include "lemans-qam-star.dtsi"

/ {
	model = "Qualcomm Technologies, Inc. Lemans IVI ADAS ADP STAR";
	compatible = "qcom,lemans-ivi-adas", "qcom,lemans", "qcom,adp-star", "qcom,lemans-ivi-adas-adp-star";
	qcom,msm-id = <534 0x10000>;
	qcom,board-id = <0x10019 0>;
};


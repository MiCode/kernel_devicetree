/dts-v1/;

#include "niobe-vm.dtsi"
#include "niobe-vm-idp.dtsi"

/ {
	model = "Qualcomm Technologies, Inc. Niobe IDP SVM";
	compatible = "qcom,niobe-idp", "qcom,niobe", "qcom,idp";
	qcom,board-id = <0x10022 0>;
};

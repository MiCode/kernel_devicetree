// SPDX-License-Identifier: BSD-3-Clause
/*
 * Copyright (c) 2022-2023 Qualcomm Innovation Center, Inc. All rights reserved.
 */
/dts-v1/;

#include "pineapple-oemvm.dtsi"
#include "pineapple-oemvm-qrd.dtsi"

/ {
	model = "Qualcomm Technologies, Inc. Pineapple OEMVM QRD";
	compatible = "qcom,pineapple-qrd", "qcom,pineapple", "qcom,qrd";
	qcom,board-id = <0x1000b 0>;
};

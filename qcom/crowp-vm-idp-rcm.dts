/dts-v1/;

#include "crowp-vm.dtsi"
#include "crowp-vm-idp-rcm.dtsi"

/ {
	model = "Qualcomm Technologies, Inc. CrowP VM IDP RCM";
	compatible = "qcom,crowp-idp", "qcom,crowp", "qcom,idp";
	qcom,board-id = <34 4>;
};

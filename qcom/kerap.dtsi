// SPDX-License-Identifier: BSD-3-Clause
/*
 * Copyright (c) 2024 Qualcomm Innovation Center, Inc. All rights reserved.
 */

#include "kera.dtsi"

/ {
	model = "Qualcomm Technologies, Inc. KeraP SoC";
	compatible = "qcom,kerap";
	qcom,msm-id = <686 0x10000>;
};

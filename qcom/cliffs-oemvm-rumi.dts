/dts-v1/;

#include "cliffs-oemvm.dtsi"
#include "cliffs-oemvm-rumi.dtsi"

/ {
	model = "Qualcomm Technologies, Inc. Cliffs OEMVM RUMI";
	compatible = "qcom,cliffs-rumi", "qcom,cliffs", "qcom,rumi";
	qcom,board-id = <15 0>;
};


// SPDX-License-Identifier: BSD-3-Clause
/*
 * Copyright (c) 2025 Qualcomm Innovation Center, Inc. All rights reserved.
 */

#include "canoe-v2.dtsi"
#include "alor-interposer-common.dtsi"

/ {
	model = "Qualcomm Technologies, Inc. Alor Interposer v2 SoC";
	compatible = "qcom,alor";
	qcom,msm-id = <704 0x20000>, <0x10002C0 0x20000>;
};

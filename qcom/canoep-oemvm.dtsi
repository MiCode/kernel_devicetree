// SPDX-License-Identifier: BSD-3-Clause
/*
 * Copyright (c) 2025 Qualcomm Innovation Center, Inc. All rights reserved.
 */

#include "canoe-oemvm.dtsi"

/ {
	model = "Qualcomm Technologies, Inc. CanoeP OEMVM";
	compatible = "qcom,canoep";
	qcom,msm-id = <661 0x10000>, <661 0x20000>,
		      <0x10295 0x10000>, <0x10295 0x20000>,
		      <0x30295 0x10000>, <0x30295 0x20000>,
		      <0x1010295 0x10000>, <0x1010295 0x20000>,
		      <0x1030295 0x10000>, <0x1030295 0x20000>;
};

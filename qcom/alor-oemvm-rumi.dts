// SPDX-License-Identifier: BSD-3-Clause
/*
 * Copyright (c) 2025 Qualcomm Innovation Center, Inc. All rights reserved.
 */

/dts-v1/;

#include "alor-oemvm.dtsi"
#include "alor-oemvm-rumi.dtsi"

/ {
	model = "Qualcomm Technologies, Inc. Alor OEMVM RUMI";
	compatible = "qcom,alor-rumi", "qcom,alor", "qcom,rumi";
	qcom,board-id = <15 0>;
};

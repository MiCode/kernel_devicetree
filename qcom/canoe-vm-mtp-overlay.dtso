// SPDX-License-Identifier: BSD-3-Clause
/*
 * Copyright (c) 2025 Qualcomm Innovation Center, Inc. All rights reserved.
 */
/dts-v1/;
/plugin/;

#include "canoe-vm-avf.dtsi"
#include "canoe-vm-mtp-avf.dtsi"

/ {
	model = "Qualcomm Technologies, Inc. Canoe SVM MTP";
	compatible = "qcom,canoe-mtp", "qcom,canoe", "qcom,canoep-mtp",
			"qcom,canoep", "qcom,mtp";
	qcom,board-id = <8 0>;

	host {
	};

};

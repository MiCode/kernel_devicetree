#include "cliffs.dtsi"

/ {
	model = "Qualcomm Technologies, Inc. Cliffs 7";
	compatible = "qcom,cliffs";
	qcom,msm-id = <632 0x10000>;
};

&cache_cont {
	compatible = "qcom,cliffs7-llcc", "qcom,llcc-v50";
};


/dts-v1/;
/plugin/;

#include <dt-bindings/interrupt-controller/arm-gic.h>
#include "khaje-idp.dtsi"
#include "khaje-idp-pm7250b.dtsi"
#include "khaje-idps-display-90hz.dtsi"
#include "lx_chg/lx_chg.dtsi"
#include "lx_sensor/lx-sensor.dtsi"

/ {
	model = "Qualcomm Technologies, Inc. KHAJE IDPS + 90Hz";
	compatible = "qcom,khaje-idp", "qcom,khaje", "qcom,idp";
	qcom,msm-id = <518 0x10000>, <586 0x10000>;
	qcom,board-id = <0x10122 0>;
	qcom,pmic-id = <0x2D 0x2E 0x0 0x0>;
};

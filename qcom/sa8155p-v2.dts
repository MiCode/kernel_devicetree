// SPDX-License-Identifier: BSD-3-Clause
/*
 * Copyright (c) 2024 Qualcomm Innovation Center, Inc. All rights reserved.
 */

/dts-v1/;

#include "sa8155p-v2.dtsi"

/ {
	model = "Qualcomm Technologies, Inc. SA8155P v2 SoC";
	compatible = "qcom,sa8155p";
	qcom,pmic-name = "PM8150";
	qcom,board-id = <0 0>;
};

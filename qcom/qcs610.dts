// SPDX-License-Identifier: BSD-3-Clause
/*
 * Copyright (c) 2025 Qualcomm Innovation Center, Inc. All rights reserved.
 */

/dts-v1/;

#include "qcs610.dtsi"

/ {
	model = "Qualcomm Technologies, Inc. QCS610 SoC";
	compatible = "qcom,qcs610";
	qcom,board-id = <0 0>;
};

/dts-v1/;
/memreserve/ 0x80C40000 0x00010000;

#include "cinder-du.dtsi"
#include "cinder-rumi.dtsi"

/ {
	model = "Qualcomm Technologies, Inc. Cinder DU RUMI";
	compatible = "qcom,cinder-rumi", "qcom,cinder", "qcom,rumi";
	qcom,board-id = <0xF 0x0>;
};

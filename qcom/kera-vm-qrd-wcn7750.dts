// SPDX-License-Identifier: BSD-3-Clause
/*
 * Copyright (c) 2024 Qualcomm Innovation Center, Inc. All rights reserved.
 */

/dts-v1/;

#include "kera-vm.dtsi"
#include "kera-vm-qrd-wcn7750.dtsi"

/ {
	model = "Qualcomm Technologies, Inc. Kera SVM QRD + WCN7750";
	compatible = "qcom,kera-qrd", "qcom,kera", "qcom,kerap-qrd", "qcom,kerap",
			"qcom,qrd";
	qcom,board-id = <0x1000B 0>, <0x2000B 0>, <0x3000B 0>;
};

// SPDX-License-Identifier: BSD-3-Clause
/*
 * Copyright (c) 2024 Qualcomm Innovation Center, Inc. All rights reserved.
 */

/dts-v1/;

#include "kerap.dtsi"

/ {
	model = "Qualcomm Technologies, Inc. KeraP SoC";
	compatible = "qcom,kerap";
	qcom,board-id = <0 0>;
};

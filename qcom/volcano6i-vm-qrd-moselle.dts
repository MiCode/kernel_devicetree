/dts-v1/;
/plugin/;

#include "volcano-vm.dtsi"
#include "volcano6i-vm-qrd-moselle.dtsi"

/ {
	model = "Qualcomm Technologies, Inc. Volcano6I SVM QRD +  WCD9378 AMIC + Amoled (SPI) + Moselle";
	compatible = "qcom,volcano-qrd", "qcom,volcano", "qcom,qrd";
	qcom,board-id = <11 1>;
};


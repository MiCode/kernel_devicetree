// SPDX-License-Identifier: BSD-3-Clause
/*
 * Copyright (c) 2024 Qualcomm Innovation Center, Inc. All rights reserved.
 */

/dts-v1/;
/plugin/;

#include "parrot-qrd.dtsi"
#include "parrot-qrd-pm7250b.dtsi"
#include "kunzite-sm6475.dtsi"
#include "fingerprint.dtsi"

/ {
	model = "Qualcomm Technologies, Inc. Kunzite QRD";
	compatible = "qcom,parrot-qrd", "qcom,parrot", "qcom,qrd";
	qcom,msm-id = <537 0x10000>, <583 0x10000>, <613 0x10000>, <631 0x10000>,
			<633 0x10000>, <634 0x10000>, <638 0x10000>,
			<663 0x10000>;
	qcom,board-id = <0x2000B 0>;
};

&soc {
	/*add simtray status*/
	simtray {
		compatible = "xiaomi,simtray-status";
		status-gpio = <&tlmm 107 0x00>;
	};
};


/dts-v1/;
/memreserve/ 0x90000000 0x00001000;

#include "kaka.dtsi"
#include "kaka-rumi.dtsi"

/ {
	model = "Qualcomm Technologies, Inc. Kaka RUMI";
	compatible = "qcom,kaka-rumi", "qcom,kaka", "qcom,rumi";
	qcom,board-id = <15 0>;
};

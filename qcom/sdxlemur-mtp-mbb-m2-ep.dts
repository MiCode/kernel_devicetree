/dts-v1/;

#include "sdxlemur.dtsi"
#include "sdxlemur-mtp-mbb-pcie-ep.dtsi"
#include "sdxlemur-mtp-mbb-m2-ep.dtsi"
#include "sdxlemur-1024mb.dtsi"

/ {
	model = "Qualcomm Technologies, Inc. SDXLEMUR MTP MBB M2 EP";
	compatible = "qcom,sdxlemur-mtp",
		"qcom,sdxlemur", "qcom,mtp";
	qcom,board-id = <0x8010008 0x308>;
};

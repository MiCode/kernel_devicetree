/dts-v1/;
/plugin/;

#include "uke-sm8635.dtsi"

/ {
	model = "Qualcomm Technologies, Inc. Uke based on SM8635";
	compatible = "qcom,cliffs-mtp", "qcom,cliffs", "qcom,mtp";
	qcom,msm-id = <614 0x10000>, <632 0x10000>, <642 0x10000>, <643 0x10000>;
	qcom,board-id = <8 0>;
	xiaomi,miboard-id = <0xB 0>;
};
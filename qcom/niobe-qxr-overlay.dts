/dts-v1/;
/plugin/;

#include "niobe-qxr.dtsi"

/ {
	model = "Qualcomm Technologies, Inc. Niobe QXR";
	compatible = "qcom,niobe-qxr", "qcom,niobe", "qcom,qxr";
	qcom,msm-id = <629 0x10000>;
	qcom,board-id = <0x10026 0>;
};

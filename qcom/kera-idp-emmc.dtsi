// SPDX-License-Identifier: BSD-3-Clause
/*
 * Copyright (c) Qualcomm Technologies, Inc. and/or its subsidiaries.
 */

#include "kerap-idp.dtsi"
#include "kera_emmc.dtsi"

&L11B {
	/delete-property/ regulator-always-on;
};

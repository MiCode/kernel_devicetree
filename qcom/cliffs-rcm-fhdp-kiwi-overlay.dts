/dts-v1/;
/plugin/;

#include "cliffs-rcm-fhdp-kiwi.dtsi"
#include "cliffs-pm7550ba.dtsi"

/ {
	model = "Qualcomm Technologies, Inc. Cliffs RCM FHD Plus + kiwi WLAN";
	compatible = "qcom,cliffs-rcm", "qcom,cliffs", "qcom,cliffsp-rcm", "qcom,cliffsp", "qcom,rcm";
	qcom,msm-id = <614 0x10000>, <632 0x10000>, <642 0x10000>, <643 0x10000>;
	qcom,board-id = <21 2>;
};

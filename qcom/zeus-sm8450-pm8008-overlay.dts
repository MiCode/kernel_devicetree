/dts-v1/;
/plugin/;

#include "zeus-sm8450.dtsi"
#include "waipio-pm8008.dtsi"

/ {
	model = "Qualcomm Technologies, Inc. 8450 zeus";
	compatible = "qcom,waipio-mtp", "qcom,waipio", "qcom,mtp";
	qcom,msm-id = <457 0x10000>, <482 0x10000>;
	qcom,board-id = <0x10008 0>;
	xiaomi,board-id = <0x1 0>;
};

/dts-v1/;

#include "crow-oemvm.dtsi"
#include "crow-oemvm-idp-rcm.dtsi"

/ {
	model = "Qualcomm Technologies, Inc. Crow OEM VM IDP RCM";
	compatible = "qcom,crow-idp", "qcom,crow", "qcom,idp";
	qcom,board-id = <34 4>;
};

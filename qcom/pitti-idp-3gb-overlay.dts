/dts-v1/;
/plugin/;

#include "pitti-idp-3gb.dtsi"
#include "pitti-pm7250b.dtsi"

/ {
	model = "Qualcomm Technologies, Inc. Pitti IDP 3GB DDR";
	compatible = "qcom,pitti-idp", "qcom,pitti", "qcom,idp";
	qcom,msm-id = <623 0x10000>;
	qcom,board-id = <34 0x501>;
};

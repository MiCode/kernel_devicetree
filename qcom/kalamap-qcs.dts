/dts-v1/;

#include "kalamap-qcs.dtsi"

/ {
	model = "Qualcomm Technologies, Inc. KalamaP QCS SoC";
	compatible = "qcom,kalamap";
	qcom,board-id = <0 0>;
};

&pcie0 {
	/delete-property/ qcom,config-recovery;
	/delete-property/ qcom,drv-name;
	/delete-property/ msi-map;
};

&pcie1 {
	/delete-property/ qcom,drv-name;
	/delete-property/ msi-map;
};

&pcie1_rp {
	/delete-node/ mhi_0;
};

// SPDX-License-Identifier: BSD-3-Clause
/*
 * Copyright (c) Qualcomm Technologies, Inc. and/or its subsidiaries.
 */

#include "sun-v2.dtsi"

/ {
	model = "Qualcomm Technologies, Inc. SunP v2 SoC";
	compatible = "qcom,sunp";
	qcom,msm-id = <639 0x20000>, <705 0x20000>, <706 0x20000>;
};

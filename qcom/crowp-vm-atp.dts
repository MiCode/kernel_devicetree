/dts-v1/;

#include "crowp-vm.dtsi"
#include "crowp-vm-atp.dtsi"

/ {
	model = "Qualcomm Technologies, Inc. CrowP VM ATP";
	compatible = "qcom,crowp-atp", "qcom,crowp", "qcom,atp";
	qcom,board-id = <33 0>;
};

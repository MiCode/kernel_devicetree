#include "bengal.dtsi"
#include "bengal-pmi632.dtsi"

/ {
	model = "Qualcomm Technologies, Inc. BENGAL-IOT";
	compatible = "qcom,bengal-iot";
	qcom,msm-id = <469 0x0>, <469 0x10000>;
	qcom,msm-name = "BENGAL-IOT";
};

/dts-v1/;
/plugin/;

#include "kalamap-hhg.dtsi"

/ {
	model = "Qualcomm Technologies, Inc. KalamaP HHG";
	compatible = "qcom,kalamap-hhg", "qcom,kalamap", "qcom,hhg";
	qcom,msm-id = <536 0x10000>, <536 0x20000>;
	qcom,board-id = <0x1001f 0x1>;
};

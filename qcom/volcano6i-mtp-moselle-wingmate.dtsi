#include "volcano-mtp.dtsi"

&pcie0 {
	status = "disabled";
};


&qupv3_se0_i2c {
	focaltech@38 {
		focaltech,qts_en;
		qts,trusted-touch-mode = "vm_mode";
		qts,touch-environment = "pvm";
		qts,trusted-touch-type = "primary";
		qts,trusted-touch-spi-irq = <598>;
		qts,trusted-touch-io-bases = <0xa80000>;
		qts,trusted-touch-io-sizes = <0x1000>;
		qts,trusted-touch-vm-gpio-list = <&tlmm 0 0 &tlmm 1 0 &tlmm 2 0
						&tlmm 3 0 &tlmm 20 0 &tlmm 19 0x2008>;
	};
};

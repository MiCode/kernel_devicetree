// SPDX-License-Identifier: BSD-3-Clause
/*
 * Copyright (c) 2024 Qualcomm Innovation Center, Inc. All rights reserved.
 */

/dts-v1/;

#include "canoe-oemvm.dtsi"
#include "canoe-oemvm-rumi.dtsi"

/ {
	model = "Qualcomm Technologies, Inc. Canoe OEMVM RUMI";
	compatible = "qcom,canoe-rumi", "qcom,canoe", "qcom,rumi";
	qcom,board-id = <15 0>;
};

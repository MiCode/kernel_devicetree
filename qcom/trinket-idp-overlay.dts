/dts-v1/;
/plugin/;

#include <dt-bindings/interrupt-controller/arm-gic.h>
#include <dt-bindings/clock/qcom,gcc-trinket.h>
#include "trinket-idp.dtsi"
#include "trinket-audio-overlay.dtsi"

/ {
	model = "IDP";
	compatible = "qcom,trinket-idp", "qcom,trinket", "qcom,idp";
	qcom,msm-id = <394 0x10000>;
	qcom,board-id = <34 0>;
};

// SPDX-License-Identifier: BSD-3-Clause
/*
 * Copyright (c) 2024 Qualcomm Innovation Center, Inc. All rights reserved.
 */

#include "ravelin.dtsi"
#include "ravelin-low-memory.dtsi"
/ {
};

&mem_client_3_size {
	qcom,peripheral-size = <0x200000>;
};

&soc {
};

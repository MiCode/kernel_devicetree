// SPDX-License-Identifier: BSD-3-Clause
/*
 * Copyright (c) 2024 Qualcomm Innovation Center, Inc. All rights reserved.
 */

#include "sun-tp.dtsi"

/ {
	model = "Qualcomm Technologies, Inc. SunP Alt. Thermal Profile SoC";
	compatible = "qcom,sunp";
	qcom,msm-id = <0x100027f 0x10000>;
};

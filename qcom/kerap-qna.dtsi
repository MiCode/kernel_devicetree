// SPDX-License-Identifier: BSD-3-Clause
/*
 * Copyright (c) Qualcomm Technologies, Inc. and/or its subsidiaries.
 */

#include "kerap.dtsi"

/ {
	model = "Qualcomm Technologies, Inc. KeraP QNA SoC";
	compatible = "qcom,kerap-qna";
	qcom,msm-id = <721 0x10000>;
};

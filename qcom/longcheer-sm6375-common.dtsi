/* longcheer-sm6375-common.dtsi */
&soc {
    mtdoops_pmsg@0xd0000000 {
        compatible = "xiaomi,mtdoops_pmsg";
        reg = <0xd0000000 0x00200000>;
        console-size = <0x80000>;
        pmsg-size = <0x100000>;
    };

    wifi_ant_check {
        compatible = "wifi_ant_check";
        label      = "wifi_ant_check";
        gpio       = <&tlmm 97 GPIO_ACTIVE_LOW>;
        status     = "ok";
    };
};

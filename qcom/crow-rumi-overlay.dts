/dts-v1/;
/plugin/;

#include "crow-rumi.dtsi"

/ {
	model = "Qualcomm Technologies, Inc. Crow RUMI";
	compatible = "qcom,crow-rumi", "qcom,crow", "qcom,rumi";
	qcom,msm-id = <608 0x10000>, <644 0x10000>;
	qcom,board-id = <0x1000F 0>;
};

/dts-v1/;

#include "qcs605-lc.dtsi"
#include "qcs605-lc-ipcamera.dtsi"

/ {
	model = "Qualcomm Technologies, Inc. QC605 LC Groot + PM8005 IPC";
	compatible = "qcom,qcs605-mtp", "qcom,qcs605", "qcom,mtp";
	qcom,msm-id = <347 0x0>;
	qcom,board-id = <8 6>;
};

/dts-v1/;

#include "crowp-oemvm.dtsi"
#include "crowp-oemvm-idp-wcd9395-wcd-dmic.dtsi"

/ {
	model = "Qualcomm Technologies, Inc. CrowP OEM VM IDP + WCD9395 WCD-DMIC";
	compatible = "qcom,crowp-idp", "qcom,crowp", "qcom,idp";
	qcom,board-id = <34 1>;
};

/dts-v1/;

#include "volcano-vm.dtsi"
#include "volcano-vm-atp.dtsi"

/ {
	model = "Qualcomm Technologies, Inc. Volcano SVM ATP";
	compatible = "qcom,volcano-atp", "qcom,volcano", "qcom,atp";
	qcom,board-id = <33 0>;
};

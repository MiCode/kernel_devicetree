/dts-v1/;
/plugin/;

#include "direwolf-vm.dtsi"
#include "direwolf-vm-la.dtsi"

/ {
	model = "Qualcomm Technologies, Inc. Direwolf Single LA Virtual Machine";
	compatible = "qcom,direwolf", "qcom,quinvm";
	qcom,msm-id = <460 0x10000>;
	qcom,board-id = <0 0x1000001>;
};

// SPDX-License-Identifier: BSD-3-Clause
/*
 * Copyright (c) 2024 Qualcomm Innovation Center, Inc. All rights reserved.
 */
/dts-v1/;

#include "sun-vm.dtsi"
#include "sun-vm-mtp-v8.dtsi"

/ {
	model = "Qualcomm Technologies, Inc. Sun SVM MTP-V8";
	compatible = "qcom,sun-mtp", "qcom,sun", "qcom,mtp";
	qcom,board-id = <0x40008 0>;
};

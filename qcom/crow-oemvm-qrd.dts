/dts-v1/;

#include "crow-oemvm.dtsi"
#include "crow-oemvm-qrd.dtsi"

/ {
	model = "Qualcomm Technologies, Inc. Crow OEM VM QRD";
	compatible = "qcom,crow-qrd", "qcom,crow", "qcom,qrd";
	qcom,board-id = <11 0>;
};

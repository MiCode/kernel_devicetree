/dts-v1/;
/plugin/;

#include "pitti-idp-90fps.dtsi"
#include "pitti-pmiv0104.dtsi"

/ {
	model = "Qualcomm Technologies, Inc. Pitti IDP 90fps pmiv0104 Display";
	compatible = "qcom,pitti-idp", "qcom,pitti", "qcom,idp";
	qcom,msm-id = <623 0x10000>;
	qcom,board-id = <34 4>;
};

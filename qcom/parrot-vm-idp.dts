// SPDX-License-Identifier: BSD-3-Clause
/*
 * Copyright (c) 2024 Qualcomm Innovation Center, Inc. All rights reserved.
 */

/dts-v1/;

#include "parrot-vm.dtsi"
#include "parrot-vm-idp.dtsi"

/ {
	model = "Qualcomm Technologies, Inc. Parrot SVM IDP";
	compatible = "qcom,parrot-idp", "qcom,parrot", "qcom,idp";
	qcom,board-id = <34 0>;
};

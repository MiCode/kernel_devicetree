// SPDX-License-Identifier: BSD-3-Clause
/*
 * Copyright (c) 2024 Qualcomm Innovation Center, Inc. All rights reserved.
 */

/dts-v1/;

#include "ravelin-sg.dtsi"
#include "ravelin-sg-atp.dtsi"

/ {
	model = "Qualcomm Technologies, Inc. Ravelin SG ATP";
	compatible = "qcom,ravelin-atp", "qcom,ravelin", "qcom,atp";
	qcom,board-id = <33 0>;
};


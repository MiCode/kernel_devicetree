// SPDX-License-Identifier: BSD-3-Clause
/*
 * Copyright (c) 2022-2023 Qualcomm Innovation Center, Inc. All rights reserved.
 */
/dts-v1/;

#include "pineapple-oemvm.dtsi"
#include "pineapple-oemvm-rumi.dtsi"

/ {
	model = "Qualcomm Technologies, Inc. Pineapple OEMVM RUMI";
	compatible = "qcom,pineapple-rumi", "qcom,pineapple", "qcom,rumi";
	qcom,board-id = <15 0>;
};

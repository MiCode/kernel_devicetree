/dts-v1/;

#include "kalama-vm.dtsi"
#include "kalama-vm-qrd.dtsi"

/ {
	model = "Qualcomm Technologies, Inc. Kalama SVM QRD";
	compatible = "qcom,kalama-qrd", "qcom,kalama", "qcom,qrd";
	qcom,board-id = <0x1000b 0>;
};

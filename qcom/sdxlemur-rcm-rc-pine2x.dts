/dts-v1/;

#include "sdxlemur.dtsi"
#include "sdxlemur-rcm-rc.dtsi"
#include "sdxlemur-rcm-rc-pine2x.dtsi"
#include "sdxlemur-1024mb.dtsi"

/ {
	model = "Qualcomm Technologies, Inc. SDXLEMUR RCM Root Complex 2x Pine";
	compatible = "qcom,sdxlemur-rcm",
		"qcom,sdxlemur", "qcom,rcm";
	qcom,board-id = <0x3010015 0x303>;
};

// SPDX-License-Identifier: BSD-3-Clause
/*
 * Copyright (c) Qualcomm Technologies, Inc. and/or its subsidiaries.
 */
&arch_timer {
	clock-frequency = <192000>;
};

&memtimer {
	clock-frequency = <192000>;
};

/dts-v1/;

#include "cliffs-vm.dtsi"
#include "cliffs-vm-atp.dtsi"

/ {
	model = "Qualcomm Technologies, Inc. Cliffs SVM ATP";
	compatible = "qcom,cliffs-atp", "qcom,cliffs", "qcom,atp";
	qcom,board-id = <33 0>;
};

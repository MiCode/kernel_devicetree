/dts-v1/;
/plugin/;

#include "volcano6i-mtp-STSafe320-brahma.dtsi"
#include "volcano-pmiv0104.dtsi"

/ {
	model = "Qualcomm Technologies, Inc. Volcano6I MTP + STSafe320 eSE + Brahma";
	compatible = "qcom,volcano-mtp", "qcom,volcano", "qcom,volcanop-mtp", "qcom,volcanop", "qcom,mtp";
	qcom,board-id = <8 11>;
	qcom,msm-id = <0X4000291 0x10000>, <0x8000291 0x10000>, <0xc000291 0x10000>, <0x10000291 0x10000>;
};

&pmiv0104_eusb2_repeater {
	status = "ok";
	vdd18-supply = <&L7B>;
	vdd3-supply = <&L17B>;
};

&eusb2_phy0 {
	dummy-supply = <&pmiv0104_eusb2_repeater>;
	usb-repeater = <&pmiv0104_eusb2_repeater>;
};

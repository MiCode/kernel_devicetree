// SPDX-License-Identifier: BSD-3-Clause
/*
 * Copyright (c) 2024 Qualcomm Innovation Center, Inc. All rights reserved.
 */

/dts-v1/;

#include "sun-vm.dtsi"
#include "sun-vm-rcm.dtsi"

/ {
	model = "Qualcomm Technologies, Inc. SUN SVM RCM";
	compatible = "qcom,sun-rcm", "qcom,sun", "qcom,rcm";
	qcom,board-id = <0x15 0>;
};

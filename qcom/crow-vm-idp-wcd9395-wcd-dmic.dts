/dts-v1/;

#include "crow-vm.dtsi"
#include "crow-vm-idp-wcd9395-wcd-dmic.dtsi"

/ {
	model = "Qualcomm Technologies, Inc. Crow VM IDP + WCD9395 WCD-DMIC";
	compatible = "qcom,crow-idp", "qcom,crow", "qcom,idp";
	qcom,board-id = <34 1>;
};

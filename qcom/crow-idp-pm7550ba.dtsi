#include "crow-pm7550ba.dtsi"

&pm7550ba_eusb2_repeater {
	vdd18-supply = <&L7B>;
	vdd3-supply = <&L17B>;
	status = "ok";
};

&eusb2_phy0 {
	dummy-supply = <&pm7550ba_eusb2_repeater>;
	usb-repeater = <&pm7550ba_eusb2_repeater>;
};

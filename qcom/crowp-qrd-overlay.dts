/dts-v1/;
/plugin/;

#include "crowp-qrd.dtsi"
#include "crow-qrd-pm7550ba.dtsi"

/ {
	model = "Qualcomm Technologies, Inc. Crowp QRD";
	compatible = "qcom,crowp-qrd", "qcom,crowp", "qcom,qrd";
	qcom,msm-id = <687 0x10000>;
	qcom,board-id = <11 0>;
};

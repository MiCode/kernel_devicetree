// SPDX-License-Identifier: BSD-3-Clause
/*
 * Copyright (c) 2022-2023 Qualcomm Innovation Center, Inc. All rights reserved.
 */
/dts-v1/;

#include "pineapple-vm.dtsi"
#include "pineapple-vm-cdp.dtsi"

/ {
	model = "Qualcomm Technologies, Inc. Pineapple SVM CDP";
	compatible = "qcom,pineapple-cdp", "qcom,pineapple", "qcom,cdp";
	qcom,board-id = <0x10001 0>;
};

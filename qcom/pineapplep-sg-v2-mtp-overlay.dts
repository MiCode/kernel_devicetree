/dts-v1/;
/plugin/;

#include "pineapplep-sg-v2-mtp.dtsi"

/ {
	model = "Qualcomm Technologies, Inc. PineappleP SG V2 MTP";
	compatible = "qcom,pineapplep-mtp", "qcom,pineapplep", "qcom,mtp";
	qcom,msm-id = <682 0x20000>;
	qcom,board-id = <8 0>;
};

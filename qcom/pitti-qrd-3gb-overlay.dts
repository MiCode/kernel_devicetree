/dts-v1/;
/plugin/;

#include "pitti-qrd-3gb.dtsi"

/ {
	model = "Qualcomm Technologies, Inc. Pitti QRD 3GB DDR";
	compatible = "qcom,pitti-qrd", "qcom,pitti", "qcom,qrd";
	qcom,msm-id = <623 0x10000>;
	qcom,board-id = <11 0x501>;
};

/dts-v1/;
/plugin/;

#include "blairp-atp.dtsi"

/ {
	model = "Qualcomm Technologies, Inc. Blairp ATP";
	compatible = "qcom,blairp-atp", "qcom,blairp", "qcom,atp";
	qcom,msm-id = <565 0x10000>;
	qcom,board-id = <33 0>;
};

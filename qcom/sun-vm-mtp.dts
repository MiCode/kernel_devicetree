// SPDX-License-Identifier: BSD-3-Clause
/*
 * Copyright (c) 2023-2024 Qualcomm Innovation Center, Inc. All rights reserved.
 */
/dts-v1/;

#include "sun-vm.dtsi"
#include "sun-vm-mtp.dtsi"

/ {
	model = "Qualcomm Technologies, Inc. Sun SVM MTP";
	compatible = "qcom,sun-mtp", "qcom,sun", "qcom,sunp-mtp",
			"qcom,sunp", "qcom,mtp";
	qcom,board-id = <8 0>;
};

// SPDX-License-Identifier: BSD-3-Clause
/*
 * Copyright (c) 2024 Qualcomm Innovation Center, Inc. All rights reserved.
 */

/dts-v1/;

#include "tuna-oemvm.dtsi"
#include "tuna-oemvm-cdp.dtsi"

/ {
	model = "Qualcomm Technologies, Inc. Tuna OEMVM CDP";
	compatible = "qcom,tuna-cdp", "qcom,tuna", "qcom,tunap-cdp", "qcom,tunap",
			"qcom,cdp";

	qcom,board-id = <1 0>;
};

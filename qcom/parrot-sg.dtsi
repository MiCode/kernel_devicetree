// SPDX-License-Identifier: BSD-3-Clause
/*
 * Copyright (c) 2024 Qualcomm Innovation Center, Inc. All rights reserved.
 */

#include "parrot.dtsi"

/ {

	model = "Qualcomm Technologies, Inc. Parrot SG";
	compatible = "qcom,parrot";
	qcom,msm-id = <633 0x10000>;
};

&msm_gpu {
	/delete-property/qcom,gpu-model;
	qcom,gpu-model = "AdrenoA21v1";
};

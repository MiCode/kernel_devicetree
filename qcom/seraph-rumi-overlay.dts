/dts-v1/;
/plugin/;

/*/memreserve/ 0x90000000 0x00000100;*/

#include "seraph-rumi.dtsi"

/ {
	model = "Qualcomm Technologies, Inc. Seraph RUMI";
	compatible = "qcom,seraph-rumi", "qcom,seraph", "qcom,rumi";
	qcom,msm-id = <672 0x10000>;
	qcom,board-id = <15 0>;
};


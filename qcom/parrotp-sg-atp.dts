// SPDX-License-Identifier: BSD-3-Clause
/*
 * Copyright (c) 2024 Qualcomm Innovation Center, Inc. All rights reserved.
 */

/dts-v1/;

#include "parrotp-sg.dtsi"
#include "parrotp-sg-atp.dtsi"

/ {
	model = "Qualcomm Technologies, Inc. ParrotP SG ATP";
	compatible = "qcom,parrotp-atp", "qcom,parrotp", "qcom,atp";
	qcom,board-id = <33 0>;
};

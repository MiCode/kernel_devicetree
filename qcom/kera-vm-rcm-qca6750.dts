// SPDX-License-Identifier: BSD-3-Clause
/*
 * Copyright (c) Qualcomm Technologies, Inc. and/or its subsidiaries.
 */

/dts-v1/;

#include "kera-vm.dtsi"
#include "kera-vm-rcm-qca6750.dtsi"

/ {
	model = "Qualcomm Technologies, Inc. Kera SVM RCM + QCA6750";
	compatible = "qcom,kera-rcm", "qcom,kera", "qcom,kerap-rcm", "qcom,kerap",
			"qcom,rcm", "qcom,kera-qmb", "qcom,kerap-qna";
	qcom,board-id = <0x10015 0>, <0x20015 0>, <0x30015 0>;
};

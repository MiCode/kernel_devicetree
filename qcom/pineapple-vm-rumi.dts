// SPDX-License-Identifier: BSD-3-Clause
/*
 * Copyright (c) 2022-2023 Qualcomm Innovation Center, Inc. All rights reserved.
 */
/dts-v1/;

#include "pineapple-vm.dtsi"
#include "pineapple-vm-rumi.dtsi"

/ {
	model = "Qualcomm Technologies, Inc. Pineapple SVM RUMI";
	compatible = "qcom,pineapple-rumi", "qcom,pineapple", "qcom,rumi";
	qcom,board-id = <15 0>;
};

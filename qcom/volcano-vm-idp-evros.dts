/dts-v1/;

#include "volcano-vm.dtsi"
#include "volcano-vm-idp.dtsi"

/ {
	model = "Qualcomm Technologies, Inc. Volcano SVM idp + Evros";
	compatible = "qcom,volcano-idp", "qcom,volcano", "qcom,idp";
	qcom,board-id = <34 4>;
};

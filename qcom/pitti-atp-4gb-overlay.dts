/dts-v1/;
/plugin/;

#include "pitti-atp-4gb.dtsi"

/ {
	model = "Qualcomm Technologies, Inc. Pitti ATP 4GB DDR";
	compatible = "qcom,pitti-atp", "qcom,pitti", "qcom,atp";
	qcom,msm-id = <623 0x10000>;
	qcom,board-id = <33 0x600>;
};

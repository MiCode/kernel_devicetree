/dts-v1/;

#include "volcano-vm.dtsi"
#include "volcano-vm-idp-wcd9395.dtsi"

/ {
	model = "Qualcomm Technologies, Inc. Volcano SVM IDP + WCD9395";
	compatible = "qcom,volcano-idp", "qcom,volcano", "qcom,idp";
	qcom,board-id = <34 1>;
};

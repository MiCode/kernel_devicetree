// SPDX-License-Identifier: BSD-3-Clause
/*
 * Copyright (c) 2024 Qualcomm Innovation Center, Inc. All rights reserved.
 */

#include "monaco.dtsi"

/ {
	model = "Qualcomm Technologies, Inc. MonacoP";
	compatible = "qcom,monacop";
	qcom,msm-id = <517 0x10000>;
};


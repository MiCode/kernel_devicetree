// SPDX-License-Identifier: BSD-3-Clause
/*
 * Copyright (c) 2022-2023 Qualcomm Innovation Center, Inc. All rights reserved.
 */

/dts-v1/;

#include "sunp.dtsi"

/ {
	model = "Qualcomm Technologies, Inc. SunP SoC";
	compatible = "qcom,sunp";
	qcom,board-id = <0 0>;
};

// SPDX-License-Identifier: BSD-3-Clause
/*
 * Copyright (c) Qualcomm Technologies, Inc. and/or its subsidiaries.
 */

/dts-v1/;

#include "montaguep.dtsi"

/ {
	model = "Qualcomm Technologies, Inc. MontagueP SoC";
	compatible = "qcom,montaguep";
	qcom,board-id = <0 0>;
};


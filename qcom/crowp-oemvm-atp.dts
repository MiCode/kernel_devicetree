/dts-v1/;

#include "crowp-oemvm.dtsi"
#include "crowp-oemvm-atp.dtsi"

/ {
	model = "Qualcomm Technologies, Inc. CrowP OEM VM ATP";
	compatible = "qcom,crowp-atp", "qcom,crowp", "qcom,atp";
	qcom,board-id = <33 0>;
};

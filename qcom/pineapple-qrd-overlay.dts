/dts-v1/;
/plugin/;

#include "pineapple-qrd.dtsi"

/ {
	model = "Qualcomm Technologies, Inc. Pineapple QRD";
	compatible = "qcom,pineapple-qrd", "qcom,pineapple", "qcom,qrd";
	qcom,msm-id = <557 0x10000>, <557 0x20000>;
	qcom,board-id = <11 0>;
};

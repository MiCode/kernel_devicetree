/dts-v1/;

#include "sdxlemur-v2.dtsi"
#include "sdxlemur-mtp-mbb-pcie-ep-ipq.dtsi"
#include "sdxlemur-512mb.dtsi"

/ {
	model = "Qualcomm Technologies, Inc. SDXLEMUR MTP MBB PCIE-EP V2";
	compatible = "qcom,sdxlemur-mtp",
		"qcom,sdxlemur", "qcom,mtp";
	qcom,board-id = <0xB020008 0x20B>;
};

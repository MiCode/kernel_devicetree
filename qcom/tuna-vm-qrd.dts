// SPDX-License-Identifier: BSD-3-Clause
/*
 * Copyright (c) 2024 Qualcomm Innovation Center, Inc. All rights reserved.
 */

/dts-v1/;

#include "tuna-vm.dtsi"
#include "tuna-vm-qrd.dtsi"

/ {
	model = "Qualcomm Technologies, Inc. Tuna SVM QRD";
	compatible = "qcom,tuna-qrd", "qcom,tuna", "qcom,tunap-qrd", "qcom,tunap",
			"qcom,qrd";
	qcom,board-id = <11 0>;
};

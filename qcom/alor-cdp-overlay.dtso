// SPDX-License-Identifier: BSD-3-Clause
/*
 * Copyright (c) 2025 Qualcomm Innovation Center, Inc. All rights reserved.
 */

/dts-v1/;
/plugin/;

#include "alor-cdp.dtsi"

/ {
	model = "Qualcomm Technologies, Inc. Alor CDP + WCN7750 WLAN + Kundu";
	compatible = "qcom,alor-cdp", "qcom,alor", "qcom,cdp";
	qcom,msm-id = <685 0x10000>;
	qcom,board-id = <0x10001 0>;
};

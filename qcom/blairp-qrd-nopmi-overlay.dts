/dts-v1/;
/plugin/;

#include "blairp-qrd-nopmi.dtsi"

/ {
	model = "Qualcomm Technologies, Inc. Blairp QRD NOPMI";
	compatible = "qcom,blairp-qrd", "qcom,blairp", "qcom,qrd";
	qcom,msm-id = <565 0x10000>;
	qcom,board-id = <0x1000B 0>;
};


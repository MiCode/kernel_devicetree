// SPDX-License-Identifier: BSD-3-Clause
/*
 * Copyright (c) Qualcomm Technologies, Inc. and/or its subsidiaries.
 */

/dts-v1/;
/plugin/;

#include "malabar-rumi.dtsi"

/ {
	model = "Qualcomm technologies, Inc. MALABAR RUMI";
	compatible = "qcom,malabar-rumi", "qcom,malabar", "qcom,rumi";
	qcom,msm-id = <733 0x10000>;
};


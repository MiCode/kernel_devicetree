#include "yupik-idp.dtsi"
#include "qcx6490-cnss.dtsi"

&wlan {
	reg = <0xb0000000 0x10000>,
	      <0xb2e5510 0x5c0>;
	reg-names = "smmu_iova_ipa", "tcs_cmd";
	qcom,same-dt-multi-dev;
	qcom,sw-ctrl-gpio = <&tlmm 86 0>;
	use-pm-domain;
	cnss-enable-self-recovery;
	/* RPMH_PDC_WLAN_RF_TCS<6>_CMD<0> offset */
	qcom,tcs_offset_int_pow_amp_vreg = <0x4B0>;
};

&pcie0 {
	status = "ok";
};

&pcie0_msi {
	status = "ok";
};

&bluetooth {
	compatible = "qcom,qca6490";
};

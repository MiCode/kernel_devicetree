/dts-v1/;
/plugin/;

#include "blair-mtp-usbc.dtsi"
#include "holi-mtp-pm7250b.dtsi"

/ {
	model = "Qualcomm Technologies, Inc. Blair MTP USBC audio";
	compatible = "qcom,blair-mtp", "qcom,blair", "qcom,mtp";
	qcom,msm-id = <507 0x10000>, <578 0x10000>;
	qcom,board-id = <8 1>;
};

&pm7250b_charger {
	dpdm-supply = <&usb2_phy0>;
};

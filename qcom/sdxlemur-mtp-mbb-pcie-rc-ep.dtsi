#include "sdxlemur-mtp.dtsi"

&soc {

};

&pcie0_rp {
	#address-cells = <5>;
	#size-cells = <0>;

	pcie0_generic_ep: pcie0_rp_ep {
		reg = <0 0 0 0 0>;
		qcom,iommu-group = <&pcie0_generic_ep_iommu_group>;

		#address-cells = <1>;
		#size-cells = <1>;

		pcie0_generic_ep_iommu_group: pcie0_generic_ep_iommu_group {
			qcom,iommu-dma = "atomic";
		};
	};
};

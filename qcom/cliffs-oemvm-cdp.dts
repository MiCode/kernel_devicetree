/dts-v1/;

#include "cliffs-oemvm.dtsi"
#include "cliffs-oemvm-cdp.dtsi"

/ {
	model = "Qualcomm Technologies, Inc. Cliffs OEMVM CDP";
	compatible = "qcom,cliffs-cdp", "qcom,cliffs", "qcom,cdp";
	qcom,board-id = <1 0>;
};

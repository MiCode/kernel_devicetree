/dts-v1/;
/plugin/;

/memreserve/ 0x90000000 0x00000100;

#include "niobe-rumi.dtsi"

/ {
	model = "Qualcomm Technologies, Inc. Niobe RUMI";
	compatible = "qcom,niobe-rumi", "qcom,niobe", "qcom,rumi";
	qcom,msm-id = <629 0x10000>;
	qcom,board-id = <15 0>;
};

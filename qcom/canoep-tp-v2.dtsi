// SPDX-License-Identifier: BSD-3-Clause
/*
 * Copyright (c) 2024 Qualcomm Innovation Center, Inc. All rights reserved.
 */

#include "canoep-v2.dtsi"
#include "canoe-tp-v2.dtsi"

/ {
		model = "Qualcomm Technologies, Inc. CanoeP Alt. Thermal Profile v2 SoC";
		compatible = "qcom,canoep";
		qcom,msm-id = <0x1010295 0x20000>;
};

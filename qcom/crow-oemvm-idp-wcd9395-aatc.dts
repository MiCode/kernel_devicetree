/dts-v1/;

#include "crow-oemvm.dtsi"
#include "crow-oemvm-idp-wcd9395-aatc.dtsi"

/{
	model = "Qualcomm Technologies, Inc. OEM VM Crow IDP + WCD9395 AATC";
	compatible = "qcom,crow-idp", "qcom,crow", "qcom,idp";
	qcom,board-id = <34 3>;
};

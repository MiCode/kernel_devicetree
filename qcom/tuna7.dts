// SPDX-License-Identifier: BSD-3-Clause
/*
 * Copyright (c) 2024 Qualcomm Innovation Center, Inc. All rights reserved.
 */

/dts-v1/;

#include "tuna7.dtsi"
/ {
	model = "Qualcomm Technologies, Inc. Tuna 7 SoC";
	compatible = "qcom,tuna";
	qcom,board-id = <0 0>;
};

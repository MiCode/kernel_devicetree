/dts-v1/;
/plugin/;

#include "kalama-cdp.dtsi"
#include "sdxbaagha-external-soc.dtsi"
#include "kalama-baagha.dtsi"

/ {
	model = "KALAMA BAAGHA CDP";
	compatible = "qcom,kalama-cdp", "qcom,kalama", "qcom,cdp";
	qcom,msm-id = <519 0x10000>, <536 0x10000>;
	qcom,board-id = <0x04010001 0x4>;
};

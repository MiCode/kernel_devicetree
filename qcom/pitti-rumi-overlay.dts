/dts-v1/;
/plugin/;

#include "pitti-rumi.dtsi"

/ {
	model = "Qualcomm Technologies, Inc. Pitti RUMI";
	compatible = "qcom,pitti-rumi", "qcom,pitti", "qcom,rumi";
	qcom,msm-id = <623 0x10000>;
	qcom,board-id = <15 0>;
};

&soc {
	/* QUPv3_1  wrapper  instance */
	qupv3_1: qcom,qupv3_1_geni_se@ac0000 {
		compatible = "qcom,geni-se-qup";
		reg = <0x00ac0000 0x2000>;
		clock-names = "m-ahb", "s-ahb";
		clocks = <&gcc GCC_QUPV3_WRAP_1_M_AHB_CLK>,
			<&gcc GCC_QUPV3_WRAP_1_S_AHB_CLK>;
		#address-cells = <1>;
		#size-cells = <1>;
		ranges;
		status = "ok";

		/*PORed Debug UART Instance */
		qupv3_se7_2uart: qcom,qup_uart@a9c000 {
			compatible = "qcom,geni-debug-uart";
			reg = <0xa9c000 0x4000>;
			reg-names = "se_phys";
			interrupts = <GIC_SPI 579 IRQ_TYPE_LEVEL_HIGH>;
			clock-names = "se", "m-ahb", "s-ahb";
			clocks = <&gcc GCC_QUPV3_WRAP1_S7_CLK>,
				<&gcc GCC_QUPV3_WRAP_1_M_AHB_CLK>,
				<&gcc GCC_QUPV3_WRAP_1_S_AHB_CLK>;

			pinctrl-names = "default", "sleep";
			pinctrl-0 = <&qupv3_se7_2uart_active>;
			pinctrl-1 = <&qupv3_se7_2uart_sleep>;
		};
	};
};

&qupv3_se1_i2c {
    #address-cells = <1>;
    #size-cells = <0>;

    sc8315_charger: sc8315@77 {
        compatible = "southchip,sc8315";
        reg = <0x77>;
        status = "okay";
        sc,sc8315,device_en = <1>; /*0:disable 1:enable*/
        sc,sc8315,vout = <0x0B>; /*2850 + val * 50, unit:mV def:3400mv*/
        sc,sc8315,ilim = <0x06>; /*4000 + val * 500, unit:mV def:7000mv*/
        sc,sc8315,ilin1_set = <0x00>; /*250 + val * 50, unit:mV def:250*/
        halo,hl7603a-vout-voltage = <0x0F>;
    };
};

// SPDX-License-Identifier: BSD-3-Clause
/*
 * Copyright (c) 2025 Qualcomm Innovation Center, Inc. All rights reserved.
 */

/dts-v1/;
/plugin/;

#include <dt-bindings/interconnect/qcom,yupik.h>
#include "yupikp-idp.dtsi"

/ {
	model = "Qualcomm Technologies, Inc. YUPIKP-IOT IDP";
	compatible = "qcom,yupikp-iot-idp", "qcom,yupikp-iot", "qcom,idp";
	qcom,msm-id = <498 0x10000>, <575 0x10000>, <576 0x10000>;
	qcom,board-id = <34 0>;
};

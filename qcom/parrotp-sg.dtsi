// SPDX-License-Identifier: BSD-3-Clause
/*
 * Copyright (c) 2024 Qualcomm Innovation Center, Inc. All rights reserved.
 */

#include "parrot-sg.dtsi"

/ {

	model = "Qualcomm Technologies, Inc. ParrotP SG";
	compatible = "qcom,parrotp";
	qcom,msm-id = <634 0x10000>;
};

&msm_gpu {
	/delete-property/qcom,gpu-model;
	qcom,gpu-model = "AdrenoA21v1";
};

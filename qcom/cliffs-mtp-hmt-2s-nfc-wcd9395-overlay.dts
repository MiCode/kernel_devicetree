/dts-v1/;
/plugin/;

#include "cliffs-mtp-hmt-2s-nfc-wcd9395.dtsi"
#include "cliffs-pm7550ba.dtsi"

/ {
	model = "Qualcomm Technologies, Inc. Cliffs MTP + HMT + 2S + NFC + WCD9395";
	compatible = "qcom,cliffs-mtp", "qcom,cliffs", "qcom,mtp";
	qcom,msm-id = <614 0x10000>, <632 0x10000>;
	qcom,board-id = <8 1>;
};

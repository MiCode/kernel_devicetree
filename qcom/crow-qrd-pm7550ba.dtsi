#include "crow-pm7550ba.dtsi"

&pm7550ba_eusb2_repeater {
	vdd18-supply = <&L7B>;
	vdd3-supply = <&L17B>;
	status = "ok";

	qcom,param-override-seq =
		<0xf 0x51
		 0x0 0x54
		 0x5 0x57
		 0x6 0x53
		 0x0 0x59>;
};

&eusb2_phy0 {
	dummy-supply = <&pm7550ba_eusb2_repeater>;
	usb-repeater = <&pm7550ba_eusb2_repeater>;
};


/dts-v1/;
/plugin/;

#include "volcano-oemvm.dtsi"
#include "volcano6i-oemvm-qrd-moselle.dtsi"

/ {
	model = "Qualcomm Technologies, Inc. Volcano6I OEMVM QRD +  WCD9378 AMIC + Amoled (SPI) + Moselle";
	compatible = "qcom,volcano-qrd", "qcom,volcano", "qcom,qrd";
	qcom,board-id = <11 1>;
};


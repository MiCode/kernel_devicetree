/dts-v1/;
/plugin/;

#include "cliffs-mtp-kiwi.dtsi"
#include "cliffs-pm7550ba.dtsi"

/ {
	model = "Qualcomm Technologies, Inc. Cliffs MTP + kiwi WLAN";
	compatible = "qcom,cliffs-mtp", "qcom,cliffs", "qcom,cliffsp-mtp", "qcom,cliffsp", "qcom,mtp";
	qcom,msm-id = <614 0x10000>, <632 0x10000>, <642 0x10000>, <643 0x10000>;
	qcom,board-id = <8 2>;
};

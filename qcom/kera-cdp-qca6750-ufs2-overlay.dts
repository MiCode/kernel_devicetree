// SPDX-License-Identifier: BSD-3-Clause
/*
 * Copyright (c) Qualcomm Technologies, Inc. and/or its subsidiaries.
 */

/dts-v1/;
/plugin/;

#include "kera-cdp-qca6750-ufs2.dtsi"
#include "kera-pmiv0102.dtsi"

/ {
	model = "Qualcomm Technologies, Inc. Kera CDP + QCA6750 + UFS2";
	compatible = "qcom,kera-cdp", "qcom,kera", "qcom,kerap-cdp", "qcom,kerap",
			"qcom,cdp", "qcom,kera-qmb", "qcom,kerap-qna";

	qcom,msm-id = <686 0x10000>, <659 0x10000>, <731 0x10000>, <732 0x10000>, <720 0x10000>, <721 0x10000>;
	qcom,board-id = <0x30001 0>;
};

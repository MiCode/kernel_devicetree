/dts-v1/;
/plugin/;

#include "crowp-idp.dtsi"
#include "crow-idp-pm7550ba.dtsi"

/ {
	model = "Qualcomm Technologies, Inc. Crowp IDP";
	compatible = "qcom,crowp-idp", "qcom,crowp", "qcom,idp";
	qcom,msm-id = <687 0x10000>;
	qcom,board-id = <34 0>;
};

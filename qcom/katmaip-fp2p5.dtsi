// SPDX-License-Identifier: BSD-3-Clause
/*
 * Copyright (c) Qualcomm Technologies, Inc. and/or its subsidiaries.
 */

#include "katmai-fp2p5.dtsi"

/ {
	model = "Qualcomm Technologies, Inc. KATMAIP-FP2P5 SoC";
	compatible = "qcom,yupikp-iot";
	qcom,msm-id = <575 0x10000>;
	qcom,softsku-id = <8>;
};

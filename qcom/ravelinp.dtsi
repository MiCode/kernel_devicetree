// SPDX-License-Identifier: BSD-3-Clause
/*
 * Copyright (c) 2024 Qualcomm Innovation Center, Inc. All rights reserved.
 */

#include "ravelin.dtsi"
/ {
	model = "Qualcomm Technologies, Inc. RavelinP";
	compatible = "qcom,ravelinp";
	qcom,msm-id = <602 0x10000>;
};

/dts-v1/;
/plugin/;

#include "kona-qrd-wingmate.dtsi"

/{
	model = "Qualcomm Technologies, Inc. KONA QRD WINGMATE";
	compatible = "qcom,kona-iot-qrd", "qcom,kona-iot", "qcom,kona-qrd";
	qcom,msm-id = <481 0x0>, <481 0x10000>, <481 0x20000>, <481 0x20001>;
	qcom,board-id = <0x01000B 0x05>;
};

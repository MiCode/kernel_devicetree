// SPDX-License-Identifier: BSD-3-Clause
/*
 * Copyright (c) 2025 Qualcomm Innovation Center, Inc. All rights reserved.
 */

#include "vienna.dtsi"

/ {
	model = "Qualcomm Technologies, Inc. ViennaP SoC";
	compatible = "qcom,viennap";
	qcom,msm-id = <670 0x10000>;
};

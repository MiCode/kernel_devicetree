/dts-v1/;

#include "crow-vm.dtsi"
#include "crow-vm-idp-wcd9395-aatc.dtsi"

/ {
	model = "Qualcomm Technologies, Inc. VM Crow IDP + WCD9395 AATC";
	compatible = "qcom,crow-idp", "qcom,crow", "qcom,idp";
	qcom,board-id = <34 3>;
};

/dts-v1/;
/plugin/;

#include "niobep.dtsi"
#include "niobep-idp.dtsi"

/ {
	model = "Qualcomm Technologies, Inc. NiobeP IDP";
	compatible = "qcom,niobep-idp", "qcom,niobep", "qcom,idp";
	qcom,board-id = <0x10022 0>;
};

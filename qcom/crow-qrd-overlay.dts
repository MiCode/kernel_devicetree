/dts-v1/;
/plugin/;

#include "crow-qrd.dtsi"
#include "crow-qrd-pm7550ba.dtsi"

/ {
	model = "Qualcomm Technologies, Inc. Crow QRD";
	compatible = "qcom,crow-qrd", "qcom,crow", "qcom,qrd";
	qcom,msm-id = <608 0x10000>, <644 0x10000>;
	qcom,board-id = <11 0>;
};

/dts-v1/;
/plugin/;

#include "sm8750-xiaomi-common.dtsi"

/ {
	model = "Qualcomm Technologies, Inc. Haotian based on SM8750";
	compatible = "qcom,sun-mtp", "qcom,sun", "qcom,sunp-mtp", "qcom,sunp", "qcom,mtp";
	qcom,msm-id = <618 0x10000>, <618 0x20000>;
	qcom,board-id = <8 0>;
};

/dts-v1/;

#include "lemans-vm.dtsi"
#include "lemans-vm-la1-mt.dtsi"

/ {
	model = "Qualcomm Technologies, Inc. Lemans Multi LA1 Guest Virtual Machine";
	compatible = "qcom,lemans", "qcom,quinvm";
	qcom,board-id = <0 0x3000001>;
};

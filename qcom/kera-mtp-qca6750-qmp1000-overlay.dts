// SPDX-License-Identifier: BSD-3-Clause
/*
 * Copyright (c) Qualcomm Technologies, Inc. and/or its subsidiaries.
 */

/dts-v1/;
/plugin/;

#include "kera-mtp-qca6750-qmp1000.dtsi"
#include "kera-pm7550ba.dtsi"

/ {
	model = "Qualcomm Technologies, Inc. Kera MTP + QCA6750 + QMP1000 + UFS3";
	compatible = "qcom,kera-mtp", "qcom,kera", "qcom,kerap-mtp", "qcom,kerap",
			 "qcom,mtp", "qcom,kera-qmb", "qcom,kerap-qna";
	qcom,msm-id = <686 0x10000>, <659 0x10000>, <731 0x10000>, <732 0x10000>, <720 0x10000>, <721 0x10000>;
	qcom,board-id = <0x30008 0>;
};

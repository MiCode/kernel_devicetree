// SPDX-License-Identifier: BSD-3-Clause
/*
 * Copyright (c) 2024 Qualcomm Innovation Center, Inc. All rights reserved.
 */

#include "tuna.dtsi"
/ {
	model = "Qualcomm Technologies, Inc. Tuna 7";
	compatible = "qcom,tuna";
	qcom,msm-id = <681 0x10000>;

};

&adsp_pas {
	firmware-name = "adsp2.mdt", "adsp2_dtb.mdt";
};

&llcc {
	compatible = "qcom,tuna7-llcc";
};

&wcd_usbss {
	interrupt-parent = <&spmi_bus>;
	interrupts = <0x0 0xb6 0x1 IRQ_TYPE_EDGE_BOTH>;
	interrupt-names = "usb_wcd";
	nvmem-cells = <&usb_mode>;
	nvmem-cell-names = "usb_mode";
	status = "ok";
};


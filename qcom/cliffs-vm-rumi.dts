/dts-v1/;

#include "cliffs-vm.dtsi"
#include "cliffs-vm-rumi.dtsi"

/ {
	model = "Qualcomm Technologies, Inc. Cliffs SVM RUMI";
	compatible = "qcom,cliffs-rumi", "qcom,cliffs", "qcom,rumi";
	qcom,board-id = <15 0>;
};

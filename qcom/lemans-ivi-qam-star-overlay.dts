/dts-v1/;
/plugin/;

#include "lemans-qam-star.dtsi"

/ {
	model = "Qualcomm Technologies, Inc. Lemans IVI QAM STAR";
	compatible = "qcom,lemans", "qcom,qam-star", "qcom,lemans-ivi", "qcom,lemans-ivi-qam-star";
	qcom,msm-id = <532 0x10000>;
	qcom,board-id = <0x10025 0>;
};


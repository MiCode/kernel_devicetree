/dts-v1/;
/plugin/;

#include "kona-mtp-wingmate.dtsi"

/{
	model = "Qualcomm Technologies, Inc. KONA MTP WINGMATE";
	compatible = "qcom,kona-mtp", "qcom,kona", "qcom,mtp";
	qcom,msm-id = <481 0x0>, <481 0x10000>, <481 0x20000>, <481 0x20001>;
	qcom,board-id = <0x010008 0x06>;
};

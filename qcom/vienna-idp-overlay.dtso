// SPDX-License-Identifier: BSD-3-Clause
/*
 * Copyright (c) 2025 Qualcomm Innovation Center, Inc. All rights reserved.
 */

/dts-v1/;
/plugin/;

#include "vienna-idp.dtsi"

/ {
	model = "Qualcomm Technologies, Inc. Vienna IDP";
	compatible = "qcom,vienna-idp", "qcom,vienna", "qcom,idp";
	qcom,board-id = <0x10022 0x0>;
};

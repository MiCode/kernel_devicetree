// SPDX-License-Identifier: BSD-3-Clause
/*
 * Copyright (c) 2024 Qualcomm Innovation Center, Inc. All rights reserved.
 */

/dts-v1/;

#include "kera-vm.dtsi"
#include "kera-vm-rumi.dtsi"

/ {
	model = "Qualcomm Technologies, Inc. Kera SVM RUMI";
	compatible = "qcom,kera-rumi", "qcom,kera", "qcom,rumi";
	qcom,board-id = <15 0>;
};

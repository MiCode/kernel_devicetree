/dts-v1/;
/plugin/;

#include "pitti-qrd.dtsi"
#include "warm-sm4635.dtsi"

/ {
	model = "Qualcomm Technologies, Inc. Warm QRD";
	compatible = "qcom,pitti-qrd", "qcom,pitti", "qcom,qrd";
	qcom,msm-id = <623 0x10000>;
	qcom,board-id = <0x2000B 0>;
};

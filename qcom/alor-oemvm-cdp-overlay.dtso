// SPDX-License-Identifier: BSD-3-Clause
/*
 * Copyright (c) Qualcomm Technologies, Inc. and/or its subsidiaries.
 */
/dts-v1/;
/plugin/;

#include "alor-oemvm-avf.dtsi"
#include "alor-oemvm-cdp-avf.dtsi"

/ {
	model = "Qualcomm Technologies, Inc. Alor OEMVM CDP";
	compatible = "qcom,alor-cdp", "qcom,alor", "qcom,alorp-cdp",
			"qcom,alorp", "qcom,cdp";
	qcom,board-id = <0x10001 0>;

	host {
	};
};

// SPDX-License-Identifier: BSD-3-Clause
/*
 * Copyright (c) 2022-2023 Qualcomm Innovation Center, Inc. All rights reserved.
 */
/dts-v1/;

#include "pineapple-vm.dtsi"
#include "pineapple-vm-mtp.dtsi"

/ {
	model = "Qualcomm Technologies, Inc. Pineapple SVM QRD";
	compatible = "qcom,pineapple-qrd", "qcom,pineapple", "qcom,qrd";
	qcom,board-id = <0x1000b 0>;
};

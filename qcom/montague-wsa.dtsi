// SPDX-License-Identifier: BSD-3-Clause
/*
 * Copyright (c) Qualcomm Technologies, Inc. and/or its subsidiaries.
 */

#include "ravelin-idp.dtsi"

&soc {
};

&pcie0 {
	status = "ok";
};

&pcie0_msi {
	status = "ok";
};

&wpss_pas {
	status = "disabled";
};

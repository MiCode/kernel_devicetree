/dts-v1/;
/memreserve/ 0x90000000 0x00001000;

#include "crow.dtsi"
#include "crow-rumi.dtsi"

/ {
	model = "Qualcomm Technologies, Inc. Crow RUMI";
	compatible = "qcom,crow-rumi", "qcom,crow", "qcom,rumi";
	qcom,board-id = <15 0>;
};

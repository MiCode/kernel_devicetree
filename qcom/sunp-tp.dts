// SPDX-License-Identifier: BSD-3-Clause
/*
 * Copyright (c) 2024 Qualcomm Innovation Center, Inc. All rights reserved.
 */

/dts-v1/;

#include "sunp.dtsi"
#include "sunp-tp.dtsi"

/ {
	model = "Qualcomm Technologies, Inc. SunP Alt. Thermal Profile SoC";
	compatible = "qcom,sunp";
	qcom,board-id = <0 0>;
};

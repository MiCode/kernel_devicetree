/dts-v1/;
/plugin/;

#include "crowp-atp.dtsi"
#include "crow-pm7550ba.dtsi"

/ {
	model = "Qualcomm Technologies, Inc. CrowP ATP";
	compatible = "qcom,crowp-atp", "qcom,crowp", "qcom,atp";
	qcom,msm-id = <687 0x10000>;
	qcom,board-id = <33 0>;
};

&pm7550ba_eusb2_repeater {
	vdd18-supply = <&L7B>;
	vdd3-supply = <&L17B>;
	status = "ok";
};

&eusb2_phy0 {
	dummy-supply = <&pm7550ba_eusb2_repeater>;
	usb-repeater = <&pm7550ba_eusb2_repeater>;
};

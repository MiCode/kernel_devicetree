// SPDX-License-Identifier: BSD-3-Clause
/*
 * Copyright (c) Qualcomm Technologies, Inc. and/or its subsidiaries.
 */

/dts-v1/;
/plugin/;

#include "katmaip-hsp-pm7250b.dtsi"

/ {
	model = "Qualcomm Technologies, Inc. KatmaiP FP3 IOT HSP + PM7250B";
	compatible = "qcom,yupikp-iot-idp", "qcom,yupikp-iot", "qcom,idp";
	qcom,msm-id = <498 0x10000>, <575 0x10000>, <576 0x10000>;
	qcom,board-id = <34 1>;
	qcom,softsku-id = <3>;
};


/dts-v1/;

#include "kalama.dtsi"
#include "kalama-cdp.dtsi"

/ {
	model = "Qualcomm Technologies, Inc. Kalama CDP";
	compatible = "qcom,kalama-cdp", "qcom,kalama", "qcom,cdp";
	qcom,board-id = <1 0>;
};

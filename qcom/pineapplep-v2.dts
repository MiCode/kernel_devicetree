/dts-v1/;

#include "pineapplep-v2.dtsi"

/ {
	model = "Qualcomm Technologies, Inc. PineappleP v2 SoC";
	compatible = "qcom,pineapplep";
	qcom,board-id = <0 0>;
};

&pcie1 {
	/delete-property/ msi-map;
};

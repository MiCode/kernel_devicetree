// SPDX-License-Identifier: BSD-3-Clause
/*
 * Copyright (c) 2025 Qualcomm Innovation Center, Inc. All rights reserved.
 */

/dts-v1/;
/plugin/;

#include "vienna-wrd-ddsip.dtsi"

/ {
	model = "Qualcomm Technologies, Inc. Vienna WRD DDSIP";
	compatible = "qcom,vienna-wrd", "qcom,vienna", "qcom,wrd";
	qcom,board-id = <0x2002d 0x0>;
};


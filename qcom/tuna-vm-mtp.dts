// SPDX-License-Identifier: BSD-3-Clause
/*
 * Copyright (c) 2024 Qualcomm Innovation Center, Inc. All rights reserved.
 */

/dts-v1/;

#include "tuna-vm.dtsi"
#include "tuna-vm-mtp.dtsi"

/ {
	model = "Qualcomm Technologies, Inc. Tuna SVM MTP";
	compatible = "qcom,tuna-mtp", "qcom,tuna", "qcom,tunap-mtp", "qcom,tunap",
			"qcom,mtp";
	qcom,board-id = <8 0>;
};

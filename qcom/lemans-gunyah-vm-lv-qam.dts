/dts-v1/;

#include "lemans-gunyah-vm-lv.dtsi"

/ {
	model = "Qualcomm Technologies, Inc. Lemans IVI ADAS QAM Gunyah LV VM";
	compatible = "qcom,lemans", "qcom,qam";
	qcom,board-id = <0x10025 0x0>;
};

/dts-v1/;
/plugin/;

#include "kona-iot-v2.1-rb5.dtsi"

/ {
	model = "Qualcomm Technologies, Inc. QRB5165 POP RB5";
	compatible = "qcom,kona-iot-qrd", "qcom,kona-iot", "qcom,kona-qrd";
	qcom,msm-id = <455 0x0>;
	qcom,board-id = <0x301000b 0x0>;
};

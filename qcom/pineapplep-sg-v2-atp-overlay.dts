/dts-v1/;
/plugin/;

#include "pineapplep-sg-v2-atp.dtsi"

/ {
	model = "Qualcomm Technologies, Inc. PineappleP SG V2 ATP";
	compatible = "qcom,pineapplep-atp", "qcom,pineapplep", "qcom,atp";
	qcom,msm-id = <682 0x20000>;
	qcom,board-id = <0x10021 0>;
};

// SPDX-License-Identifier: BSD-3-Clause
/*
 * Copyright (c) Qualcomm Technologies, Inc. and/or its subsidiaries.
 */

#include "yupik-iot.dtsi"
#include "katmai-cpu-fp2p5.dtsi"

/ {
	model = "Qualcomm Technologies, Inc. KATMAI-FP2P5 SoC";
	compatible = "qcom,yupik-iot";
	qcom,msm-id = <576 0x10000>;
	qcom,softsku-id = <8>;
};

&pcie1 {
	status = "ok";
};

&pcie1_msi {
	status = "ok";
};

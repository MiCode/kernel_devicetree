/dts-v1/;

#include "cinder-du.dtsi"
#include "cinder-x100.dtsi"

/ {
	model = "Qualcomm Technologies, Inc. Cinder DU X100";
	compatible = "qcom,cinder-x100", "qcom,cinder", "qcom,x100";
	qcom,board-id = <0x27 0x0>;
};

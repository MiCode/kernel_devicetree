#include "lemans.dtsi"
#include "lemans-adp-common.dtsi"

/ {
	model = "Qualcomm Technologies, Inc. LeMans IVI ADAS SoC";
	compatible = "qcom,lemans-ivi-adas", "qcom,lemans";
	qcom,msm-id = <534 0x10000>;
};

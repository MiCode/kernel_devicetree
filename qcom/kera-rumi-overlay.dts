// SPDX-License-Identifier: BSD-3-Clause
/*
 * Copyright (c) Qualcomm Technologies, Inc. and/or its subsidiaries.
 */

/dts-v1/;
/plugin/;

#include "kera-rumi.dtsi"

/ {
	model = "Qualcomm Technologies, Inc. Kera RUMI";
	compatible = "qcom,kera-rumi", "qcom,kera", "qcom,rumi", "qcom,kera-qmb";
	qcom,msm-id = <659 0x10000>, <720 0x10000>;
	qcom,board-id = <15 0>;
};

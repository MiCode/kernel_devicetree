// SPDX-License-Identifier: BSD-3-Clause
/*
 * Copyright (c) 2025 Qualcomm Innovation Center, Inc. All rights reserved.
 */

#include "yupik.dtsi"

/ {
	model = "Qualcomm Technologies, Inc. YupikP";
	compatible = "qcom,yupikp";
	qcom,msm-id = <499 0x10000>;
};

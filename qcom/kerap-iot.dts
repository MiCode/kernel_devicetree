// SPDX-License-Identifier: BSD-3-Clause
/*
 * Copyright (c) Qualcomm Technologies, Inc. and/or its subsidiaries.
 */

/dts-v1/;

#include "kerap.dtsi"

/ {
	model = "Qualcomm Technologies, Inc. KeraP IoT SoC";
	compatible = "qcom,kerap";
	qcom,msm-id = <732 0x10000>;
	qcom,board-id = <0 0>;
};

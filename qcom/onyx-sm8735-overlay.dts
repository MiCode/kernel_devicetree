// SPDX-License-Identifier: BSD-3-Clause
/*
 * Copyright (c) 2024 Qualcomm Innovation Center, Inc. All rights reserved.
 */

/dts-v1/;
/plugin/;

#include "tuna-pm7550ba-pmd802x.dtsi"
#include "onyx-sm8735.dtsi"

/ {
	model = "Qualcomm Technologies, Inc. Onyx based on SM8735";
	compatible = "qcom,tuna-mtp", "qcom,tuna", "qcom,tunap-mtp", "qcom,tunap",
			"qcom,mtp";
	qcom,msm-id = <681 0x10000>, <655 0x10000>;
	qcom,board-id = <8 0>;
	xiaomi,miboard-id = <0x7 0>;
};
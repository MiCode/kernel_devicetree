#include "cinder-v2.dtsi"
#include "cinder-ru.dtsi"

/ {
	model = "Qualcomm Technologies, Inc. Cinder V2 RU";
	compatible = "qcom,cinder";
	qcom,msm-id = <539 0x20000>, <588 0x20000>, <589 0x20000>, <590 0x20000>;
};

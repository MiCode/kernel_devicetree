// SPDX-License-Identifier: BSD-3-Clause
/*
 * Copyright (c) 2024 Qualcomm Innovation Center, Inc. All rights reserved.
 */

/dts-v1/;

#include "sdxkova.dtsi"
#include "sdxkova-idp-mbb.dtsi"
#include "sdxkova-reserved-memory.dtsi"

/ {
	model = "Qualcomm Technologies, Inc. SDXKOVA IDP MBB";
	compatible = "qcom,sdxkova-idp",
		"qcom,sdxkova", "qcom,idp";
	qcom,msm-id = <556 0x10000>;
	qcom,board-id = <0x2010022 0x302>, <0x2010022 0x402>;
};

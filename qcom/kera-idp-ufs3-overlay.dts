// SPDX-License-Identifier: BSD-3-Clause
/*
 * Copyright (c) Qualcomm Technologies, Inc. and/or its subsidiaries.
 */

/dts-v1/;
/plugin/;

#include "kera-idp-ufs3.dtsi"
#include "kera-pmiv0102.dtsi"

/ {
	model = "Qualcomm Technologies, Inc. Kera IDP + UFS3";
	compatible = "qcom,kera-idp", "qcom,kera", "qcom,kerap-idp", "qcom,kerap",
			"qcom,idp", "qcom,kerap-qna";
	qcom,msm-id = <686 0x10000>, <721 0x10000>;
	qcom,board-id = <0x20022 0>, <0x40022 0>;
};

&pmiv010x_eusb2_repeater {
	qcom,param-override-seq =
		/* <value reg_offset> */
		/* Tx pre-emphasis tuning */
		<0x6 0x57>;
};

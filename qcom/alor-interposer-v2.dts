// SPDX-License-Identifier: BSD-3-Clause
/*
 * Copyright (c) 2025 Qualcomm Innovation Center, Inc. All rights reserved.
 */

/dts-v1/;

#include "alor-interposer-v2.dtsi"

/ {
	model = "Qualcomm Technologies, Inc. Alor Interposer v2 SoC";
	compatible = "qcom,alor";
	qcom,board-id = <0 0>;
};

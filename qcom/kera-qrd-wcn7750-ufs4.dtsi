// SPDX-License-Identifier: BSD-3-Clause
/*
 * Copyright (c) 2024 Qualcomm Innovation Center, Inc. All rights reserved.
 */

#include "kera-qrd.dtsi"
#include "kera_ufs4.dtsi"

&L11B {
	/delete-property/ regulator-always-on;
};

/dts-v1/;

#include "sdxbaagha.dtsi"
#include "sdxbaagha-rumi.dtsi"

/ {
	model = "Qualcomm Technologies, Inc. SDXBAAGHA RUMI";
	compatible = "qcom,sdxbaagha-rumi",
		"qcom,sdxbaagha", "qcom,rumi";
	qcom,board-id = <0x0F 0>;
};

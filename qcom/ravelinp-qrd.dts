// SPDX-License-Identifier: BSD-3-Clause
/*
 * Copyright (c) 2024 Qualcomm Innovation Center, Inc. All rights reserved.
 */

/dts-v1/;

#include "ravelinp.dtsi"
#include "ravelinp-qrd.dtsi"

/ {
	model = "Qualcomm Technologies, Inc. RavelinP QRD";
	compatible = "qcom,ravelinp-qrd", "qcom,ravelinp", "qcom,qrd";
	qcom,board-id = <0x1000B 0>;
};


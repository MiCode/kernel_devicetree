// SPDX-License-Identifier: BSD-3-Clause
/*
 * Copyright (c) Qualcomm Technologies, Inc. and/or its subsidiaries.
 */

/dts-v1/;

#include "montaguep.dtsi"
#include "montague-talyn.dtsi"

/ {
	model = "Qualcomm Technologies, Inc. Montague Apache IDP";
	compatible = "qcom,montague-idp", "qcom,montague", "qcom,idp";
	qcom,board-id = <0x10022 0x8>;
};

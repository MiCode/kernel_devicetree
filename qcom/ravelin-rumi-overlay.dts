// SPDX-License-Identifier: BSD-3-Clause
/*
 * Copyright (c) 2024 Qualcomm Innovation Center, Inc. All rights reserved.
 */

/dts-v1/;
/plugin/;

#include "ravelin-rumi.dtsi"

/ {
	model = "Qualcomm Technologies, Inc. Ravelin RUMI";
	compatible = "qcom,ravelin-rumi", "qcom,ravelin", "qcom,rumi";
	qcom,msm-id = <568 0x10000>;
	qcom,board-id = <0x1000F 0>;
};


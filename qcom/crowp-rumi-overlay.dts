/dts-v1/;
/plugin/;

#include "crowp-rumi.dtsi"

/ {
	model = "Qualcomm Technologies, Inc. Crowp RUMI";
	compatible = "qcom,crowp-rumi", "qcom,crowp", "qcom,rumi";
	qcom,msm-id = <687 0x10000>;
	qcom,board-id = <0x1000F 0>;
};

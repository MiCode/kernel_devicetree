// SPDX-License-Identifier: BSD-3-Clause
/*
 * Copyright (c) 2025 Qualcomm Innovation Center, Inc. All rights reserved.
 */

/dts-v1/;

#include "katmai-fp2.dtsi"

/ {
	model = "Qualcomm Technologies, Inc. KATMAI-FP2 SoC";
	compatible = "qcom,yupik-iot";
	qcom,board-id = <0 0>;
};

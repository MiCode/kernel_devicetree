// SPDX-License-Identifier: BSD-3-Clause
/*
 * Copyright (c) 2024 Qualcomm Innovation Center, Inc. All rights reserved.
 */

/dts-v1/;

#include "canoep-v2.dtsi"

/ {
	model = "Qualcomm Technologies, Inc. CanoeP v2 SoC";
	compatible = "qcom,canoep";
	qcom,board-id = <0 0>;
};

/dts-v1/;
/plugin/;

#include "kalama-atp.dtsi"

/ {
	model = "Qualcomm Technologies, Inc. Kalama ATP";
	compatible = "qcom,kalama-atp", "qcom,kalama", "qcom,atp";
	qcom,msm-id = <519 0x10000>, <536 0x10000>, <519 0x20000>, <536 0x20000>, <600 0x20000>, <601 0x20000>;
	qcom,board-id = <0x10021 0>;
};

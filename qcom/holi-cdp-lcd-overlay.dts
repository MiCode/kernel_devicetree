/dts-v1/;
/plugin/;

#include "holi-cdp-lcd.dtsi"

/ {
	model = "Qualcomm Technologies, Inc. Holi CDP-LCD attached";
	compatible = "qcom,holi-cdp", "qcom,holi", "qcom,cdp";
	qcom,msm-id = <454 0x10000>, <472 0x10000>;
	qcom,board-id = <1 1>;
	qcom,pmic-id-size = <4>;
	qcom,pmic-id = <0x36 0x0 0x2E 0x0>;
};

&video_mem {
	reg = <0x0 0x87700000 0x0 0x400000>;
};

&ipa_fw_mem {
	reg = <0x0 0x87b00000 0x0 0x10000>;
};

&ipa_gsi_mem {
	reg = <0x0 0x87b10000 0x0 0xa000>;
};

&gpu_microcode_mem {
	reg = <0x0 0x87b1a000 0x0 0x2000>;
};

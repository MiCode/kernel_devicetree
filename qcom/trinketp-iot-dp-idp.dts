/dts-v1/;

#include "trinketp-iot.dtsi"
#include "trinketp-iot-idp.dtsi"

/ {
	model = "Qualcomm Technologies, Inc. TRINKETIOT Disp. Port Enable IDP";
	compatible = "qcom,trinketp-iot-idp", "qcom,trinketp-iot", "qcom,idp";
	qcom,board-id = <34 4>;
};

&usb0 {
	dwc3@4e00000 {
		usb-phy = <&qusb_phy0>, <&usb_nop_phy>;
		maximum-speed = "high-speed";
	};
};

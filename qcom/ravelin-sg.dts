// SPDX-License-Identifier: BSD-3-Clause
/*
 * Copyright (c) 2024 Qualcomm Innovation Center, Inc. All rights reserved.
 */

/dts-v1/;

#include "ravelin-sg.dtsi"

/ {
	model = "Qualcomm Technologies, Inc. Ravelin SG SoC";
	compatible = "qcom,ravelin";
	qcom,board-id = <0 0>;
};


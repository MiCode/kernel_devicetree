/dts-v1/;
/plugin/;

#include "volcano-idp-wcd9395-evros.dtsi"
#include "volcano-pmiv0104.dtsi"

/ {
	model = "Qualcomm Technologies, Inc. Volcano IDP + WCD9395 + Evros";
	compatible = "qcom,volcano-idp", "qcom,volcano", "qcom,volcanop-idp", "qcom,volcanop", "qcom,idp";
	qcom,msm-id = <636 0x10000>, <640 0x10000>, <641 0x10000>;
	qcom,board-id = <34 5>;
};

&pmiv0104_eusb2_repeater {
	vdd18-supply = <&L7B>;
	vdd3-supply = <&L17B>;
	status = "ok";
};

&eusb2_phy0 {
	dummy-supply = <&pmiv0104_eusb2_repeater>;
	usb-repeater = <&pmiv0104_eusb2_repeater>;
};

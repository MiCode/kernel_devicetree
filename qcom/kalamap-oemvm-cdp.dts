/dts-v1/;

#include "kalamap-oemvm.dtsi"
#include "kalamap-oemvm-cdp.dtsi"

/ {
	model = "Qualcomm Technologies, Inc. KalamaP OEMVM CDP";
	compatible = "qcom,kalamap-cdp", "qcom,kalamap", "qcom,cdp";
	qcom,board-id = <0x10001 0>;
};

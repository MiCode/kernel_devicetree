// SPDX-License-Identifier: BSD-3-Clause
/*
 * Copyright (c) 2023 Qualcomm Innovation Center, Inc. All rights reserved.
 */

/dts-v1/;

#include "sun-vm.dtsi"
#include "sun-vm-rumi.dtsi"

/ {
	model = "Qualcomm Technologies, Inc. Sun SVM RUMI";
	compatible = "qcom,sun-rumi", "qcom,sun", "qcom,rumi";
	qcom,board-id = <15 0>;
};

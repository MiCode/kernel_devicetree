/dts-v1/;
/plugin/;

#include "sa410m-idp.dtsi"

/ {
	model = "Qualcomm Technologies, Inc. SA410M NAND IDP";
	compatible = "qcom,sa410m", "qcom,idp", "qcom,sa410m-idp";
	qcom,msm-id=<560 0x10000>;
	qcom,board-id = <34 0x1>;
};

&qnand_1 {
	status = "ok";
};

&sdhc_1 {
	status = "disabled";
};

/dts-v1/;

#include "volcano-vm.dtsi"
#include "volcano-vm-qrd.dtsi"

/ {
	model = "Qualcomm Technologies, Inc. Volcano SVM QRD";
	compatible = "qcom,volcano-qrd", "qcom,volcano", "qcom,qrd";
	qcom,board-id = <11 0>;
};

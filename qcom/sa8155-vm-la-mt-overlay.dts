/dts-v1/;
/plugin/;

/ {
	model = "Qualcomm Technologies, Inc. SA8155 Multi LA Virtual Machine";
	compatible = "qcom,sa8155", "qcom,quinvm";
	qcom,msm-id = <362 0x20000>;
	qcom,board-id = <0 0x2000001>;
};

/dts-v1/;

#include "kalama.dtsi"
#include "kalama-qrd.dtsi"

/ {
	model = "Qualcomm Technologies, Inc. Kalama QRD";
	compatible = "qcom,kalama-qrd", "qcom,kalama", "qcom,qrd";
	qcom,board-id = <11 0>;
};

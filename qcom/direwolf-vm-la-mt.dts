/dts-v1/;

#include "direwolf-vm.dtsi"
#include "direwolf-vm-la-mt.dtsi"

/ {
	model = "Qualcomm Technologies, Inc. Direwolf Multi LA Virtual Machine";
	compatible = "qcom,direwolf", "qcom,quinvm";
	qcom,board-id = <0 0x2000001>;
};

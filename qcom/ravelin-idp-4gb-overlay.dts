/dts-v1/;
/plugin/;

#include "ravelin-idp-4gb.dtsi"

/ {
	model = "Qualcomm Technologies, Inc. Ravelin IDP 4GB DDR";
	compatible = "qcom,ravelin-idp", "qcom,ravelin", "qcom,idp";
	qcom,msm-id = <568 0x10000>;
	qcom,board-id = <34 0x600>;
};

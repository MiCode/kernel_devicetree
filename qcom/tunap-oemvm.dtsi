// SPDX-License-Identifier: BSD-3-Clause
/*
 * Copyright (c) 2025 Qualcomm Innovation Center, Inc. All rights reserved.
 */

#include "tuna-oemvm.dtsi"

/ {
	model = "Qualcomm Technologies, Inc. TunaP OEMVM SoC";
	compatible = "qcom,tunap";
	qcom,msm-id = <694 0x10000>;
};

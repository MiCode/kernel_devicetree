/dts-v1/;
/plugin/;

#include "volcano6i-mtp-ganges.dtsi"

/ {
	model = "Qualcomm Technologies, Inc. Volcano6I MTP + WCD9378 AATC + Ganges";
	compatible = "qcom,volcano-mtp", "qcom,volcano", "qcom,volcanop-mtp", "qcom,volcanop", "qcom,mtp";
	qcom,msm-id = <657 0x10000>, <658 0x10000>;
	qcom,board-id = <8 3>;
};


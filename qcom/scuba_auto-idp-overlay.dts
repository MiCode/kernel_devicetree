/dts-v1/;
/plugin/;

#include "scuba_auto-idp.dtsi"

/ {
	model = "Qualcomm Technologies, Inc. SCUBA AUTO IDP";
	compatible = "qcom,sa410m", "qcom,idp", "qcom,sa410m-idp";
	qcom,msm-id = <441 0x10000>, <471 0x10000>;
	qcom,board-id = <34 0x500>;
};


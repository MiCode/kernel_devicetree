/dts-v1/;

#include "crowp-vm.dtsi"
#include "crowp-vm-idp-wcd9395-wcd-dmic.dtsi"

/ {
	model = "Qualcomm Technologies, Inc. CrowP VM IDP + WCD9395 WCD-DMIC";
	compatible = "qcom,crowp-idp", "qcom,crowp", "qcom,idp";
	qcom,board-id = <34 1>;
};

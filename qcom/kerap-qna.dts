// SPDX-License-Identifier: BSD-3-Clause
/*
 * Copyright (c) Qualcomm Technologies, Inc. and/or its subsidiaries.
 */

/dts-v1/;

#include "kerap-qna.dtsi"

/ {
	model = "Qualcomm Technologies, Inc. KeraP QNA SoC";
	compatible = "qcom,kerap-qna";
	qcom,board-id = <0 0>;
};

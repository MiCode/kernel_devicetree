// SPDX-License-Identifier: BSD-3-Clause
/*
 * Copyright (c) 2024 Qualcomm Innovation Center, Inc. All rights reserved.
 */

/dts-v1/;

#include "tuna-vm.dtsi"
#include "tuna-vm-rcm-kiwi.dtsi"

/ {
	model = "Qualcomm Technologies, Inc. Tuna SVM RCM + kiwi WLAN";
	compatible = "qcom,tuna-rcm", "qcom,tuna", "qcom,tunap-rcm", "qcom,tunap",
			"qcom,rcm";
	qcom,board-id = <21 1>;
};

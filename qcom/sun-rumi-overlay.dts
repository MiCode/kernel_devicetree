// SPDX-License-Identifier: BSD-3-Clause
/*
 * Copyright (c) 2023-2024 Qualcomm Innovation Center, Inc. All rights reserved.
 */

/dts-v1/;
/plugin/;

#include "sun-rumi.dtsi"

/ {
	model = "Qualcomm Technologies, Inc. Sun RUMI";
	compatible = "qcom,sun-rumi", "qcom,sun", "qcom,rumi";
	qcom,msm-id = <618 0x10000>, <618 0x20000>;
	qcom,board-id = <15 0>;
};

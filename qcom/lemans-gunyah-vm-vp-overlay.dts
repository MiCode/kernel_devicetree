/dts-v1/;
/plugin/;

/ {
	model = "Qualcomm Technologies, Inc. Lemans IVI ADAS VP Gunyah VM";
	compatible = "qcom,lemans";
	qcom,msm-id = <532 0x10000>, <533 0x10000>, <534 0x10000>, <619 0x10000>, <532 0x20000>, <533 0x20000>, <534 0x20000>, <619 0x20000>;
	qcom,board-id = <0x10029 0x0>;
};

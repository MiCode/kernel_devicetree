/dts-v1/;
/plugin/;

#include "volcano-vm.dtsi"
#include "volcano6i-vm-mtp-wcd9395-moselle.dtsi"

/ {
	model = "Qualcomm Technologies, Inc. Volcano6I SVM MTP + WCD9395 AATC + SN220T + Moselle ";
	compatible = "qcom,volcano-mtp", "qcom,volcano", "qcom,mtp";
	qcom,board-id = <8 7>;
};


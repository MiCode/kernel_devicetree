// SPDX-License-Identifier: BSD-3-Clause
/*
 * Copyright (c) 2024 Qualcomm Innovation Center, Inc. All rights reserved.
 */
/dts-v1/;

#include "sunp-oemvm.dtsi"
#include "sunp-oemvm-hdk.dtsi"

/ {
	model = "Qualcomm Technologies, Inc. SunP OEMVM HDK";
	compatible = "qcom,sunp-hdk", "qcom,sun", "qcom,hdk";
	qcom,board-id = <0x1001F 0>;
};

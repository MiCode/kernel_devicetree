/dts-v1/;
/plugin/;

#include "niobep.dtsi"
#include "niobep-qxr-vista.dtsi"

/ {
	model = "Qualcomm Technologies, Inc. NiobeP QXR Vista";
	compatible = "qcom,niobep-qxr", "qcom,niobep", "qcom,qxr";
	qcom,board-id = <0x10026 0x1>;
};

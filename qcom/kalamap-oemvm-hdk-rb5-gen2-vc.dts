/dts-v1/;
/plugin/;

#include "kalamap-oemvm.dtsi"
#include "kalamap-oemvm-hdk-rb5-gen2-vc.dtsi"

/ {
	model = "Qualcomm Technologies, Inc. KalamaP OEMVM HDK RB5 Gen2 VC";
	compatible = "qcom,kalamap-hdk", "qcom,kalamap", "qcom,hdk";
	qcom,board-id = <0x1001f 0x6>;
};

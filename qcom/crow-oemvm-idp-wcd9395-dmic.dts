/dts-v1/;

#include "crow-oemvm.dtsi"
#include "crow-oemvm-idp-wcd9395-dmic.dtsi"

/ {
	model = "Qualcomm Technologies, Inc. OEM VM Crow IDP + WCD9395 DMIC";
	compatible = "qcom,crow-idp", "qcom,crow", "qcom,idp";
	qcom,board-id = <34 2>;
};

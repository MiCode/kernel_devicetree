/dts-v1/;
/plugin/;


/ {
	model = "Qualcomm Technologies, Inc. LeMans Single Linux Virtual Machine";
	compatible = "qcom,lemans", "qcom,quinvm";
	qcom,msm-id = <532 0x20000>;
	qcom,board-id = <0 0x1000002>;
};

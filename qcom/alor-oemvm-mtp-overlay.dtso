// SPDX-License-Identifier: BSD-3-Clause
/*
 * Copyright (c) Qualcomm Technologies, Inc. and/or its subsidiaries.
 */
/dts-v1/;
/plugin/;

#include "alor-oemvm-avf.dtsi"
#include "alor-oemvm-mtp-avf.dtsi"

/ {
	model = "Qualcomm Technologies, Inc. Alor OEMVM MTP";
	compatible = "qcom,alor-mtp", "qcom,alor", "qcom,alorp-mtp",
			"qcom,alorp", "qcom,mtp";
	qcom,board-id = <0x10008 0>;

	host {
	};
};

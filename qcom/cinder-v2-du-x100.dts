/dts-v1/;

#include "cinder-v2-du.dtsi"
#include "cinder-v2-x100.dtsi"

/ {
	model = "Qualcomm Technologies, Inc. Cinder V2 DU X100";
	compatible = "qcom,cinder-x100", "qcom,cinder", "qcom,x100";
	qcom,board-id = <0x20027 0x0>;
};

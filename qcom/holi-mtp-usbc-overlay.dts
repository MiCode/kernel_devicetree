/dts-v1/;
/plugin/;

#include "holi-mtp-usbc.dtsi"

/ {
	model = "Qualcomm Technologies, Inc. Holi MTP USBC audio";
	compatible = "qcom,holi-mtp", "qcom,holi", "qcom,mtp";
	qcom,msm-id = <454 0x10000>, <472 0x10000>;
	qcom,board-id = <8 1>;
	qcom,pmic-id-size = <4>;
	qcom,pmic-id = <0x36 0x0 0x2E 0x0>;
};

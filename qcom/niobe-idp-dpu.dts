/dts-v1/;
/plugin/;

#include "niobe.dtsi"
#include "niobe-idp.dtsi"

/ {
	model = "Qualcomm Technologies, Inc. Niobe IDP DPU";
	compatible = "qcom,niobe-idp", "qcom,niobe", "qcom,idp";
	qcom,board-id = <0x10022 1>;
};

// SPDX-License-Identifier: BSD-3-Clause
/*
 * Copyright (c) Qualcomm Technologies, Inc. and/or its subsidiaries.
 */

/dts-v1/;

#include "chora.dtsi"

/ {
	model = "Qualcomm Technologies, Inc. Chora SoC";
	compatible = "qcom,chora";
	qcom,board-id = <0 0>;
};

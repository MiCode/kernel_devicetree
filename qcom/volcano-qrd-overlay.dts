/dts-v1/;
/plugin/;

#include "volcano-qrd.dtsi"

/ {
	model = "Qualcomm Technologies, Inc. Volcano QRD";
	compatible = "qcom,volcano-qrd", "qcom,volcano", "qcom,volcanop-qrd", "qcom,volcanop", "qcom,qrd";
	qcom,msm-id = <636 0x10000>, <640 0x10000>, <641 0x10000>;
	qcom,board-id = <11 0>;
};


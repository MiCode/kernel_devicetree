// SPDX-License-Identifier: BSD-3-Clause
/*
 * Copyright (c) Qualcomm Technologies, Inc. and/or its subsidiaries.
 */

&soc {
	rpmh_tgu: tgu@11301000 {
		compatible = "arm,primecell";
		arm,primecell-periphid = <0x000bb999>;
		reg = <0x0 0x11301000 0x0 0x1000>;
		reg-names = "tgu-base";
		tgu-steps = <3>;
		tgu-conditions = <4>;
		tgu-regs = <17>;

		device-name = "tgu_rpmh";

		clocks = <&aoss_qmp>;
		clock-names = "apb_pclk";
	};

	ipcb_tgu: tgu@1130e000 {
		compatible = "arm,primecell";
		arm,primecell-periphid = <0x000bb999>;
		reg = <0x0 0x1130e000 0x0 0x1000>;
		reg-names = "tgu-base";
		tgu-steps = <2>;
		tgu-conditions = <4>;
		tgu-regs = <4>;

		device-name = "tgu_ipcb";

		clocks = <&aoss_qmp>;
		clock-names = "apb_pclk";
	};

	spmi_tgu0: tgu@1130f000 {
		compatible = "arm,primecell";
		arm,primecell-periphid = <0x000bb999>;

		reg = <0x0 0x1130f000 0x0 0x1000>;
		reg-names = "tgu-base";

		tgu-steps = <3>;
		tgu-conditions = <4>;
		tgu-regs = <8>;

		device-name = "tgu_spmi0";

		clocks = <&aoss_qmp>;
		clock-names = "apb_pclk";
	};

	spmi_tgu1: tgu@11310000 {
		compatible = "arm,primecell";
		arm,primecell-periphid = <0x000bb999>;

		reg = <0x0 0x11310000 0x0 0x1000>;
		reg-names = "tgu-base";

		tgu-steps = <2>;
		tgu-conditions = <4>;
		tgu-regs = <8>;

		device-name = "tgu_spmi1";

		clocks = <&aoss_qmp>;
		clock-names = "apb_pclk";
	};

	csr: csr@10001000 {
		compatible = "qcom,coresight-csr";
		reg = <0x0 0x10001000 0x0 0x1000>;
		reg-names = "csr-base";

		device-name = "csr";

		qcom,hwctrl-set-support;
		qcom,set-byte-cntr-support;
		qcom,blk-size = <1>;
	};

	swao_csr: csr@11311000 {
		compatible = "qcom,coresight-csr";
		reg = <0x0 0x11311000 0x0 0x1000>,
		      <0x0 0x113110f8 0x0 0x90>;
		reg-names = "csr-base", "msr-base";

		device-name = "swao_csr";

		qcom,timestamp-support;
		qcom,msr-support;
		qcom,blk-size = <1>;

		clocks = <&aoss_qmp>;
		clock-names = "apb_pclk";
	};

	tpdm_spss: tpdm@11080000 {
		compatible = "qcom,coresight-tpdm", "arm,primecell";
		reg = <0x0 0x11080000 0x0 0x1000>;
		reg-names = "tpdm-base";

		device-name = "tpdm_spss";

		clocks = <&aoss_qmp>;
		clock-names = "apb_pclk";
		status = "disabled";

		out-ports {
			port {
				tpdm_spss_out_funnel_spss: endpoint {
					remote-endpoint =
					<&funnel_spss_in_tpdm_spss>;
				};
			};
		};
	};

	funnel_spss: funnel@11084000 {
		compatible = "arm,coresight-dynamic-funnel", "arm,primecell";
		reg = <0x0 0x11084000 0x0 0x1000>;
		reg-names = "funnel-base";

		device-name = "coresight-funnel-spss";

		clocks = <&aoss_qmp>;
		clock-names = "apb_pclk";
		status = "disabled";

		in-ports {
			#address-cells = <1>;
			#size-cells = <0>;

			port@0 {
				reg = <0>;
				funnel_spss_in_tpdm_spss: endpoint {
					remote-endpoint =
					<&tpdm_spss_out_funnel_spss>;
				};
			};
		};

		out-ports {
			port {
				funnel_spss_out_tn_ag: endpoint {
					remote-endpoint =
					<&tn_ag_in_funnel_spss>;
				};
			};
		};
	};

	tpdm_tmess0: tpdm@114c0000 {
		compatible = "arm,primecell";
		arm,primecell-periphid = <0x000f0e00>;
		reg = <0x0 0x114c0000 0x0 0x1000>;
		reg-names = "tpdm-base";
		qcom,cmb-element-bits = <32>;

		device-name = "tpdm_tmess_0";

		clocks = <&aoss_qmp>;
		clock-names = "apb_pclk";

		qcom,hw-enable-check;
		status = "disabled";

		out-ports {
			port {
				tpdm_tmess0_out_tpda_tmess: endpoint {
					remote-endpoint =
					<&tpda_tmess_in_tpdm_tmess0>;
				};
			};
		};
	};

	tpdm_tmess1: tpdm@114c1000 {
		compatible = "arm,primecell";
		arm,primecell-periphid = <0x000f0e00>;
		reg = <0x0 0x114c1000 0x0 0x1000>;
		reg-names = "tpdm-base";
		qcom,cmb-element-bits = <32>;

		device-name = "tpdm_tmess_1";

		clocks = <&aoss_qmp>;
		clock-names = "apb_pclk";

		qcom,hw-enable-check;
		status = "disabled";

		out-ports {
			port {
				tpdm_tmess1_out_tpda_tmess: endpoint {
					remote-endpoint =
					<&tpda_tmess_in_tpdm_tmess1>;
				};
			};
		};
	};

	tpdm_tmess2: tpdm@114c2000 {
		compatible = "arm,primecell";
		arm,primecell-periphid = <0x000f0e00>;
		reg = <0x0 0x114c2000 0x0 0x1000>;
		reg-names = "tpdm-base";
		qcom,cmb-element-bits = <32>;

		device-name = "tpdm_tmess_2";

		clocks = <&aoss_qmp>;
		clock-names = "apb_pclk";

		qcom,hw-enable-check;
		status = "disabled";

		out-ports {
			port {
				tpdm_tmess2_out_tpda_tmess: endpoint {
					remote-endpoint =
					<&tpda_tmess_in_tpdm_tmess2>;
				};
			};
		};
	};

	tpdm_tmess3: tpdm@114c3000 {
		compatible = "arm,primecell";
		arm,primecell-periphid = <0x000f0e00>;
		reg = <0x0 0x114c3000 0x0 0x1000>;
		reg-names = "tpdm-base";
		qcom,dsb-element-bits = <32>;
		qcom,cmb-element-bits = <64>;

		device-name = "tpdm_tmess_3";

		clocks = <&aoss_qmp>;
		clock-names = "apb_pclk";

		qcom,hw-enable-check;
		status = "disabled";

		out-ports {
			port {
				tpdm_tmess3_out_tpda_tmess: endpoint {
					remote-endpoint =
					<&tpda_tmess_in_tpdm_tmess3>;
				};
			};
		};
	};

	tpda_tmess: tpda@114c6000 {
		compatible = "qcom,coresight-tpda", "arm,primecell";
		reg = <0x0 0x114c6000 0x0 0x1000>;
		reg-names = "tpda-base";

		device-name = "tpda_tmess";

		clocks = <&aoss_qmp>;
		clock-names = "apb_pclk";
		status = "disabled";

		in-ports {
			#address-cells = <1>;
			#size-cells = <0>;

			port@0 {
				reg = <0>;
				tpda_tmess_in_tpdm_tmess0: endpoint {
					remote-endpoint =
					<&tpdm_tmess0_out_tpda_tmess>;
				};
			};

			port@1 {
				reg = <1>;
				tpda_tmess_in_tpdm_tmess1: endpoint {
					remote-endpoint =
					<&tpdm_tmess1_out_tpda_tmess>;
				};
			};

			port@2 {
				reg = <2>;
				tpda_tmess_in_tpdm_tmess2: endpoint {
					remote-endpoint =
					<&tpdm_tmess2_out_tpda_tmess>;
				};
			};

			port@3 {
				reg = <3>;
				tpda_tmess_in_tpdm_tmess3: endpoint {
					remote-endpoint =
					<&tpdm_tmess3_out_tpda_tmess>;
				};
			};
		};

		out-ports {
			port {
				tpda_tmess_out_funnel_tmess: endpoint {
					remote-endpoint =
					<&funnel_tmess_in_tpda_tmess>;
				};
			};
		};
	};

	funnel_tmess: funnel@114c7000 {
		compatible = "arm,coresight-dynamic-funnel", "arm,primecell";
		reg = <0x0 0x114c7000 0x0 0x1000>;
		reg-names = "funnel-base";

		device-name = "funnel_tmess";

		clocks = <&aoss_qmp>;
		clock-names = "apb_pclk";
		status = "disabled";

		in-ports {
			#address-cells = <1>;
			#size-cells = <0>;

			port@0 {
				reg = <0>;
				funnel_tmess_in_tpda_tmess: endpoint {
					remote-endpoint =
					<&tpda_tmess_out_funnel_tmess>;
				};
			};
		};

		out-ports {
			#address-cells = <1>;
			#size-cells = <0>;

			port@0 {
				reg = <0>;
				funnel_tmess_out_tn_ag: endpoint {
					remote-endpoint =
					<&tn_ag_in_funnel_tmess>;
				};
			};
		};
	};

	tpdm_modem0: tpdm@11000000 {
		compatible = "qcom,coresight-tpdm", "arm,primecell";
		reg = <0x0 0x11000000 0x0 0x1000>;
		reg-names = "tpdm-base";
		qcom,dsb-element-bits = <32>;
		qcom,dsb-msrs-num = <16>;

		device-name = "tpdm_modem_0";

		clocks = <&aoss_qmp>;
		clock-names = "apb_pclk";

		out-ports {
			port {
				tpdm_modem0_out_tpda_modem: endpoint {
					remote-endpoint =
					<&tpda_modem_in_tpdm_modem0>;
				};
			};
		};
	};

	tpdm_modem1: tpdm@11001000 {
		compatible = "qcom,coresight-static-tpdm";
		device-name = "tpdm_modem_1";
		qcom,cmb-element-bits = <32>;

		out-ports {
			port {
				tpdm_modem1_out_tpda_modem: endpoint {
					remote-endpoint =
					<&tpda_modem_in_tpdm_modem1>;
				};
			};
		};
	};

	tpdm_modem2: tpdm@11002000 {
		compatible = "qcom,coresight-static-tpdm";
		device-name = "tpdm_modem_2";
		qcom,cmb-element-bits = <64>;

		out-ports {
			port {
				tpdm_modem2_out_tpda_modem: endpoint {
					remote-endpoint =
					<&tpda_modem_in_tpdm_modem2>;
				};
			};
		};
	};

	tpda_modem: tpda@11004000 {
		compatible = "qcom,coresight-tpda", "arm,primecell";
		reg = <0x0 0x11004000 0x0 0x1000>;
		reg-names = "tpda-base";

		device-name = "tpda_modem";

		clocks = <&aoss_qmp>;
		clock-names = "apb_pclk";

		in-ports {
			#address-cells = <1>;
			#size-cells = <0>;

			port@0 {
				reg = <0>;
				tpda_modem_in_tpdm_modem0: endpoint {
					remote-endpoint =
					<&tpdm_modem0_out_tpda_modem>;
				};
			};

			port@1 {
				reg = <1>;
				tpda_modem_in_tpdm_modem1: endpoint {
					remote-endpoint =
					<&tpdm_modem1_out_tpda_modem>;
				};
			};

			port@2 {
				reg = <2>;
				tpda_modem_in_tpdm_modem2: endpoint {
					remote-endpoint =
					<&tpdm_modem2_out_tpda_modem>;
				};
			};
		};

		out-ports {
			port {
				tpda_modem_out_funnel_modem_dl: endpoint {
					remote-endpoint =
					<&funnel_modem_dl_in_tpda_modem>;
				};
			};
		};
	};

	modem_etm0 {
		compatible = "qcom,coresight-remote-etm";

		device-name = "modem_etm0";
		qcom,atid-num = <2>;
		atid = <36 37>;
		trace-name = "modem-etm0";
		qcom,secure-component;

		out-ports {
			port@0 {
				reg = <0>;
				modem_etm0_out_funnel_modem_q6_dup: endpoint {
					remote-endpoint =
						<&funnel_modem_q6_dup_in_modem_etm0>;
				};
			};

			port@1 {
				reg = <1>;
				modem_etm0_out_qmi: endpoint {
					remote-endpoint =
						<&qmi_in_modem_etm0>;
				};
			};
		};
	};

	modem2-etm0 {
		compatible = "qcom,coresight-remote-etm";

		device-name = "modem2_etm0";
		qcom,atid-num = <1>;
		atid = <39>;
		trace-name = "modem2-etm0";

		out-ports {
			port@0 {
				reg = <0>;
				modem2_etm0_out_funnel_modem: endpoint {
					remote-endpoint =
						<&funnel_modem_in_modem2_etm0>;
				};
			};

			port@1 {
				reg = <1>;
				modem2_etm0_out_qmi: endpoint {
					remote-endpoint =
						<&qmi_in_modem2_etm0>;
				};
			};
		};
	};

	modem_diag: modem_diag {
		compatible = "arm,coresight-dummy-source";

		device-name = "modem_diag";
		atid = <50>;

		out-ports {
			port {
				modem_diag_out_funnel_modem_q6: endpoint {
					remote-endpoint =
					<&funnel_modem_q6_in_modem_diag>;
				};
			};
		};
	};

	funnel_modem_q6_dup: funnel@1100d000 {
		compatible = "arm,primecell";
		arm,primecell-periphid = <0x000bb908>;
		reg = <0x0 0x1100d000 0x0 0x1000>,
			<0x0 0x1100c000 0x0 0x1000>;
		reg-names = "funnel-base-dummy", "funnel-base-real";

		device-name = "funnel_modem_q6_dup";

		clocks = <&aoss_qmp>;
		clock-names = "apb_pclk";
		qcom,duplicate-funnel;

		in-ports {
			#address-cells = <1>;
			#size-cells = <0>;

			port@0 {
				reg = <0>;
				funnel_modem_q6_dup_in_modem_etm0: endpoint {
					remote-endpoint =
					<&modem_etm0_out_funnel_modem_q6_dup>;
				};
			};
		};

		out-ports {
			port {
				funnel_modem_q6_dup_out_funnel_modem_q6: endpoint {
					remote-endpoint =
					<&funnel_modem_q6_in_funnel_modem_q6_dup>;
				};
			};
		};
	};

	funnel_modem_q6: funnel@1100c000 {
		compatible = "arm,coresight-dynamic-funnel", "arm,primecell";
		reg = <0x0 0x1100c000 0x0 0x1000>;
		reg-names = "funnel-base";

		device-name = "funnel_modem_q6";

		clocks = <&aoss_qmp>;
		clock-names = "apb_pclk";

		in-ports {
			#address-cells = <1>;
			#size-cells = <0>;

			port@1 {
				reg = <1>;
				funnel_modem_q6_in_funnel_modem_q6_dup: endpoint {
					remote-endpoint =
					<&funnel_modem_q6_dup_out_funnel_modem_q6>;
				};
			};

			port@2 {
				reg = <2>;
				funnel_modem_q6_in_modem_diag: endpoint {
					remote-endpoint =
					<&modem_diag_out_funnel_modem_q6>;
				};
			};
		};

		out-ports {

			port {
				funnel_modem_q6_out_funnel_modem_dl: endpoint {
					remote-endpoint =
					<&funnel_modem_dl_in_funnel_modem_q6>;
				};
			};
		};
	};

	funnel_modem_dl: funnel@11005000 {
		compatible = "arm,coresight-dynamic-funnel", "arm,primecell";
		reg = <0x0 0x11005000 0x0 0x1000>;
		reg-names = "funnel-base";

		device-name = "funnel_modem_dl";

		clocks = <&aoss_qmp>;
		clock-names = "apb_pclk";

		in-ports {

			#address-cells = <1>;
			#size-cells = <0>;

			port@0 {
				reg = <0>;
				funnel_modem_dl_in_tpda_modem: endpoint {
					remote-endpoint =
					<&tpda_modem_out_funnel_modem_dl>;
				};
			};

			port@1 {
				reg = <1>;
				funnel_modem_in_modem2_etm0: endpoint {
					remote-endpoint =
					<&modem2_etm0_out_funnel_modem>;
				};
			};

			port@3 {
				reg = <3>;
				funnel_modem_dl_in_funnel_modem_q6: endpoint {
					remote-endpoint =
					<&funnel_modem_q6_out_funnel_modem_dl>;
				};
			};
		};

		out-ports {

			port {
				funnel_modem_dl_out_tn_ag: endpoint {
					remote-endpoint =
					<&tn_ag_in_funnel_modem_dl>;
				};
			};
		};
	};

	tpdm_turing: tpdm@11180000 {
		compatible = "qcom,coresight-tpdm", "arm,primecell";
		reg = <0x0 0x11180000 0x0 0x1000>;
		reg-names = "tpdm-base";
		qcom,dsb-element-bits = <32>;
		qcom,dsb-msrs-num = <16>;

		device-name = "tpdm_turing";

		clocks = <&aoss_qmp>;
		clock-names = "apb_pclk";

		out-ports {
			port {
				tpdm_turing_out_tpda_turing: endpoint {
					remote-endpoint =
					<&tpda_turing_in_tpdm_turing>;
				};
			};
		};
	};

	tpdm_turing_llm: tpdm@11181000 {
		compatible = "qcom,coresight-static-tpdm";
		device-name = "tpdm_turing_llm";
		qcom,cmb-element-bits = <32>;

		out-ports {
			port {
				tpdm_turing_llm_out_tpda_turing: endpoint {
					remote-endpoint =
					<&tpda_turing_in_tpdm_turing_llm>;
				};
			};
		};
	};

	tpdm_turing_llm2: tpdm@11182000 {
		compatible = "qcom,coresight-static-tpdm";
		device-name = "tpdm_turing_llm2";
		qcom,cmb-element-bits = <32>;

		out-ports {
			port {
				tpdm_turing_llm2_out_tpda_turing: endpoint {
					remote-endpoint =
					<&tpda_turing_in_tpdm_turing_llm2>;
				};
			};
		};
	};

	tpdm_turing_cmsr1: tpdm@11183000 {
		compatible = "qcom,coresight-tpdm", "arm,primecell";
		reg = <0x0 0x11183000 0x0 0x1000>;
		reg-names = "tpdm-base";
		qcom,dsb-element-bits = <32>;
		qcom,cmb-element-bits = <32>;

		device-name = "tpdm_turing_cmsr1";

		clocks = <&aoss_qmp>;
		clock-names = "apb_pclk";

		out-ports {
			port {
				tpdm_turing_cmsr1_out_tpda_turing: endpoint {
					remote-endpoint =
					<&tpda_turing_in_tpdm_turing_cmsr1>;
				};
			};
		};
	};

	tpdm_turing_cmsr2: tpdm@11184000 {
		compatible = "qcom,coresight-tpdm", "arm,primecell";
		reg = <0x0 0x11184000 0x0 0x1000>;
		reg-names = "tpdm-base";
		qcom,dsb-element-bits = <32>;
		qcom,cmb-element-bits = <32>;

		device-name = "tpdm_turing_cmsr2";

		clocks = <&aoss_qmp>;
		clock-names = "apb_pclk";

		out-ports {
			port {
				tpdm_turing_cmsr2_out_tpda_turing: endpoint {
					remote-endpoint =
					<&tpda_turing_in_tpdm_turing_cmsr2>;
				};
			};
		};
	};

	tpdm_turing_dpm1: tpdm@11185000 {
		compatible = "qcom,coresight-tpdm", "arm,primecell";
		reg = <0x0 0x11185000 0x0 0x1000>;
		reg-names = "tpdm-base";
		qcom,cmb-element-bits = <64>;

		device-name = "tpdm_turing_dpm1";

		clocks = <&aoss_qmp>;
		clock-names = "apb_pclk";

		out-ports {
			port {
				tpdm_turing_dpm1_out_tpda_turing: endpoint {
					remote-endpoint =
					<&tpda_turing_in_tpdm_turing_dpm1>;
				};
			};
		};
	};

	tpdm_turing_dpm2: tpdm@11186000 {
		compatible = "qcom,coresight-tpdm", "arm,primecell";
		reg = <0x0 0x11186000 0x0 0x1000>;
		reg-names = "tpdm-base";
		qcom,cmb-element-bits = <64>;

		device-name = "tpdm_turing_dpm2";

		clocks = <&aoss_qmp>;
		clock-names = "apb_pclk";

		out-ports {
			port {
				tpdm_turing_dpm2_out_tpda_turing: endpoint {
					remote-endpoint =
					<&tpda_turing_in_tpdm_turing_dpm2>;
				};
			};
		};
	};

	tpda_turing: tpda@11188000 {
		compatible = "qcom,coresight-tpda", "arm,primecell";
		reg = <0x0 0x11188000 0x0 0x1000>;
		reg-names = "tpda-base";

		device-name = "tpda_turing";

		clocks = <&aoss_qmp>;
		clock-names = "apb_pclk";

		in-ports {
			#address-cells = <1>;
			#size-cells = <0>;

			port@0 {
				reg = <0>;
				tpda_turing_in_tpdm_turing: endpoint {
					remote-endpoint =
					<&tpdm_turing_out_tpda_turing>;
				};
			};

			port@1 {
				reg = <1>;
				tpda_turing_in_tpdm_turing_llm: endpoint {
					remote-endpoint =
					<&tpdm_turing_llm_out_tpda_turing>;
				};
			};

			port@2 {
				reg = <2>;
				tpda_turing_in_tpdm_turing_llm2: endpoint {
					remote-endpoint =
					<&tpdm_turing_llm2_out_tpda_turing>;
				};
			};

			port@3 {
				reg = <3>;
				tpda_turing_in_tpdm_turing_cmsr1: endpoint {
					remote-endpoint =
					<&tpdm_turing_cmsr1_out_tpda_turing>;
				};
			};

			port@4 {
				reg = <4>;
				tpda_turing_in_tpdm_turing_cmsr2: endpoint {
					remote-endpoint =
					<&tpdm_turing_cmsr2_out_tpda_turing>;
				};
			};

			port@5 {
				reg = <5>;
				tpda_turing_in_tpdm_turing_dpm1: endpoint {
					remote-endpoint =
					<&tpdm_turing_dpm1_out_tpda_turing>;
				};
			};

			port@6 {
				reg = <6>;
				tpda_turing_in_tpdm_turing_dpm2: endpoint {
					remote-endpoint =
					<&tpdm_turing_dpm2_out_tpda_turing>;
				};
			};
		};

		out-ports {
			#address-cells = <1>;
			#size-cells = <0>;

			port@0 {
				reg = <0>;
				tpda_turing_out_funnel_turing: endpoint {
					remote-endpoint =
					<&funnel_turing_in_tpda_turing>;
				};
			};
		};
	};

	turing_etm0: turing-etm0 {
		compatible = "qcom,coresight-remote-etm";

		device-name = "turing_etm0";

		qcom,atid-num = <4>;
		atid = <38 39 40 41>;
		trace-name = "turing-etm0";

		out-ports {
			port@0 {
				reg = <0>;
				turing_etm0_out_funnel_turing_dup: endpoint {
					remote-endpoint =
						<&funnel_turing_dup_in_turing_etm0>;
				};
			};

			port@1 {
				reg = <1>;
				turing_etm0_out_qmi: endpoint {
					remote-endpoint =
						<&qmi_in_turing_etm0>;
				};
			};
		};
	};

	funnel_turing_dup: funnel@1114c000 {
		compatible = "arm,primecell";
		arm,primecell-periphid = <0x000bb908>;
		reg = <0x0 0x1114c000 0x0 0x1000>,
			<0x0 0x11189000 0x0 0x1000>;
		reg-names = "funnel-base-dummy", "funnel-base-real";

		device-name = "funnel_turing_dup";

		qcom,duplicate-funnel;
		clocks = <&aoss_qmp>;
		clock-names = "apb_pclk";

		in-ports {
			#address-cells = <1>;
			#size-cells = <0>;
			port@3 {
				reg = <3>;
				funnel_turing_dup_in_turing_etm0: endpoint {
					remote-endpoint =
					<&turing_etm0_out_funnel_turing_dup>;
				};
			};
		};

		out-ports {
			port {
				funnel_turing_dup_out_funnel_turing: endpoint {
					remote-endpoint =
					<&funnel_turing_in_funnel_turing_dup>;
				};
			};
		};
	};

	funnel_turing: funnel@11189000 {
		compatible = "arm,coresight-dynamic-funnel", "arm,primecell";
		reg = <0x0 0x11189000 0x0 0x1000>;
		reg-names = "funnel-base";

		device-name = "funnel_turing";

		clocks = <&aoss_qmp>;
		clock-names = "apb_pclk";

		in-ports {
			#address-cells = <1>;
			#size-cells = <0>;

			port@0 {
				reg = <0>;
				funnel_turing_in_tpda_turing: endpoint {
					remote-endpoint =
					<&tpda_turing_out_funnel_turing>;
				};
			};

			port@4 {
				reg = <4>;
				funnel_turing_in_funnel_turing_dup: endpoint {
					remote-endpoint =
					<&funnel_turing_dup_out_funnel_turing>;
				};
			};
		};

		out-ports {
			#address-cells = <1>;
			#size-cells = <0>;

			port@0 {
				reg = <0>;
				funnel_turing_out_tn_ag: endpoint {
					remote-endpoint =
					<&tn_ag_in_funnel_turing>;
				};
			};
		};
	};

	tpdm_gcc: tpdm@1102c000 {
		compatible = "qcom,coresight-tpdm", "arm,primecell";
		reg = <0x0 0x1102c000 0x0 0x1000>;
		reg-names = "tpdm-base";
		qcom,dsb-msrs-num = <32>;

		device-name = "tpdm_gcc";

		clocks = <&aoss_qmp>;
		clock-names = "apb_pclk";

		out-ports {
			port {
				tpdm_gcc_out_tn_ag: endpoint {
					remote-endpoint =
					<&tn_ag_in_tpdm_gcc>;
				};
			};
		};
	};

	tpdm_qm: tpdm@111d0000 {
		compatible = "qcom,coresight-tpdm", "arm,primecell";
		reg = <0x0 0x111d0000 0x0 0x1000>;
		reg-names = "tpdm-base";

		device-name = "tpdm_qm";

		clocks = <&aoss_qmp>;
		clock-names = "apb_pclk";

		out-ports {
			port {
				tpdm_qm_out_tn_ag: endpoint {
					remote-endpoint =
					<&tn_ag_in_tpdm_qm>;
				};
			};
		};
	};

	tpdm_vsense: tpdm@11040000 {
		compatible = "qcom,coresight-tpdm", "arm,primecell";
		reg = <0x0 0x11040000 0x0 0x1000>;
		reg-names = "tpdm-base";

		device-name = "tpdm_vsense";
		status = "disabled";

		clocks = <&aoss_qmp>;
		clock-names = "apb_pclk";

		out-ports {
			port {
				tpdm_vsense_out_tn_ag: endpoint {
					remote-endpoint =
					<&tn_ag_in_tpdm_vsense>;
				};
			};
		};
	};

	tpdm_ipa: tpdm@11422000 {
		compatible = "qcom,coresight-tpdm", "arm,primecell";
		reg = <0x0 0x11422000 0x0 0x1000>;
		reg-names = "tpdm-base";
		qcom,dsb-msrs-num = <32>;

		device-name = "tpdm_ipa";

		clocks = <&aoss_qmp>;
		clock-names = "apb_pclk";

		out-ports {
			port {
				tpdm_ipa_out_tn_ag: endpoint {
					remote-endpoint =
					<&tn_ag_in_tpdm_ipa>;
				};
			};
		};
	};

	tpdm_sdcc5_4: tpdm@10c21000 {
		compatible = "qcom,coresight-tpdm", "arm,primecell";
		reg = <0x0 0x10c21000 0x0 0x1000>;
		reg-names = "tpdm-base";

		device-name = "tpdm_sdcc4";

		clocks = <&aoss_qmp>;
		clock-names = "apb_pclk";
		status = "disabled";

		out-ports {
			port {
				tpdm_sdcc5_4_out_tn_ag: endpoint {
					remote-endpoint =
					<&tn_ag_in_tpdm_sdcc5_4>;
				};
			};
		};
	};

	tpdm_sdcc5_2: tpdm@10c20000 {
		compatible = "qcom,coresight-tpdm", "arm,primecell";
		reg = <0x0 0x10c20000 0x0 0x1000>;
		reg-names = "tpdm-base";

		device-name = "tpdm_sdcc2";

		clocks = <&aoss_qmp>;
		clock-names = "apb_pclk";
		status = "disabled";

		out-ports {
			port {
				tpdm_sdcc5_2_out_tn_ag: endpoint {
					remote-endpoint =
					<&tn_ag_in_tpdm_sdcc5_2>;
				};
			};
		};
	};

	tpdm_ufs: tpdm@11423000 {
		compatible = "qcom,coresight-tpdm", "arm,primecell";
		reg = <0x0 0x11423280 0x0 0x1000>;
		reg-names = "tpdm-base";

		device-name = "tpdm_ufs";

		clocks = <&aoss_qmp>;
		clock-names = "apb_pclk";
		status = "disabled";

		out-ports {
			port {
				tpdm_ufs_out_tn_ag: endpoint {
					remote-endpoint =
					<&tn_ag_in_tpdm_ufs>;
				};
			};
		};
	};

	tpdm_llm_lmh0: tpdm@12180000 {
		compatible = "arm,primecell";
		arm,primecell-periphid = <0x000f0e00>;
		reg = <0x0 0x12180000 0x0 0x1000>;
		reg-names = "tpdm-base";
		qcom,cmb-element-bits = <32>;
		qcom,cmb-msrs-num = <12>;

		device-name = "tpdm_llm_lmh0";

		clocks = <&aoss_qmp>,
			<&cpucp_scmi_clk 0>;
		clock-names = "apb_pclk",
				"atclk";

		out-ports {
			port {
				tpdm_llm_lmh0_out_tpda_apss: endpoint {
					remote-endpoint =
					<&tpda_apss_in_tpdm_llm_lmh0>;
				};
			};
		};
	};

	tpdm_llm_lmh1: tpdm@12181000 {
		compatible = "arm,primecell";
		arm,primecell-periphid = <0x000f0e00>;
		reg = <0x0 0x12181000 0x0 0x1000>;
		reg-names = "tpdm-base";
		qcom,cmb-element-bits = <32>;
		qcom,cmb-msrs-num = <12>;

		device-name = "tpdm_llm_lmh1";

		clocks = <&aoss_qmp>,
			<&cpucp_scmi_clk 0>;
		clock-names = "apb_pclk",
				"atclk";

		out-ports {
			port {
				tpdm_llm_lmh1_out_tpda_apss: endpoint {
					remote-endpoint =
					<&tpda_apss_in_tpdm_llm_lmh1>;
				};
			};
		};
	};

	tpdm_ext_cmb0: tpdm@12183000 {
		compatible = "arm,primecell";
		arm,primecell-periphid = <0x000f0e00>;
		reg = <0x0 0x12183000 0x0 0x1000>;
		reg-names = "tpdm-base";
		qcom,cmb-element-bits = <64>;
		qcom,cmb-msrs-num = <7>;

		device-name = "tpdm_ext_cmb0";

		clocks = <&aoss_qmp>,
			<&cpucp_scmi_clk 0>;
		clock-names = "apb_pclk",
				"atclk";

		out-ports {
			port {
				tpdm_ext_cmb0_out_tpda_apss: endpoint {
					remote-endpoint =
					<&tpda_apss_in_tpdm_ext_cmb0>;
				};
			};
		};
	};

	tpdm_ext_dsb0: tpdm@12185000 {
		compatible = "arm,primecell";
		arm,primecell-periphid = <0x000f0e00>;
		reg = <0x0 0x12185000 0x0 0x1000>;
		reg-names = "tpdm-base";
		qcom,dsb-element-bits = <32>;
		qcom,dsb-msrs-num = <32>;

		device-name = "tpdm_ext_dsb0";

		clocks = <&aoss_qmp>,
			<&cpucp_scmi_clk 0>;
		clock-names = "apb_pclk",
				"atclk";

		out-ports {
			port {
				tpdm_ext_dsb0_out_tpda_apss: endpoint {
					remote-endpoint =
					<&tpda_apss_in_tpdm_ext_dsb0>;
				};
			};
		};
	};

	tpda_apss: tpda@1218b000 {
		compatible = "arm,primecell";
		arm,primecell-periphid = <0x000f0f00>;
		reg = <0x0 0x1218b000 0x0 0x1000>;
		reg-names = "tpda-base";

		device-name = "tpda_apss";

		clocks = <&aoss_qmp>,
			<&cpucp_scmi_clk 0>;
		clock-names = "apb_pclk",
				"atclk";

		in-ports {
			#address-cells = <1>;
			#size-cells = <0>;

			port@0 {
				reg = <0>;
				tpda_apss_in_tpdm_llm_lmh0: endpoint {
					remote-endpoint =
					<&tpdm_llm_lmh0_out_tpda_apss>;
				};
			};

			port@1 {
				reg = <1>;
				tpda_apss_in_tpdm_llm_lmh1: endpoint {
					remote-endpoint =
					<&tpdm_llm_lmh1_out_tpda_apss>;
				};
			};

			port@3 {
				reg = <3>;
				tpda_apss_in_tpdm_ext_cmb0: endpoint {
					remote-endpoint =
					<&tpdm_ext_cmb0_out_tpda_apss>;
				};
			};

			port@4 {
				reg = <4>;
				tpda_apss_in_tpdm_ext_dsb0: endpoint {
					remote-endpoint =
					<&tpdm_ext_dsb0_out_tpda_apss>;
				};
			};
		};

		out-ports {
			port {
				tpda_apss_out_funnel_apss: endpoint {
					remote-endpoint =
					<&funnel_apss_in_tpda_apss>;
				};
			};
		};
	};

	uc_uetm0 {
		compatible = "qcom,coresight-uetm";

		device-name = "uetm_cluster0_uncore";

		cluster = <0>;
		qcom,uncore_uetm;

		out-ports {
			port {
				uetm_uc0_out_funnel_ncc0: endpoint {
				remote-endpoint = <&funnel_ncc0_in_uetm_uc0>;
				};
			};
		};
	};

	qmx_uetm0 {
		compatible = "qcom,coresight-uetm";

		device-name = "uetm_cluster0_qmx";

		cluster = <0>;
		qcom,qmx_uetm;

		out-ports {
			port {
				uetm_qmx0_out_funnel_ncc0_uetm: endpoint {
				remote-endpoint = <&funnel_ncc0_uetm_in_uetm_qmx0>;
				};
			};
		};
	};

	funnel_ncc0_uetm: funnel@1d02b000 {
		compatible = "arm,primecell";
		arm,primecell-periphid = <0x000bb908>;
		reg = <0x0 0x1d02b000 0x0 0x1000>;
		reg-names = "funnel-base";

		device-name = "funnel_ncc0_uetm";

		clocks = <&aoss_qmp>,
			<&cpucp_scmi_clk 0>;
		clock-names = "apb_pclk",
				"atclk";
		qcom,atclk-dependence;
		power-domains = <&CLUSTER_PD0>;

		in-ports {
			#address-cells = <1>;
			#size-cells = <0>;

			port@0 {
				reg = <0>;
				funnel_ncc0_in_uetm_uc0: endpoint {
					remote-endpoint =
					<&uetm_uc0_out_funnel_ncc0>;
				};
			};

			port@1 {
				reg = <1>;
				funnel_ncc0_uetm_in_uetm_qmx0: endpoint {
					remote-endpoint =
					<&uetm_qmx0_out_funnel_ncc0_uetm>;
				};
			};
		};

		out-ports {
			#address-cells = <1>;
			#size-cells = <0>;

			port@0 {
				reg = <0>;
				funnel_ncc0_uetm_out_uc0_etf: endpoint {
					remote-endpoint =
					<&uc0_etf_in_funnel_ncc0_uetm>;
				};
			};
		};
	};

	uc0_etf: tmc@1d028000 {
		compatible = "arm,primecell";
		arm,primecell-periphid = <0x000bb961>;
		reg = <0x0 0x1d028000 0x0 0x1000>;
		reg-names = "tmc-base";

		device-name = "tmc_etf_uc0";

		clocks = <&aoss_qmp>,
			<&cpucp_scmi_clk 0>;
		clock-names = "apb_pclk",
				"atclk";
		qcom,atclk-dependence;
		power-domains = <&CLUSTER_PD0>;

		in-ports {
			port {
				uc0_etf_in_funnel_ncc0_uetm: endpoint {
					remote-endpoint =
					<&funnel_ncc0_uetm_out_uc0_etf>;
				};
			};
		};

		out-ports {
			port {
				etf_uc0_out_replicator_uc0: endpoint {
					remote-endpoint =
					<&replicator_uc0_in_etf_uc0>;
				};
			};
		};
	};

	replicator_uc0: replicator@1d02a000 {
		compatible = "arm,primecell";
		arm,primecell-periphid = <0x000bb909>;
		reg = <0x0 0x1d02a000 0x0 0x1000>;
		reg-names = "replicator-base";

		device-name = "coresight-replicator-uc0";

		qcom,replicator-loses-context;

		clocks = <&aoss_qmp>,
			<&cpucp_scmi_clk 0>;
		clock-names = "apb_pclk",
				"atclk";
		qcom,atclk-dependence;
		power-domains = <&CLUSTER_PD0>;

		in-ports {
			port {
				replicator_uc0_in_etf_uc0: endpoint {
					remote-endpoint =
					<&etf_uc0_out_replicator_uc0>;
				};
			};
		};

		out-ports {
			#address-cells = <1>;
			#size-cells = <0>;

			port@0 {
				reg = <0>;
				rep_uc0_out_funnel_ncc0_lv2: endpoint {
					remote-endpoint =
					<&funnel_ncc0_lv2_in_rep_uc0>;
				};
			};
		};
	};

	ete0 {
		compatible = "arm,embedded-trace-extension";
		cpu = <&CPU0>;

		qcom,skip-power-up;

		out-ports {
			port {
				etm0_out_funnel_etm0: endpoint {
				remote-endpoint = <&funnel_etm0_in_etm0>;
				};
			};
		};
	};

	uetm0 {
		compatible = "qcom,coresight-uetm";

		device-name = "uetm_cluster0_core0";

		cluster = <0>;
		core = <0>;

		out-ports {
			port {
				uetm0_out_funnel_etm0: endpoint {
				remote-endpoint = <&funnel_etm0_in_uetm0>;
				};
			};
		};
	};

	funnel-etm0 {
		compatible = "arm,coresight-static-funnel";
		device-name = "funnel_etm0";

		out-ports {
			port {
				etm0_out_replicator_ncc0_0: endpoint {
				remote-endpoint = <&replicator_ncc0_0_in_etm0>;
				};
			};
		};

		in-ports {
			#address-cells = <1>;
			#size-cells = <0>;

			port@0 {
				reg = <0>;
				funnel_etm0_in_etm0: endpoint {
					remote-endpoint =
					<&etm0_out_funnel_etm0>;
				};
			};

			port@1 {
				reg = <1>;
				funnel_etm0_in_uetm0: endpoint {
				remote-endpoint =
					<&uetm0_out_funnel_etm0>;
				};
			};
		};
	};

	replicator_ncc0_0: replicator@1d090000 {
		compatible = "arm,primecell";
		arm,primecell-periphid = <0x000bb909>;
		reg = <0x0 0x1d090000 0x0 0x1000>;
		reg-names = "replicator-base";

		device-name = "replicator_etr0_ncc0";

		qcom,replicator-loses-context;

		clocks = <&aoss_qmp>,
			<&cpucp_scmi_clk 0>;
		clock-names = "apb_pclk",
				"atclk";
		qcom,atclk-dependence;
		power-domains = <&CLUSTER_PD0>;

		in-ports {
			port {
				replicator_ncc0_0_in_etm0: endpoint {
					remote-endpoint =
					<&etm0_out_replicator_ncc0_0>;
				};
			};
		};

		out-ports {
			#address-cells = <1>;
			#size-cells = <0>;

			port@0 {
				reg = <0>;
				rep_ncc0_0_out_funnel_ncc0_lv1: endpoint {
					remote-endpoint =
					<&funnel_ncc0_lv1_in_rep_ncc0_0>;
				};
			};
		};
	};

	ete1 {
		compatible = "arm,embedded-trace-extension";
		cpu = <&CPU1>;

		qcom,skip-power-up;

		out-ports {
			port {
				etm1_out_funnel_etm1: endpoint {
				remote-endpoint = <&funnel_etm1_in_etm1>;
				};
			};
		};
	};

	uetm1 {
		compatible = "qcom,coresight-uetm";

		device-name = "uetm_cluster0_core1";

		cluster = <0>;
		core = <1>;

		out-ports {
			port {
				uetm1_out_funnel_etm1: endpoint {
				remote-endpoint = <&funnel_etm1_in_uetm1>;
				};
			};
		};
	};

	funnel-etm1 {
		compatible = "arm,coresight-static-funnel";
		device-name = "funnel_etm1";

		out-ports {
			port {
				etm1_out_replicator_ncc0_1: endpoint {
				remote-endpoint = <&replicator_ncc0_1_in_etm1>;
				};
			};
		};

		in-ports {
			#address-cells = <1>;
			#size-cells = <0>;

			port@0 {
				reg = <0>;
				funnel_etm1_in_etm1: endpoint {
					remote-endpoint =
					<&etm1_out_funnel_etm1>;
				};
			};

			port@1 {
				reg = <1>;
				funnel_etm1_in_uetm1: endpoint {
				remote-endpoint =
					<&uetm1_out_funnel_etm1>;
				};
			};
		};
	};

	replicator_ncc0_1: replicator@1d0a0000 {
		compatible = "arm,primecell";
		arm,primecell-periphid = <0x000bb909>;
		reg = <0x0 0x1d0a0000 0x0 0x1000>;
		reg-names = "replicator-base";

		device-name = "replicator_etr1_ncc0";

		qcom,replicator-loses-context;

		clocks = <&aoss_qmp>,
			<&cpucp_scmi_clk 0>;
		clock-names = "apb_pclk",
				"atclk";
		qcom,atclk-dependence;
		power-domains = <&CLUSTER_PD0>;

		in-ports {
			port {
				replicator_ncc0_1_in_etm1: endpoint {
					remote-endpoint =
					<&etm1_out_replicator_ncc0_1>;
				};
			};
		};

		out-ports {
			#address-cells = <1>;
			#size-cells = <0>;

			port@0 {
				reg = <0>;
				rep_ncc0_1_out_funnel_ncc0_lv1: endpoint {
					remote-endpoint =
					<&funnel_ncc0_lv1_in_rep_ncc0_1>;
				};
			};
		};
	};

	ete2 {
		compatible = "arm,embedded-trace-extension";
		cpu = <&CPU2>;

		qcom,skip-power-up;

		out-ports {
			port {
				etm2_out_funnel_etm2: endpoint {
				remote-endpoint = <&funnel_etm2_in_etm2>;
				};
			};
		};
	};

	uetm2 {
		compatible = "qcom,coresight-uetm";

		device-name = "uetm_cluster0_core2";

		cluster = <0>;
		core = <2>;

		out-ports {
			port {
				uetm2_out_funnel_etm2: endpoint {
				remote-endpoint = <&funnel_etm2_in_uetm2>;
				};
			};
		};
	};

	funnel-etm2 {
		compatible = "arm,coresight-static-funnel";
		device-name = "funnel_etm2";

		out-ports {
			port {
				etm2_out_replicator_ncc0_2: endpoint {
				remote-endpoint = <&replicator_ncc0_2_in_etm2>;
				};
			};
		};

		in-ports {
			#address-cells = <1>;
			#size-cells = <0>;

			port@0 {
				reg = <0>;
				funnel_etm2_in_etm2: endpoint {
					remote-endpoint =
					<&etm2_out_funnel_etm2>;
				};
			};

			port@1 {
				reg = <1>;
				funnel_etm2_in_uetm2: endpoint {
				remote-endpoint =
					<&uetm2_out_funnel_etm2>;
				};
			};
		};
	};

	replicator_ncc0_2: replicator@1d0b0000 {
		compatible = "arm,primecell";
		arm,primecell-periphid = <0x000bb909>;
		reg = <0x0 0x1d0b0000 0x0 0x1000>;
		reg-names = "replicator-base";

		device-name = "replicator_etr2_ncc0";

		qcom,replicator-loses-context;

		clocks = <&aoss_qmp>,
			<&cpucp_scmi_clk 0>;
		clock-names = "apb_pclk",
				"atclk";
		qcom,atclk-dependence;
		power-domains = <&CLUSTER_PD0>;

		in-ports {
			port {
				replicator_ncc0_2_in_etm2: endpoint {
					remote-endpoint =
					<&etm2_out_replicator_ncc0_2>;
				};
			};
		};

		out-ports {
			#address-cells = <1>;
			#size-cells = <0>;

			port@0 {
				reg = <0>;
				rep_ncc0_2_out_funnel_ncc0_lv1: endpoint {
					remote-endpoint =
					<&funnel_ncc0_lv1_in_rep_ncc0_2>;
				};
			};
		};
	};

	ete3 {
		compatible = "arm,embedded-trace-extension";
		cpu = <&CPU3>;

		qcom,skip-power-up;

		out-ports {
			port {
				etm3_out_funnel_etm3: endpoint {
				remote-endpoint = <&funnel_etm3_in_etm3>;
				};
			};
		};
	};

	uetm3 {
		compatible = "qcom,coresight-uetm";

		device-name = "uetm_cluster0_core3";

		cluster = <0>;
		core = <3>;

		out-ports {
			port {
				uetm3_out_funnel_etm3: endpoint {
				remote-endpoint = <&funnel_etm3_in_uetm3>;
				};
			};
		};
	};

	funnel-etm3 {
		compatible = "arm,coresight-static-funnel";
		device-name = "funnel_etm3";

		out-ports {
			port {
				etm3_out_replicator_ncc0_3: endpoint {
				remote-endpoint = <&replicator_ncc0_3_in_etm3>;
				};
			};
		};

		in-ports {
			#address-cells = <1>;
			#size-cells = <0>;

			port@0 {
				reg = <0>;
				funnel_etm3_in_etm3: endpoint {
					remote-endpoint =
					<&etm3_out_funnel_etm3>;
				};
			};

			port@1 {
				reg = <1>;
				funnel_etm3_in_uetm3: endpoint {
				remote-endpoint =
					<&uetm3_out_funnel_etm3>;
				};
			};
		};
	};

	replicator_ncc0_3: replicator@1d0c0000 {
		compatible = "arm,primecell";
		arm,primecell-periphid = <0x000bb909>;
		reg = <0x0 0x1d0c0000 0x0 0x1000>;
		reg-names = "replicator-base";

		device-name = "replicator_etr3_ncc0";

		qcom,replicator-loses-context;

		clocks = <&aoss_qmp>,
			<&cpucp_scmi_clk 0>;
		clock-names = "apb_pclk",
				"atclk";
		qcom,atclk-dependence;
		power-domains = <&CLUSTER_PD0>;

		in-ports {
			port {
				replicator_ncc0_3_in_etm3: endpoint {
					remote-endpoint =
					<&etm3_out_replicator_ncc0_3>;
				};
			};
		};

		out-ports {
			#address-cells = <1>;
			#size-cells = <0>;

			port@0 {
				reg = <0>;
				rep_ncc0_3_out_funnel_ncc0_lv1: endpoint {
					remote-endpoint =
					<&funnel_ncc0_lv1_in_rep_ncc0_3>;
				};
			};
		};
	};

	ete4 {
		compatible = "arm,embedded-trace-extension";
		cpu = <&CPU4>;

		qcom,skip-power-up;

		out-ports {
			port {
				etm4_out_funnel_etm4: endpoint {
				remote-endpoint = <&funnel_etm4_in_etm4>;
				};
			};
		};
	};

	uetm4 {
		compatible = "qcom,coresight-uetm";

		device-name = "uetm_cluster0_core4";

		cluster = <0>;
		core = <4>;

		out-ports {
			port {
				uetm4_out_funnel_etm4: endpoint {
				remote-endpoint = <&funnel_etm4_in_uetm4>;
				};
			};
		};
	};

	funnel-etm4 {
		compatible = "arm,coresight-static-funnel";
		device-name = "funnel_etm4";

		out-ports {
			port {
				etm4_out_replicator_ncc0_4: endpoint {
				remote-endpoint = <&replicator_ncc0_4_in_etm4>;
				};
			};
		};

		in-ports {
			#address-cells = <1>;
			#size-cells = <0>;

			port@0 {
				reg = <0>;
				funnel_etm4_in_etm4: endpoint {
					remote-endpoint =
					<&etm4_out_funnel_etm4>;
				};
			};

			port@1 {
				reg = <1>;
				funnel_etm4_in_uetm4: endpoint {
				remote-endpoint =
					<&uetm4_out_funnel_etm4>;
				};
			};
		};
	};

	replicator_ncc0_4: replicator@1d0d0000 {
		compatible = "arm,primecell";
		arm,primecell-periphid = <0x000bb909>;
		reg = <0x0 0x1d0d0000 0x0 0x1000>;
		reg-names = "replicator-base";

		device-name = "replicator_etr4_ncc0";

		qcom,replicator-loses-context;

		clocks = <&aoss_qmp>,
			<&cpucp_scmi_clk 0>;
		clock-names = "apb_pclk",
				"atclk";
		qcom,atclk-dependence;
		power-domains = <&CLUSTER_PD0>;

		in-ports {
			port {
				replicator_ncc0_4_in_etm4: endpoint {
					remote-endpoint =
					<&etm4_out_replicator_ncc0_4>;
				};
			};
		};

		out-ports {
			#address-cells = <1>;
			#size-cells = <0>;

			port@0 {
				reg = <0>;
				rep_ncc0_4_out_funnel_ncc0_lv1: endpoint {
					remote-endpoint =
					<&funnel_ncc0_lv1_in_rep_ncc0_4>;
				};
			};
		};
	};

	ete5 {
		compatible = "arm,embedded-trace-extension";
		cpu = <&CPU5>;

		qcom,skip-power-up;

		out-ports {
			port {
				etm5_out_funnel_etm5: endpoint {
				remote-endpoint = <&funnel_etm5_in_etm5>;
				};
			};
		};
	};

	uetm5 {
		compatible = "qcom,coresight-uetm";

		device-name = "uetm_cluster0_core5";

		cluster = <0>;
		core = <5>;

		out-ports {
			port {
				uetm5_out_funnel_etm5: endpoint {
				remote-endpoint = <&funnel_etm5_in_uetm5>;
				};
			};
		};
	};

	funnel-etm5 {
		compatible = "arm,coresight-static-funnel";
		device-name = "funnel_etm5";

		out-ports {
			port {
				etm5_out_replicator_ncc0_5: endpoint {
				remote-endpoint = <&replicator_ncc0_5_in_etm5>;
				};
			};
		};

		in-ports {
			#address-cells = <1>;
			#size-cells = <0>;

			port@0 {
				reg = <0>;
				funnel_etm5_in_etm5: endpoint {
					remote-endpoint =
					<&etm5_out_funnel_etm5>;
				};
			};

			port@1 {
				reg = <1>;
				funnel_etm5_in_uetm5: endpoint {
				remote-endpoint =
					<&uetm5_out_funnel_etm5>;
				};
			};
		};
	};

	replicator_ncc0_5: replicator@1d0e0000 {
		compatible = "arm,primecell";
		arm,primecell-periphid = <0x000bb909>;
		reg = <0x0 0x1d0e0000 0x0 0x1000>;
		reg-names = "replicator-base";

		device-name = "replicator_etr5_ncc0";

		qcom,replicator-loses-context;

		clocks = <&aoss_qmp>,
			<&cpucp_scmi_clk 0>;
		clock-names = "apb_pclk",
				"atclk";
		qcom,atclk-dependence;
		power-domains = <&CLUSTER_PD0>;

		in-ports {
			port {
				replicator_ncc0_5_in_etm5: endpoint {
					remote-endpoint =
					<&etm5_out_replicator_ncc0_5>;
				};
			};
		};

		out-ports {
			#address-cells = <1>;
			#size-cells = <0>;

			port@0 {
				reg = <0>;
				rep_ncc0_5_out_funnel_ncc0_lv1: endpoint {
					remote-endpoint =
					<&funnel_ncc0_lv1_in_rep_ncc0_5>;
				};
			};
		};
	};

	funnel_ncc0_lv1: funnel@1d081000  {
		compatible = "arm,primecell";
		arm,primecell-periphid = <0x000bb908>;
		reg = <0x0 0x1d081000 0x0 0x1000>;
		reg-names = "funnel-base";

		device-name = "funnel_ncc0_lv1";

		clocks = <&aoss_qmp>,
			<&cpucp_scmi_clk 0>;
		clock-names = "apb_pclk",
				"atclk";
		qcom,atclk-dependence;
		power-domains = <&CLUSTER_PD0>;

		in-ports {
			#address-cells = <1>;
			#size-cells = <0>;

			port@0 {
				reg = <0>;
				funnel_ncc0_lv1_in_rep_ncc0_0: endpoint {
					remote-endpoint =
					<&rep_ncc0_0_out_funnel_ncc0_lv1>;
				};
			};

			port@1 {
				reg = <1>;
				funnel_ncc0_lv1_in_rep_ncc0_1: endpoint {
					remote-endpoint =
					<&rep_ncc0_1_out_funnel_ncc0_lv1>;
				};
			};

			port@2 {
				reg = <2>;
				funnel_ncc0_lv1_in_rep_ncc0_2: endpoint {
					remote-endpoint =
					<&rep_ncc0_2_out_funnel_ncc0_lv1>;
				};
			};

			port@3 {
				reg = <3>;
				funnel_ncc0_lv1_in_rep_ncc0_3: endpoint {
					remote-endpoint =
					<&rep_ncc0_3_out_funnel_ncc0_lv1>;
				};
			};

			port@4 {
				reg = <4>;
				funnel_ncc0_lv1_in_rep_ncc0_4: endpoint {
					remote-endpoint =
					<&rep_ncc0_4_out_funnel_ncc0_lv1>;
				};
			};

			port@5 {
				reg = <5>;
				funnel_ncc0_lv1_in_rep_ncc0_5: endpoint {
					remote-endpoint =
					<&rep_ncc0_5_out_funnel_ncc0_lv1>;
				};
			};
		};

		out-ports {
			port {
				funnel_ncc0_lv1_out_funnel_ncc0_lv2: endpoint {
					remote-endpoint =
					<&funnel_ncc0_lv2_in_funnel_ncc0_lv1>;
				};
			};
		};
	};

	funnel_ncc0_lv2: funnel@1d021000 {
		compatible = "arm,primecell";
		arm,primecell-periphid = <0x000bb908>;
		reg = <0x0 0x1d021000 0x0 0x1000>;
		reg-names = "funnel-base";

		device-name = "funnel_ncc0_lv2";

		clocks = <&aoss_qmp>,
			<&cpucp_scmi_clk 0>;
		clock-names = "apb_pclk",
				"atclk";
		qcom,atclk-dependence;
		power-domains = <&CLUSTER_PD0>;

		in-ports {
			#address-cells = <1>;
			#size-cells = <0>;

			port@1 {
				reg = <1>;
				funnel_ncc0_lv2_in_rep_uc0: endpoint {
					remote-endpoint =
					<&rep_uc0_out_funnel_ncc0_lv2>;
				};
			};

			port@2 {
				reg = <2>;
				funnel_ncc0_lv2_in_funnel_ncc0_lv1: endpoint {
					remote-endpoint =
					<&funnel_ncc0_lv1_out_funnel_ncc0_lv2>;
				};
			};
		};

		out-ports {
			port {
				funnel_ncc0_lv2_out_apss_etf: endpoint {
					remote-endpoint =
					<&apss_etf_in_funnel_ncc0_lv2>;
				};
			};
		};
	};

	ncc_etf: tmc@1d029000 {
		compatible = "arm,primecell";
		arm,primecell-periphid = <0x000bb961>;
		reg = <0x0 0x1d029000 0x0 0x1000>;
		reg-names = "tmc-base";

		device-name = "tmc_etf_ncc0";

		clocks = <&aoss_qmp>,
			<&cpucp_scmi_clk 0>;
		clock-names = "apb_pclk",
				"atclk";
		qcom,atclk-dependence;
		power-domains = <&CLUSTER_PD0>;

		in-ports {
			port {
				apss_etf_in_funnel_ncc0_lv2: endpoint {
					remote-endpoint =
					<&funnel_ncc0_lv2_out_apss_etf>;
				};
			};
		};

		out-ports {
			port {
				apss_etf_out_funnel_apss: endpoint {
					remote-endpoint =
					<&funnel_apss_in_apss_etf>;
				};
			};
		};
	};

	uc_uetm1 {
		compatible = "qcom,coresight-uetm";

		device-name = "uetm_cluster1_uncore";

		cluster = <1>;
		qcom,uncore_uetm;

		out-ports {
			port {
				uetm_uc1_out_funnel_ncc1_uetm: endpoint {
				remote-endpoint = <&funnel_ncc1_uetm_in_uetm_uc1>;
				};
			};
		};
	};

	qmx_uetm1 {
		compatible = "qcom,coresight-uetm";

		device-name = "uetm_cluster1_qmx";

		cluster = <1>;
		qcom,qmx_uetm;

		out-ports {
			port {
				uetm_qmx1_out_funnel_ncc1_uetm: endpoint {
				remote-endpoint = <&funnel_ncc1_uetm_in_uetm_qmx1>;
				};
			};
		};
	};

	funnel_ncc1_uetm: funnel@1d12b000 {
		compatible = "arm,primecell";
		arm,primecell-periphid = <0x000bb908>;
		reg = <0x0 0x1d12b000 0x0 0x1000>;
		reg-names = "funnel-base";

		device-name = "funnel_ncc1_uetm";

		clocks = <&aoss_qmp>,
			<&cpucp_scmi_clk 0>;
		clock-names = "apb_pclk",
				"atclk";
		qcom,atclk-dependence;
		power-domains = <&CLUSTER_PD1>;

		in-ports {
			#address-cells = <1>;
			#size-cells = <0>;

			port@0 {
				reg = <0>;
				funnel_ncc1_uetm_in_uetm_uc1: endpoint {
					remote-endpoint =
					<&uetm_uc1_out_funnel_ncc1_uetm>;
				};
			};

			port@1 {
				reg = <1>;
				funnel_ncc1_uetm_in_uetm_qmx1: endpoint {
					remote-endpoint =
					<&uetm_qmx1_out_funnel_ncc1_uetm>;
				};
			};
		};

		out-ports {
			#address-cells = <1>;
			#size-cells = <0>;

			port@0 {
				reg = <0>;
				funnel_ncc1_uetm_out_uc1_etf: endpoint {
					remote-endpoint =
					<&uc1_etf_in_funnel_ncc1_uetm>;
				};
			};
		};
	};

	uc1_etf: tmc@1d128000 {
		compatible = "arm,primecell";
		arm,primecell-periphid = <0x000bb961>;
		reg = <0x0 0x1d128000 0x0 0x1000>;
		reg-names = "tmc-base";

		device-name = "tmc_etf_uc1";

		clocks = <&aoss_qmp>,
			<&cpucp_scmi_clk 0>;
		clock-names = "apb_pclk",
				"atclk";
		qcom,atclk-dependence;
		power-domains = <&CLUSTER_PD1>;

		in-ports {
			port {
				uc1_etf_in_funnel_ncc1_uetm: endpoint {
					remote-endpoint =
					<&funnel_ncc1_uetm_out_uc1_etf>;
				};
			};
		};

		out-ports {
			port {
				etf_uc1_out_replicator_uc1: endpoint {
					remote-endpoint =
					<&replicator_uc1_in_etf_uc1>;
				};
			};
		};
	};

	replicator_uc1: replicator@1d12a000 {
		compatible = "arm,primecell";
		arm,primecell-periphid = <0x000bb909>;
		reg = <0x0 0x1d12a000 0x0 0x1000>;
		reg-names = "replicator-base";

		device-name = "replicator_uc1";

		qcom,replicator-loses-context;

		clocks = <&aoss_qmp>,
			<&cpucp_scmi_clk 0>;
		clock-names = "apb_pclk",
				"atclk";
		qcom,atclk-dependence;
		power-domains = <&CLUSTER_PD1>;

		in-ports {
			port {
				replicator_uc1_in_etf_uc1: endpoint {
					remote-endpoint =
					<&etf_uc1_out_replicator_uc1>;
				};
			};
		};

		out-ports {
			#address-cells = <1>;
			#size-cells = <0>;

			port@0 {
				reg = <0>;
				rep_uc1_out_funnel_ncc1_lv2: endpoint {
					remote-endpoint =
					<&funnel_ncc1_lv2_in_rep_uc1>;
				};
			};
		};
	};

	ete6 {
		compatible = "arm,embedded-trace-extension";
		cpu = <&CPU6>;

		qcom,skip-power-up;

		out-ports {
			port {
				etm6_out_funnel_etm6: endpoint {
				remote-endpoint = <&funnel_etm6_in_etm6>;
				};
			};
		};
	};

	uetm6 {
		compatible = "qcom,coresight-uetm";

		device-name = "uetm_cluster1_core0";

		cluster = <1>;
		core = <0>;

		out-ports {
			port {
				uetm6_out_funnel_etm6: endpoint {
				remote-endpoint = <&funnel_etm6_in_uetm6>;
				};
			};
		};
	};

	funnel-etm6 {
		compatible = "arm,coresight-static-funnel";
		device-name = "funnel_etm6";

		out-ports {
			port {
				etm6_out_replicator_ncc1_0: endpoint {
				remote-endpoint = <&replicator_ncc1_0_in_etm6>;
				};
			};
		};

		in-ports {
			#address-cells = <1>;
			#size-cells = <0>;

			port@0 {
				reg = <0>;
				funnel_etm6_in_etm6: endpoint {
					remote-endpoint =
					<&etm6_out_funnel_etm6>;
				};
			};

			port@1 {
				reg = <1>;
				funnel_etm6_in_uetm6: endpoint {
				remote-endpoint =
					<&uetm6_out_funnel_etm6>;
				};
			};
		};
	};

	replicator_ncc1_0: replicator@1d190000 {
		compatible = "arm,primecell";
		arm,primecell-periphid = <0x000bb909>;
		reg = <0x0 0x1d190000 0x0 0x1000>;
		reg-names = "replicator-base";

		device-name = "replicator_etr0_ncc1";

		qcom,replicator-loses-context;

		clocks = <&aoss_qmp>,
			<&cpucp_scmi_clk 0>;
		clock-names = "apb_pclk",
				"atclk";
		qcom,atclk-dependence;
		power-domains = <&CLUSTER_PD1>;

		in-ports {
			port {
				replicator_ncc1_0_in_etm6: endpoint {
					remote-endpoint =
					<&etm6_out_replicator_ncc1_0>;
				};
			};
		};

		out-ports {
			#address-cells = <1>;
			#size-cells = <0>;

			port@0 {
				reg = <0>;
				rep_ncc1_0_out_funnel_ncc1_lv1: endpoint {
					remote-endpoint =
					<&funnel_ncc1_lv1_in_rep_ncc1_0>;
				};
			};
		};
	};

	ete7 {
		compatible = "arm,embedded-trace-extension";
		cpu = <&CPU7>;

		qcom,skip-power-up;

		out-ports {
			port {
				etm7_out_funnel_etm7: endpoint {
				remote-endpoint = <&funnel_etm7_in_etm7>;
				};
			};
		};
	};

	uetm7 {
		compatible = "qcom,coresight-uetm";

		device-name = "uetm_cluster1_core1";

		cluster = <1>;
		core = <1>;

		out-ports {
			port {
				uetm7_out_funnel_etm7: endpoint {
				remote-endpoint = <&funnel_etm7_in_uetm7>;
				};
			};
		};
	};

	funnel-etm7 {
		compatible = "arm,coresight-static-funnel";
		device-name = "funnel_etm7";

		out-ports {
			port {
				etm7_out_replicator_ncc1_1: endpoint {
				remote-endpoint = <&replicator_ncc1_1_in_etm7>;
				};
			};
		};

		in-ports {
			#address-cells = <1>;
			#size-cells = <0>;

			port@0 {
				reg = <0>;
				funnel_etm7_in_etm7: endpoint {
					remote-endpoint =
					<&etm7_out_funnel_etm7>;
				};
			};

			port@1 {
				reg = <1>;
				funnel_etm7_in_uetm7: endpoint {
				remote-endpoint =
					<&uetm7_out_funnel_etm7>;
				};
			};
		};
	};

	replicator_ncc1_1: replicator@1d1a0000 {
		compatible = "arm,primecell";
		arm,primecell-periphid = <0x000bb909>;
		reg = <0x0 0x1d1a0000 0x0 0x1000>;
		reg-names = "replicator-base";

		device-name = "replicator_etr1_ncc1";

		qcom,replicator-loses-context;
		clocks = <&aoss_qmp>,
			<&cpucp_scmi_clk 0>;
		clock-names = "apb_pclk",
				"atclk";
		qcom,atclk-dependence;
		power-domains = <&CLUSTER_PD1>;

		in-ports {
			port {
				replicator_ncc1_1_in_etm7: endpoint {
					remote-endpoint =
					<&etm7_out_replicator_ncc1_1>;
				};
			};
		};

		out-ports {
			#address-cells = <1>;
			#size-cells = <0>;

			port@0 {
				reg = <0>;
				rep_ncc1_1_out_funnel_ncc1_lv1: endpoint {
					remote-endpoint =
					<&funnel_ncc1_lv1_in_rep_ncc1_1>;
				};
			};
		};
	};

	funnel_ncc1_lv1: funnel@1d181000 {
		compatible = "arm,primecell";
		arm,primecell-periphid = <0x000bb908>;
		reg = <0x0 0x1d181000 0x0 0x1000>;
		reg-names = "funnel-base";

		device-name = "funnel_ncc1_lv1";

		clocks = <&aoss_qmp>,
			<&cpucp_scmi_clk 0>;
		clock-names = "apb_pclk",
				"atclk";
		qcom,atclk-dependence;
		power-domains = <&CLUSTER_PD1>;

		in-ports {
			#address-cells = <1>;
			#size-cells = <0>;

			port@0 {
				reg = <0>;
				funnel_ncc1_lv1_in_rep_ncc1_0: endpoint {
					remote-endpoint =
					<&rep_ncc1_0_out_funnel_ncc1_lv1>;
				};
			};

			port@1 {
				reg = <1>;
				funnel_ncc1_lv1_in_rep_ncc1_1: endpoint {
					remote-endpoint =
					<&rep_ncc1_1_out_funnel_ncc1_lv1>;
				};
			};
		};

		out-ports {
			port {
				funnel_ncc1_lv1_out_funnel_ncc1_lv2: endpoint {
					remote-endpoint =
					<&funnel_ncc1_lv2_in_funnel_ncc1_lv1>;
				};
			};
		};
	};

	funnel_ncc1_lv2: funnel@1d121000 {
		compatible = "arm,primecell";
		arm,primecell-periphid = <0x000bb908>;
		reg = <0x0 0x1d121000 0x0 0x1000>;
		reg-names = "funnel-base";

		device-name = "funnel_ncc1_lv2";

		clocks = <&aoss_qmp>,
			<&cpucp_scmi_clk 0>;
		clock-names = "apb_pclk",
				"atclk";
		qcom,atclk-dependence;
		power-domains = <&CLUSTER_PD1>;

		in-ports {
			#address-cells = <1>;
			#size-cells = <0>;

			port@1 {
				reg = <1>;
				funnel_ncc1_lv2_in_rep_uc1: endpoint {
					remote-endpoint =
					<&rep_uc1_out_funnel_ncc1_lv2>;
				};
			};

			port@2 {
				reg = <2>;
				funnel_ncc1_lv2_in_funnel_ncc1_lv1: endpoint {
					remote-endpoint =
					<&funnel_ncc1_lv1_out_funnel_ncc1_lv2>;
				};
			};
		};

		out-ports {
			port {
				funnel_ncc1_lv2_out_apss_etf: endpoint {
					remote-endpoint =
					<&apss_etf_in_funnel_ncc1_lv2>;
				};
			};
		};
	};

	tmc@1d129000 {
		compatible = "arm,primecell";
		arm,primecell-periphid = <0x000bb961>;
		reg = <0x0 0x1d129000 0x0 0x1000>;
		reg-names = "tmc-base";

		device-name = "tmc_etf_ncc1";

		clocks = <&aoss_qmp>,
			<&cpucp_scmi_clk 0>;
		clock-names = "apb_pclk",
				"atclk";
		qcom,atclk-dependence;
		power-domains = <&CLUSTER_PD1>;

		in-ports {
			port {
				apss_etf_in_funnel_ncc1_lv2: endpoint {
					remote-endpoint =
					<&funnel_ncc1_lv2_out_apss_etf>;
				};
			};
		};

		out-ports {
			port {
				apss_etf1_out_funnel_apss: endpoint {
					remote-endpoint =
					<&funnel_apss_in_apss_etf1>;
				};
			};
		};
	};

	funnel_apss: funnel@12080000 {
		compatible = "arm,primecell";
		arm,primecell-periphid = <0x000bb908>;
		reg = <0x0 0x12080000 0x0 0x1000>;
		reg-names = "funnel-base";

		device-name = "funnel_apss";

		clocks = <&aoss_qmp>,
			<&cpucp_scmi_clk 0>;
		clock-names = "apb_pclk",
				"atclk";
		qcom,atclk-dependence;


		in-ports {
			#address-cells = <1>;
			#size-cells = <0>;

			port@0 {
				reg = <0>;
				funnel_apss_in_apss_etf: endpoint {
					remote-endpoint =
					<&apss_etf_out_funnel_apss>;
				};
			};

			port@1 {
				reg = <1>;
				funnel_apss_in_apss_etf1: endpoint {
					remote-endpoint =
					<&apss_etf1_out_funnel_apss>;
				};
			};

			port@5 {
				reg = <5>;
				funnel_apss_in_tpda_apss: endpoint {
					remote-endpoint =
					<&tpda_apss_out_funnel_apss>;
				};
			};
		};

		out-ports {
			port {
				funnel_apss_out_tn_ag: endpoint {
					remote-endpoint =
					<&tn_ag_in_funnel_apss>;
				};
			};
		};
	};

	tpdm_lpass_crdl: tpdm@11384000 {
		compatible = "qcom,coresight-tpdm", "arm,primecell";
		reg = <0x0 0x11384000 0x0 0x1000>;
		reg-names = "tpdm-base";
		qcom,dsb-msrs-num = <32>;

		device-name = "tpdm_lpass_crdl";

		clocks = <&aoss_qmp>;
		clock-names = "apb_pclk";
		status = "disabled";

		out-ports {
			port {
				tpdm_crdl_out_tn_lpass: endpoint {
					remote-endpoint =
					<&tn_lpass_in_tpdm_crdl>;
				};
			};
		};
	};

	tn_lpass: tn@11380000 {
		compatible = "arm,primecell";
		arm,primecell-periphid = <0x000f0c00>;
		reg = <0x0 0x11380000 0x0 0x1000>;
		reg-names = "traceNoc-base";

		device-name = "tracenoc_lpass";

		clocks = <&aoss_qmp>;
		clock-names = "apb_pclk";

		in-ports {
			#address-cells = <1>;
			#size-cells = <0>;

			port@0 {
				reg = <0>;
				tn_lpass_in_tpdm_crdl: endpoint {
					remote-endpoint =
					<&tpdm_crdl_out_tn_lpass>;
				};
			};
		};

		out-ports {
			port {
				tn_lpass_out_tn_ag: endpoint {
					remote-endpoint =
					<&tn_ag_in_tn_lpass>;
				};
			};
		};
	};

	tpdm_soccp: tpdm@113a4000 {
		compatible = "qcom,coresight-tpdm", "arm,primecell";
		reg = <0x0 0x113a4000 0x0 0x1000>;
		reg-names = "tpdm-base";
		qcom,dsb-msrs-num = <32>;

		device-name = "tpdm_soccp";

		clocks = <&aoss_qmp>;
		clock-names = "apb_pclk";

		out-ports {
			port {
				tpdm_soccp_out_tn_soccp: endpoint {
					remote-endpoint =
					<&tn_soccp_in_tpdm_soccp>;
				};
			};
		};
	};

	tn_soccp: tn@113a0000 {
		compatible = "arm,primecell";
		arm,primecell-periphid = <0x000f0c00>;
		reg = <0x0 0x113a0000 0x0 0x1000>;
		reg-names = "traceNoc-base";

		device-name = "tracenoc_soccp";

		clocks = <&aoss_qmp>;
		clock-names = "apb_pclk";

		in-ports {
			#address-cells = <1>;
			#size-cells = <0>;

			port@0 {
				reg = <0>;
				tn_soccp_in_tpdm_soccp: endpoint {
					remote-endpoint =
					<&tpdm_soccp_out_tn_soccp>;
				};
			};
		};

		out-ports {
			port {
				tn_soccp_out_tn_ag: endpoint {
					remote-endpoint =
					<&tn_ag_in_tn_soccp>;
				};
			};
		};
	};

	tpdm_video: tpdm@11034000 {
		compatible = "qcom,coresight-tpdm", "arm,primecell";
		reg = <0x0 0x11034000 0x0 0x1000>;
		reg-names = "tpdm-base";
		qcom,dsb-msrs-num = <32>;

		device-name = "tpdm_video";

		clocks = <&aoss_qmp>;
		clock-names = "apb_pclk";
		status = "disabled";

		out-ports {
			port {
				tpdm_video_out_tn_video: endpoint {
					remote-endpoint =
					<&tn_video_in_tpdm_video>;
				};
			};
		};
	};

	tn_video: tn@11030000 {
		compatible = "arm,primecell";
		arm,primecell-periphid = <0x000f0c00>;
		reg = <0x0 0x11030000 0x0 0x1000>;
		reg-names = "traceNoc-base";

		device-name = "tracenoc_video";

		clocks = <&aoss_qmp>;
		clock-names = "apb_pclk";

		in-ports {
			#address-cells = <1>;
			#size-cells = <0>;

			port@0 {
				reg = <0>;
				tn_video_in_tpdm_video: endpoint {
					remote-endpoint =
					<&tpdm_video_out_tn_video>;
				};
			};
		};

		out-ports {
			port {
				tn_video_out_tn_ag: endpoint {
					remote-endpoint =
					<&tn_ag_in_tn_video>;
				};
			};
		};
	};

	tpdm_eva: tpdm@111c4000 {
		compatible = "qcom,coresight-tpdm", "arm,primecell";
		reg = <0x0 0x111c4000 0x0 0x1000>;
		reg-names = "tpdm-base";
		qcom,dsb-msrs-num = <32>;

		device-name = "tpdm_eva";

		clocks = <&aoss_qmp>;
		clock-names = "apb_pclk";
		status = "disabled";

		out-ports {
			port {
				tpdm_eva_out_tn_eva: endpoint {
					remote-endpoint =
					<&tn_eva_in_tpdm_eva>;
				};
			};
		};
	};

	tn_eva: tn@111c0000 {
		compatible = "arm,primecell";
		arm,primecell-periphid = <0x000f0c00>;
		reg = <0x0 0x111c0000 0x0 0x1000>;
		reg-names = "traceNoc-base";

		device-name = "tracenoc_eva";

		clocks = <&aoss_qmp>;
		clock-names = "apb_pclk";

		in-ports {
			#address-cells = <1>;
			#size-cells = <0>;

			port@0 {
				reg = <0>;
				tn_eva_in_tpdm_eva: endpoint {
					remote-endpoint =
					<&tpdm_eva_out_tn_eva>;
				};
			};
		};

		out-ports {
			port {
				tn_eva_out_tn_ag: endpoint {
					remote-endpoint =
					<&tn_ag_in_tn_eva>;
				};
			};
		};
	};

	tpdm_mdss: tpdm@11463000 {
		compatible = "qcom,coresight-tpdm", "arm,primecell";
		reg = <0x0 0x11463000 0x0 0x1000>;
		reg-names = "tpdm-base";
		qcom,dsb-msrs-num = <16>;

		device-name = "tpdm_mdss";

		clocks = <&aoss_qmp>;
		clock-names = "apb_pclk";
		status = "disabled";

		out-ports {
			port {
				tpdm_mdss_out_tn_mdss: endpoint {
					remote-endpoint =
					<&tn_mdss_in_tpdm_mdss>;
				};
			};
		};
	};

	tpdm_mdss_rscc: tpdm@11464000 {
		compatible = "qcom,coresight-tpdm", "arm,primecell";
		reg = <0x0 0x11464000 0x0 0x1000>;
		reg-names = "tpdm-base";

		device-name = "tpdm_mdss_rscc";

		clocks = <&aoss_qmp>;
		clock-names = "apb_pclk";
		status = "disabled";

		out-ports {
			port {
				tpdm_mdss_rscc_out_tn_mdss: endpoint {
					remote-endpoint =
					<&tn_mdss_in_tpdm_mdss_rscc>;
				};
			};
		};
	};

	tpdm_mdss_dcp: tpdm@11465000 {
		compatible = "qcom,coresight-tpdm", "arm,primecell";
		reg = <0x0 0x11465000 0x0 0x1000>;
		reg-names = "tpdm-base";

		device-name = "tpdm_mdss_dcp";

		clocks = <&aoss_qmp>;
		clock-names = "apb_pclk";
		status = "disabled";

		out-ports {
			port {
				tpdm_mdss_dcp_out_tn_mdss: endpoint {
					remote-endpoint =
					<&tn_mdss_in_tpdm_mdss_dcp>;
				};
			};
		};
	};

	tn_mdss: tn@11460000 {
		compatible = "arm,primecell";
		arm,primecell-periphid = <0x000f0c00>;
		reg = <0x0 0x11460000 0x0 0x1000>;
		reg-names = "traceNoc-base";

		device-name = "tracenoc_mdss";

		clocks = <&aoss_qmp>;
		clock-names = "apb_pclk";
		status = "disabled";

		in-ports {
			#address-cells = <1>;
			#size-cells = <0>;

			port@0 {
				reg = <0>;
				tn_mdss_in_tpdm_mdss: endpoint {
					remote-endpoint =
					<&tpdm_mdss_out_tn_mdss>;
				};
			};

			port@1 {
				reg = <1>;
				tn_mdss_in_tpdm_mdss_rscc: endpoint {
					remote-endpoint =
					<&tpdm_mdss_rscc_out_tn_mdss>;
				};
			};

			port@2 {
				reg = <2>;
				tn_mdss_in_tpdm_mdss_dcp: endpoint {
					remote-endpoint =
					<&tpdm_mdss_dcp_out_tn_mdss>;
				};
			};
		};

		out-ports {
			port {
				tn_mdss_out_tn_ag: endpoint {
					remote-endpoint =
					<&tn_ag_in_tn_mdss>;
				};
			};
		};
	};

	tpdm_gpu: tpdm@11103000 {
		compatible = "qcom,coresight-tpdm", "arm,primecell";
		reg = <0x0 0x11103000 0x0 0x1000>;
		reg-names = "tpdm-base";
		qcom,dsb-msrs-num = <16>;

		device-name = "tpdm_gpu";

		clocks = <&aoss_qmp>;
		clock-names = "apb_pclk";
		status = "disabled";

		out-ports {
			port {
				tpdm_gpu_out_tn_gpu: endpoint {
					remote-endpoint =
					<&tn_gpu_in_tpdm_gpu>;
				};
			};
		};
	};

	funnel_gfx: funnel@11163000 {
		compatible = "arm,primecell";
		arm,primecell-periphid = <0x000bb908>;
		reg = <0x0 0x11163000 0x0 0x1000>;
		reg-names = "funnel-base";

		device-name = "funnel_gfx";

		clocks = <&aoss_qmp>;
		clock-names = "apb_pclk";
		status = "disabled";

		out-ports {
			port {
				funnel_gfx_out_tn_gpu: endpoint {
				remote-endpoint =
					<&tn_gpu_in_funnel_gfx>;
				};
			};
		};
	};

	tn_gpu: tn@11100000 {
		compatible = "arm,primecell";
		arm,primecell-periphid = <0x000f0c00>;
		reg = <0x0 0x11100000 0x0 0x1000>;
		reg-names = "traceNoc-base";

		device-name = "tracenoc_gpu";

		clocks = <&aoss_qmp>;
		clock-names = "apb_pclk";

		in-ports {
			#address-cells = <1>;
			#size-cells = <0>;

			port@0 {
				reg = <0>;
				tn_gpu_in_tpdm_gpu: endpoint {
					remote-endpoint =
					<&tpdm_gpu_out_tn_gpu>;
				};
			};
			port@1 {
				reg = <1>;
				tn_gpu_in_funnel_gfx: endpoint {
					remote-endpoint =
					<&funnel_gfx_out_tn_gpu>;
				};
			};
		};

		out-ports {
			port {
				tn_gpu_out_tn_ag: endpoint {
					remote-endpoint =
					<&tn_ag_in_tn_gpu>;
				};
			};
		};
	};

	tpdm_ddr_llcc0: tpdm@11521000 {
		compatible = "qcom,coresight-tpdm", "arm,primecell";
		reg = <0x0 0x11521000 0x0 0x1000>;
		reg-names = "tpdm-base";

		device-name = "tpdm_ddr_llcc0";

		clocks = <&aoss_qmp>;
		clock-names = "apb_pclk";

		out-ports {
			port {
				tpdm_ddr_llcc0_out_tn_ddr: endpoint {
					remote-endpoint =
					<&tn_ddr_in_tpdm_ddr_llcc0>;
				};
			};
		};
	};

	tpdm_ddr_llcc1: tpdm@11522000 {
		compatible = "qcom,coresight-tpdm", "arm,primecell";
		reg = <0x0 0x11522000 0x0 0x1000>;
		reg-names = "tpdm-base";

		device-name = "tpdm_ddr_llcc1";

		clocks = <&aoss_qmp>;
		clock-names = "apb_pclk";

		out-ports {
			port {
				tpdm_ddr_llcc1_out_tn_ddr: endpoint {
					remote-endpoint =
					<&tn_ddr_in_tpdm_ddr_llcc1>;
				};
			};
		};
	};

	tpdm_ddr_llcc2: tpdm@11523000 {
		compatible = "qcom,coresight-tpdm", "arm,primecell";
		reg = <0x0 0x11523000 0x0 0x1000>;
		reg-names = "tpdm-base";

		device-name = "tpdm_ddr_llcc2";

		clocks = <&aoss_qmp>;
		clock-names = "apb_pclk";

		out-ports {
			port {
				tpdm_ddr_llcc2_out_tn_ddr: endpoint {
					remote-endpoint =
					<&tn_ddr_in_tpdm_ddr_llcc2>;
				};
			};
		};
	};

	tpdm_ddr_llcc3: tpdm@11524000 {
		compatible = "qcom,coresight-tpdm", "arm,primecell";
		reg = <0x0 0x11524000 0x0 0x1000>;
		reg-names = "tpdm-base";

		device-name = "tpdm_ddr_llcc3";

		clocks = <&aoss_qmp>;
		clock-names = "apb_pclk";

		out-ports {
			port {
				tpdm_ddr_llcc3_out_tn_ddr: endpoint {
					remote-endpoint =
					<&tn_ddr_in_tpdm_ddr_llcc3>;
				};
			};
		};
	};

	tpdm_ddr_shrm: tpdm@11504000 {
		compatible = "qcom,coresight-tpdm", "arm,primecell";
		reg = <0x0 0x11504000 0x0 0x1000>;
		reg-names = "tpdm-base";
		qcom,dsb-msrs-num = <32>;

		device-name = "tpdm_ddr_shrm";

		clocks = <&aoss_qmp>;
		clock-names = "apb_pclk";
		status = "disabled";

		out-ports {
			port {
				tpdm_ddr_shrm_out_tn_ddr: endpoint {
					remote-endpoint =
					<&tn_ddr_in_tpdm_ddr_shrm>;
				};
			};
		};
	};

	tpdm_ddr_qpace: tpdm@11525000 {
		compatible = "qcom,coresight-tpdm", "arm,primecell";
		reg = <0x0 0x11525000 0x0 0x1000>;
		reg-names = "tpdm-base";

		device-name = "tpdm_ddr_qpace";

		clocks = <&aoss_qmp>;
		clock-names = "apb_pclk";
		status = "disabled";

		out-ports {
			port {
				tpdm_ddr_qpace_out_tn_ddr: endpoint {
					remote-endpoint =
					<&tn_ddr_in_tpdm_ddr_qpace>;
				};
			};
		};
	};

	tpdm_ddr_ch02: tpdm@1150b000 {
		compatible = "qcom,coresight-tpdm", "arm,primecell";
		reg = <0x0 0x1150b000 0x0 0x1000>;
		reg-names = "tpdm-base";
		qcom,dsb-msrs-num = <16>;

		device-name = "tpdm_ddr_ch02";

		clocks = <&aoss_qmp>;
		clock-names = "apb_pclk";

		out-ports {
			port {
				tpdm_ddr_ch02_out_tn_ddr: endpoint {
					remote-endpoint =
					<&tn_ddr_in_tpdm_ddr_ch02>;
				};
			};
		};
	};

	tpdm_ddr_ch13: tpdm@1150e000 {
		compatible = "qcom,coresight-tpdm", "arm,primecell";
		reg = <0x0 0x1150e000 0x0 0x1000>;
		reg-names = "tpdm-base";
		qcom,dsb-msrs-num = <16>;

		device-name = "tpdm_ddr_ch13";

		clocks = <&aoss_qmp>;
		clock-names = "apb_pclk";

		out-ports {
			port {
				tpdm_ddr_ch13_out_tn_ddr: endpoint {
					remote-endpoint =
					<&tn_ddr_in_tpdm_ddr_ch13>;
				};
			};
		};
	};

	gemnoc {
		compatible = "arm,coresight-dummy-source";
		device-name = "gemnoc";
		atid = <95>;

		out-ports {
			port {
				gemnoc_out_tn_ddr: endpoint {
					remote-endpoint =
					<&tn_ddr_in_gemnoc>;
				};
			};
		};
	};

	gladiator {
		compatible = "arm,coresight-dummy-source";
		device-name = "gladiator";
		atid = <96>;

		out-ports {
			port {
				gladiator_out_tn_ddr: endpoint {
					remote-endpoint =
					<&tn_ddr_in_gladiator>;
				};
			};
		};
	};

	tn_ddr: tn@11500000 {
		compatible = "arm,primecell";
		arm,primecell-periphid = <0x000f0c00>;
		reg = <0x0 0x11500000 0x0 0x3c00>;
		reg-names = "traceNoc-base";

		device-name = "tracenoc_ddr";

		clocks = <&aoss_qmp>;
		clock-names = "apb_pclk";

		in-ports {
			#address-cells = <1>;
			#size-cells = <0>;

			port@0 {
				reg = <0>;
				tn_ddr_in_gemnoc: endpoint {
					remote-endpoint =
					<&gemnoc_out_tn_ddr>;
				};
			};

			port@6 {
				reg = <6>;
				tn_ddr_in_gladiator: endpoint {
					remote-endpoint =
					<&gladiator_out_tn_ddr>;
				};
			};

			port@7 {
				reg = <7>;
				tn_ddr_in_tpdm_ddr_llcc0: endpoint {
					remote-endpoint =
					<&tpdm_ddr_llcc0_out_tn_ddr>;
				};
			};

			port@8 {
				reg = <8>;
				tn_ddr_in_tpdm_ddr_llcc1: endpoint {
					remote-endpoint =
					<&tpdm_ddr_llcc1_out_tn_ddr>;
				};
			};

			port@9 {
				reg = <9>;
				tn_ddr_in_tpdm_ddr_llcc2: endpoint {
					remote-endpoint =
					<&tpdm_ddr_llcc2_out_tn_ddr>;
				};
			};

			port@a {
				reg = <10>;
				tn_ddr_in_tpdm_ddr_llcc3: endpoint {
					remote-endpoint =
					<&tpdm_ddr_llcc3_out_tn_ddr>;
				};
			};

			port@b {
				reg = <11>;
				tn_ddr_in_tpdm_ddr_shrm: endpoint {
					remote-endpoint =
					<&tpdm_ddr_shrm_out_tn_ddr>;
				};
			};

			port@c {
				reg = <12>;
				tn_ddr_in_tpdm_ddr_qpace: endpoint {
					remote-endpoint =
					<&tpdm_ddr_qpace_out_tn_ddr>;
				};
			};

			port@f {
				reg = <15>;
				tn_ddr_in_tpdm_ddr_ch02: endpoint {
					remote-endpoint =
					<&tpdm_ddr_ch02_out_tn_ddr>;
				};
			};

			port@10 {
				reg = <16>;
				tn_ddr_in_tpdm_ddr_ch13: endpoint {
					remote-endpoint =
					<&tpdm_ddr_ch13_out_tn_ddr>;
				};
			};
		};

		out-ports {
			port {
				tn_ddr_out_tn_ag: endpoint {
					remote-endpoint =
					<&tn_ag_in_tn_ddr>;
				};
			};
		};
	};

	tpdm_pcie_rscc: tpdm@111b3000 {
		compatible = "qcom,coresight-tpdm", "arm,primecell";
		reg = <0x0 0x111b3000 0x0 0x1000>;
		reg-names = "tpdm-base";

		device-name = "tpdm_pcie_rscc";

		clocks = <&aoss_qmp>;
		clock-names = "apb_pclk";

		out-ports {
			port {
				tpdm_pcie_rscc_out_tn_ag: endpoint {
					remote-endpoint =
					<&tn_ag_in_tpdm_pcie_rscc>;
				};
			};
		};
	};

	tpdm_qrng: tpdm@111a4000 {
		compatible = "qcom,coresight-tpdm", "arm,primecell";
		reg = <0x0 0x111a4000 0x0 0x1000>;
		reg-names = "tpdm-base";

		device-name = "tpdm_qrng";

		clocks = <&aoss_qmp>;
		clock-names = "apb_pclk";

		out-ports {
			port {
				tpdm_qrng_out_tn_ag: endpoint {
					remote-endpoint =
					<&tn_ag_in_tpdm_qrng>;
				};
			};
		};
	};

	tpdm_dlmm: tpdm@111a5000 {
		compatible = "qcom,coresight-tpdm", "arm,primecell";
		reg = <0x0 0x111a5000 0x0 0x1000>;
		reg-names = "tpdm-base";
		qcom,dsb-msrs-num = <32>;

		device-name = "tpdm_dlmm";

		clocks = <&aoss_qmp>;
		clock-names = "apb_pclk";

		out-ports {
			port {
				tpdm_dlmm_out_tn_ag: endpoint {
					remote-endpoint =
					<&tn_ag_in_tpdm_dlmm>;
				};
			};
		};
	};

	tpdm_north_dsb: tpdm@111a6000 {
		compatible = "qcom,coresight-tpdm", "arm,primecell";
		reg = <0x0 0x111a6000 0x0 0x1000>;
		reg-names = "tpdm-base";
		qcom,dsb-msrs-num = <32>;

		device-name = "tpdm_north_dsb";

		clocks = <&aoss_qmp>;
		clock-names = "apb_pclk";

		out-ports {
			port {
				tpdm_north_dsb_out_tn_ag: endpoint {
					remote-endpoint =
					<&tn_ag_in_tpdm_north_dsb>;
				};
			};
		};
	};

	tpdm_south_dsb: tpdm@111a7000 {
		compatible = "qcom,coresight-tpdm", "arm,primecell";
		reg = <0x0 0x111a7000 0x0 0x1000>;
		reg-names = "tpdm-base";
		qcom,dsb-msrs-num = <32>;

		device-name = "tpdm_south_dsb";

		clocks = <&aoss_qmp>;
		clock-names = "apb_pclk";

		out-ports {
			port {
				tpdm_south_dsb_out_tn_ag: endpoint {
					remote-endpoint =
					<&tn_ag_in_tpdm_south_dsb>;
				};
			};
		};
	};

	tpdm_ipcc_cmb1: tpdm@111ac000 {
		compatible = "qcom,coresight-tpdm", "arm,primecell";
		reg = <0x0 0x111ac000 0x0 0x1000>;
		reg-names = "tpdm-base";

		device-name = "tpdm_ipcc_cmb1";

		clocks = <&aoss_qmp>;
		clock-names = "apb_pclk";

		out-ports {
			port {
				tpdm_ipcc_cmb1_out_tn_ag: endpoint {
					remote-endpoint =
					<&tn_ag_in_tpdm_ipcc_cmb1>;
				};
			};
		};
	};

	tpdm_pmu: tpdm@111a3000 {
		compatible = "qcom,coresight-tpdm", "arm,primecell";
		reg = <0x0 0x111a3000 0x0 0x1000>;
		reg-names = "tpdm-base";
		qcom,dsb-msrs-num = <32>;

		device-name = "tpdm_pmu";

		clocks = <&aoss_qmp>;
		clock-names = "apb_pclk";

		out-ports {
			port {
				tpdm_pmu_out_tn_ag: endpoint {
					remote-endpoint =
					<&tn_ag_in_tpdm_pmu>;
				};
			};
		};
	};

	tpdm_rdpm_cmb0: tpdm@111a8000 {
		compatible = "qcom,coresight-tpdm", "arm,primecell";
		reg = <0x0 0x111a8000 0x0 0x1000>;
		reg-names = "tpdm-base";

		device-name = "tpdm_rdpm_cx";

		clocks = <&aoss_qmp>;
		clock-names = "apb_pclk";

		out-ports {
			port {
				tpdm_rdpm_cmb0_out_tn_ag: endpoint {
					remote-endpoint =
					<&tn_ag_in_tpdm_rdpm_cmb0>;
				};
			};
		};
	};

	tpdm_rdpm_cmb1: tpdm@111a9000 {
		compatible = "qcom,coresight-tpdm", "arm,primecell";
		reg = <0x0 0x111a9000 0x0 0x1000>;
		reg-names = "tpdm-base";

		device-name = "tpdm_rdpm_mxa";

		clocks = <&aoss_qmp>;
		clock-names = "apb_pclk";

		out-ports {
			port {
				tpdm_rdpm_cmb1_out_tn_ag: endpoint {
					remote-endpoint =
					<&tn_ag_in_tpdm_rdpm_cmb1>;
				};
			};
		};
	};

	tpdm_rdpm_cmb2: tpdm@111aa000 {
		compatible = "qcom,coresight-tpdm", "arm,primecell";
		reg = <0x0 0x111aa000 0x0 0x1000>;
		reg-names = "tpdm-base";

		device-name = "tpdm_rdpm_mxc";

		clocks = <&aoss_qmp>;
		clock-names = "apb_pclk";

		out-ports {
			port {
				tpdm_rdpm_cmb2_out_tn_ag: endpoint {
					remote-endpoint =
					<&tn_ag_in_tpdm_rdpm_cmb2>;
				};
			};
		};
	};

	tpdm_ipcc_cmb2: tpdm@111ad000 {
		compatible = "qcom,coresight-tpdm", "arm,primecell";
		reg = <0x0 0x111ad000 0x0 0x1000>;
		reg-names = "tpdm-base";

		device-name = "tpdm_ipcc_cmb2";

		clocks = <&aoss_qmp>;
		clock-names = "apb_pclk";

		out-ports {
			port {
				tpdm_ipcc_cmb2_out_tn_ag: endpoint {
					remote-endpoint =
					<&tn_ag_in_tpdm_ipcc_cmb2>;
				};
			};
		};
	};

	tpdm_ipcc_cmb4: tpdm@111af000 {
		compatible = "qcom,coresight-tpdm", "arm,primecell";
		reg = <0x0 0x111af000 0x0 0x1000>;
		reg-names = "tpdm-base";

		device-name = "tpdm_ipcc_cmb4";

		clocks = <&aoss_qmp>;
		clock-names = "apb_pclk";

		out-ports {
			port {
				tpdm_ipcc_cmb4_out_tn_ag: endpoint {
					remote-endpoint =
					<&tn_ag_in_tpdm_ipcc_cmb4>;
				};
			};
		};
	};

	tpdm_ipcc_cmb0: tpdm@111ab000 {
		compatible = "qcom,coresight-tpdm", "arm,primecell";
		reg = <0x0 0x111ab000 0x0 0x1000>;
		reg-names = "tpdm-base";

		device-name = "tpdm_ipcc_cmb0";

		clocks = <&aoss_qmp>;
		clock-names = "apb_pclk";

		out-ports {
			port {
				tpdm_ipcc_cmb0_out_tn_ag: endpoint {
					remote-endpoint =
					<&tn_ag_in_tpdm_ipcc_cmb0>;
				};
			};
		};
	};

	tpdm_ipcc_cmb3: tpdm@111ae000 {
		compatible = "qcom,coresight-tpdm", "arm,primecell";
		reg = <0x0 0x111ae000 0x0 0x1000>;
		reg-names = "tpdm-base";

		device-name = "tpdm_ipcc_cmb3";

		clocks = <&aoss_qmp>;
		clock-names = "apb_pclk";

		out-ports {
			port {
				tpdm_ipcc_cmb3_out_tn_ag: endpoint {
					remote-endpoint =
					<&tn_ag_in_tpdm_ipcc_cmb3>;
				};
			};
		};
	};

	tpdm_crm: tpdm@111b2000 {
		compatible = "qcom,coresight-tpdm", "arm,primecell";
		reg = <0x0 0x111b2000 0x0 0x1000>;
		reg-names = "tpdm-base";

		device-name = "tpdm_crm";
		status = "disabled";

		clocks = <&aoss_qmp>;
		clock-names = "apb_pclk";

		out-ports {
			port {
				tpdm_crm_out_tn_ag: endpoint {
					remote-endpoint =
					<&tn_ag_in_tpdm_crm>;
				};
			};
		};
	};

	tpdm_lmh: tpdm@111b1000 {
		compatible = "qcom,coresight-tpdm", "arm,primecell";
		reg = <0x0 0x111b1000 0x0 0x1000>;
		reg-names = "tpdm-base";
		qcom,cmb-msrs-num = <12>;

		device-name = "tpdm_lmh";
		status = "disabled";

		clocks = <&aoss_qmp>;
		clock-names = "apb_pclk";

		out-ports {
			port {
				tpdm_lmh_out_tn_ag: endpoint {
					remote-endpoint =
					<&tn_ag_in_tpdm_lmh>;
				};
			};
		};
	};

	tpdm_dpm: tpdm@111b0000 {
		compatible = "qcom,coresight-tpdm", "arm,primecell";
		reg = <0x0 0x111b0000 0x0 0x1000>;
		reg-names = "tpdm-base";

		device-name = "tpdm_dpm";

		clocks = <&aoss_qmp>;
		clock-names = "apb_pclk";

		out-ports {
			port {
				tpdm_dpm_out_tn_ag: endpoint {
					remote-endpoint =
					<&tn_ag_in_tpdm_dpm>;
				};
			};
		};
	};

	tn_ag: tn@111b8000 {
		compatible = "arm,primecell";
		arm,primecell-periphid = <0x000f0c00>;
		reg = <0x0 0x111b8000 0x0 0x4200>;
		reg-names = "traceNoc-base";

		device-name = "tracenoc_ag";

		clocks = <&aoss_qmp>;
		clock-names = "apb_pclk";

		in-ports {
			#address-cells = <1>;
			#size-cells = <0>;
			port@8 {
				reg = <8>;
				tn_ag_in_tpdm_pcie_rscc: endpoint {
					remote-endpoint =
					<&tpdm_pcie_rscc_out_tn_ag>;
				};
			};

			port@9 {
				reg = <9>;
				tn_ag_in_funnel_spss: endpoint {
					remote-endpoint =
					<&funnel_spss_out_tn_ag>;
				};
			};


			port@c {
				reg = <12>;
				tn_ag_in_funnel_tmess: endpoint {
					remote-endpoint =
					<&funnel_tmess_out_tn_ag>;
				};
			};

			port@d {
				reg = <13>;
				tn_ag_in_funnel_modem_dl: endpoint {
					remote-endpoint =
					<&funnel_modem_dl_out_tn_ag>;
				};
			};

			port@10 {
				reg = <16>;
				tn_ag_in_funnel_turing: endpoint {
					remote-endpoint =
					<&funnel_turing_out_tn_ag>;
				};
			};

			port@11 {
				reg = <17>;
				tn_ag_in_tpdm_gcc: endpoint {
					remote-endpoint =
					<&tpdm_gcc_out_tn_ag>;
				};
			};

			port@12 {
				reg = <18>;
				tn_ag_in_tpdm_qrng: endpoint {
					remote-endpoint =
					<&tpdm_qrng_out_tn_ag>;
				};
			};

			port@13 {
				reg = <19>;
				tn_ag_in_tpdm_qm: endpoint {
					remote-endpoint =
					<&tpdm_qm_out_tn_ag>;
				};
			};

			port@14 {
				reg = <20>;
				tn_ag_in_tpdm_vsense: endpoint {
					remote-endpoint =
					<&tpdm_vsense_out_tn_ag>;
				};
			};

			port@15 {
				reg = <21>;
				tn_ag_in_tpdm_ipa: endpoint {
					remote-endpoint =
					<&tpdm_ipa_out_tn_ag>;
				};
			};

			port@16 {
				reg = <22>;
				tn_ag_in_tpdm_sdcc5_2: endpoint {
					remote-endpoint =
					<&tpdm_sdcc5_2_out_tn_ag>;
				};
			};

			port@17 {
				reg = <23>;
				tn_ag_in_tpdm_sdcc5_4: endpoint {
					remote-endpoint =
					<&tpdm_sdcc5_4_out_tn_ag>;
				};
			};

			port@18 {
				reg = <24>;
				tn_ag_in_tpdm_ufs: endpoint {
					remote-endpoint =
					<&tpdm_ufs_out_tn_ag>;
				};
			};

			port@19 {
				reg = <25>;
				tn_ag_in_tpdm_dlmm: endpoint {
					remote-endpoint =
					<&tpdm_dlmm_out_tn_ag>;
				};
			};

			port@1a {
				reg = <26>;
				tn_ag_in_tpdm_north_dsb: endpoint {
					remote-endpoint =
					<&tpdm_north_dsb_out_tn_ag>;
				};
			};

			port@1b {
				reg = <27>;
				tn_ag_in_tpdm_south_dsb: endpoint {
					remote-endpoint =
					<&tpdm_south_dsb_out_tn_ag>;
				};
			};

			port@1c {
				reg = <28>;
				tn_ag_in_tpdm_ipcc_cmb1: endpoint {
					remote-endpoint =
					<&tpdm_ipcc_cmb1_out_tn_ag>;
				};
			};

			port@1d {
				reg = <29>;
				tn_ag_in_tpdm_pmu: endpoint {
					remote-endpoint =
					<&tpdm_pmu_out_tn_ag>;
				};
			};

			port@1e {
				reg = <30>;
				tn_ag_in_tpdm_rdpm_cmb0: endpoint {
					remote-endpoint =
					<&tpdm_rdpm_cmb0_out_tn_ag>;
				};
			};

			port@1f {
				reg = <31>;
				tn_ag_in_tpdm_rdpm_cmb1: endpoint {
					remote-endpoint =
					<&tpdm_rdpm_cmb1_out_tn_ag>;
				};
			};

			port@20 {
				reg = <32>;
				tn_ag_in_tpdm_rdpm_cmb2: endpoint {
					remote-endpoint =
					<&tpdm_rdpm_cmb2_out_tn_ag>;
				};
			};

			port@21 {
				reg = <33>;
				tn_ag_in_funnel_apss: endpoint {
					remote-endpoint =
					<&funnel_apss_out_tn_ag>;
				};
			};

			port@22 {
				reg = <34>;
				tn_ag_in_tpdm_ipcc_cmb2: endpoint {
					remote-endpoint =
					<&tpdm_ipcc_cmb2_out_tn_ag>;
				};
			};

			port@23 {
				reg = <35>;
				tn_ag_in_tpdm_ipcc_cmb4: endpoint {
					remote-endpoint =
					<&tpdm_ipcc_cmb4_out_tn_ag>;
				};
			};

			port@24 {
				reg = <36>;
				tn_ag_in_tpdm_ipcc_cmb0: endpoint {
					remote-endpoint =
					<&tpdm_ipcc_cmb0_out_tn_ag>;
				};
			};

			port@25 {
				reg = <37>;
				tn_ag_in_tpdm_ipcc_cmb3: endpoint {
					remote-endpoint =
					<&tpdm_ipcc_cmb3_out_tn_ag>;
				};
			};

			port@29 {
				reg = <41>;
				tn_ag_in_tpdm_crm: endpoint {
					remote-endpoint =
					<&tpdm_crm_out_tn_ag>;
				};
			};

			port@2a {
				reg = <42>;
				tn_ag_in_tpdm_lmh: endpoint {
					remote-endpoint =
					<&tpdm_lmh_out_tn_ag>;
				};
			};

			port@2b {
				reg = <43>;
				tn_ag_in_tpdm_dpm: endpoint {
					remote-endpoint =
					<&tpdm_dpm_out_tn_ag>;
				};
			};

			port@37 {
				reg = <55>;
				tn_ag_in_tn_lpass: endpoint {
					remote-endpoint =
					<&tn_lpass_out_tn_ag>;
				};
			};

			port@39 {
				reg = <57>;
				tn_ag_in_tn_soccp: endpoint {
					remote-endpoint =
					<&tn_soccp_out_tn_ag>;
				};
			};

			port@40 {
				reg = <64>;
				tn_ag_in_tn_video: endpoint {
					remote-endpoint =
					<&tn_video_out_tn_ag>;
				};
			};

			port@48 {
				reg = <72>;
				tn_ag_in_tn_eva: endpoint {
					remote-endpoint =
					<&tn_eva_out_tn_ag>;
				};
			};

			port@50 {
				reg = <80>;
				tn_ag_in_tn_mdss: endpoint {
					remote-endpoint =
					<&tn_mdss_out_tn_ag>;
				};
			};

			port@58 {
				reg = <88>;
				tn_ag_in_tn_gpu: endpoint {
					remote-endpoint =
					<&tn_gpu_out_tn_ag>;
				};
			};

			port@60 {
				reg = <96>;
				tn_ag_in_tn_ddr: endpoint {
					remote-endpoint =
					<&tn_ddr_out_tn_ag>;
				};
			};
		};

		out-ports {
			port {
				tn_ag_out_funnel_in0: endpoint {
					remote-endpoint =
					<&funnel_in0_in_tn_ag>;
				};
			};
		};
	};

	stm: stm@10002000 {
		compatible = "arm,coresight-stm", "arm,primecell";
		reg = <0x0 0x10002000 0x0 0x1000>,
			<0x0 0x16280000 0x0 0x180000>;
		reg-names = "stm-base", "stm-stimulus-base";
		atid = <16>;

		clocks = <&aoss_qmp>;
		clock-names = "apb_pclk";

		out-ports {
			port {
				stm_out_funnel_in0: endpoint {
					remote-endpoint =
					<&funnel_in0_in_stm>;
				};
			};
		};
	};

	tpdm_dcc: tpdm@10003000 {
		compatible = "arm,primecell";
		arm,primecell-periphid = <0x000f0e00>;
		reg = <0x0 0x10003000 0x0 0x1000>;
		reg-names = "tpdm-base";
		qcom,cmb-element-bits = <32>;

		device-name = "tpdm_dcc";

		qcom,hw-enable-check;
		clocks = <&aoss_qmp>;
		clock-names = "apb_pclk";

		out-ports {
			port {
				tpdm_dcc_out_tpda_qdss: endpoint {
					remote-endpoint =
					<&tpda_qdss_in_tpdm_dcc>;
				};
			};
		};
	};

	tpdm_spdm: tpdm@1000f000 {
		compatible = "qcom,coresight-tpdm", "arm,primecell";
		reg = <0x0 0x1000f000 0x0 0x1000>;
		qcom,cmb-element-bits = <32>;
		reg-names = "tpdm-base";

		device-name = "tpdm_spdm";

		clocks = <&aoss_qmp>;
		clock-names = "apb_pclk";

		out-ports {
			port {
				tpdm_spdm_out_tpda_qdss: endpoint {
					remote-endpoint =
					<&tpda_qdss_in_tpdm_spdm>;
				};
			};
		};
	};

	tpda_qdss: tpda@10004000 {
		compatible = "qcom,coresight-tpda", "arm,primecell";
		reg = <0x0 0x10004000 0x0 0x1000>;
		reg-names = "tpda-base";

		device-name = "tpda_qdss";

		clocks = <&aoss_qmp>;
		clock-names = "apb_pclk";

		in-ports {
			#address-cells = <1>;
			#size-cells = <0>;

			port@0 {
				reg = <0>;
				tpda_qdss_in_tpdm_dcc: endpoint {
					remote-endpoint =
					<&tpdm_dcc_out_tpda_qdss>;
				};
			};

			port@1 {
				reg = <1>;
				tpda_qdss_in_tpdm_spdm: endpoint {
					remote-endpoint =
					<&tpdm_spdm_out_tpda_qdss>;
				};
			};

		};

		out-ports {
			port {
				tpda_qdss_out_funnel_in0: endpoint {
					remote-endpoint =
					<&funnel_in0_in_tpda_qdss>;
				};
			};
		};
	};

	funnel_in0: funnel@10041000 {
		compatible = "arm,coresight-dynamic-funnel", "arm,primecell";
		reg = <0x0 0x10041000 0x0 0x1000>;
		reg-names = "funnel-base";

		device-name = "funnel_in0";

		clocks = <&aoss_qmp>;
		clock-names = "apb_pclk";

		in-ports {
			#address-cells = <1>;
			#size-cells = <0>;

			port@0 {
				reg = <0>;
				funnel_in0_in_tn_ag: endpoint {
					remote-endpoint =
					<&tn_ag_out_funnel_in0>;
				};
			};

			port@6 {
				reg = <6>;
				funnel_in0_in_tpda_qdss: endpoint {
					remote-endpoint =
					<&tpda_qdss_out_funnel_in0>;
				};
			};

			port@7 {
				reg = <7>;
				funnel_in0_in_stm: endpoint {
					remote-endpoint =
					<&stm_out_funnel_in0>;
				};
			};
		};

		out-ports {
			port {
				funnel_in0_out_funnel_aoss: endpoint {
					remote-endpoint =
					<&funnel_aoss_in_funnel_in0>;
				};
			};
		};
	};

	tpdm_swao_prio0: tpdm@11309000 {
		compatible = "qcom,coresight-tpdm", "arm,primecell";
		reg = <0x0 0x11309000 0x0 0x1000>;
		reg-names = "tpdm-base";
		qcom,cmb-element-bits = <64>;

		device-name = "tpdm_swao_prio_0";

		clocks = <&aoss_qmp>;
		clock-names = "apb_pclk";

		out-ports {
			port {
				tpdm_swao_prio0_out_tpda_aoss: endpoint {
					remote-endpoint =
					<&tpda_aoss_in_tpdm_swao_prio0>;
				};
			};
		};
	};

	tpdm_swao_prio1: tpdm@1130a000 {
		compatible = "qcom,coresight-tpdm", "arm,primecell";
		reg = <0x0 0x1130a000 0x0 0x1000>;
		reg-names = "tpdm-base";
		qcom,cmb-element-bits = <64>;

		device-name = "tpdm_swao_prio_1";

		clocks = <&aoss_qmp>;
		clock-names = "apb_pclk";

		out-ports {
			port {
				tpdm_swao_prio1_out_tpda_aoss: endpoint {
					remote-endpoint =
					<&tpda_aoss_in_tpdm_swao_prio1>;
				};
			};
		};
	};

	tpdm_swao_prio2: tpdm@1130b000 {
		compatible = "qcom,coresight-tpdm", "arm,primecell";
		reg = <0x0 0x1130b000 0x0 0x1000>;
		reg-names = "tpdm-base";
		qcom,cmb-element-bits = <64>;

		device-name = "tpdm_swao_prio_2";

		clocks = <&aoss_qmp>;
		clock-names = "apb_pclk";

		out-ports {
			port {
				tpdm_swao_prio2_out_tpda_aoss: endpoint {
					remote-endpoint =
					<&tpda_aoss_in_tpdm_swao_prio2>;
				};
			};
		};
	};

	tpdm_swao_prio3: tpdm@1130c000 {
		compatible = "qcom,coresight-tpdm", "arm,primecell";
		reg = <0x0 0x1130c000 0x0 0x1000>;
		reg-names = "tpdm-base";
		qcom,cmb-element-bits = <64>;

		device-name = "tpdm_swao_prio_3";

		clocks = <&aoss_qmp>;
		clock-names = "apb_pclk";

		out-ports {
			port {
				tpdm_swao_prio3_out_tpda_aoss: endpoint {
					remote-endpoint =
					<&tpda_aoss_in_tpdm_swao_prio3>;
				};
			};
		};
	};

	tpdm_swao_prio4: tpdm@11303000 {
		compatible = "qcom,coresight-tpdm", "arm,primecell";
		reg = <0x0 0x11303000 0x0 0x1000>;
		reg-names = "tpdm-base";
		qcom,cmb-element-bits = <64>;

		device-name = "tpdm_swao_prio_4";

		clocks = <&aoss_qmp>;
		clock-names = "apb_pclk";

		out-ports {
			port {
				tpdm_swao_prio4_out_tpda_aoss: endpoint {
					remote-endpoint =
					<&tpda_aoss_in_tpdm_swao_prio4>;
				};
			};
		};
	};

	tpdm_swao: tpdm@1130d000 {
		compatible = "qcom,coresight-tpdm", "arm,primecell";
		reg = <0x0 0x1130d000 0x0 0x1000>;
		reg-names = "tpdm-base";
		qcom,dsb-element-bits = <32>;
		qcom,dsb-msrs-num = <32>;

		device-name = "tpdm_swao_1";

		clocks = <&aoss_qmp>;
		clock-names = "apb_pclk";

		out-ports {
			port {
				tpdm_swao_out_tpda_aoss: endpoint {
					remote-endpoint =
					<&tpda_aoss_in_tpdm_swao>;
				};
			};
		};
	};

	tpda_aoss: tpda@11308000 {
		compatible = "qcom,coresight-tpda", "arm,primecell";
		reg = <0x0 0x11308000 0x0 0x1000>;
		reg-names = "tpda-base";

		device-name = "tpda_aoss";

		clocks = <&aoss_qmp>;
		clock-names = "apb_pclk";

		in-ports {
			#address-cells = <1>;
			#size-cells = <0>;

			port@0 {
				reg = <0>;
				tpda_aoss_in_tpdm_swao_prio0: endpoint {
					remote-endpoint =
					<&tpdm_swao_prio0_out_tpda_aoss>;
				};
			};

			port@1 {
				reg = <1>;
				tpda_aoss_in_tpdm_swao_prio1: endpoint {
					remote-endpoint =
					<&tpdm_swao_prio1_out_tpda_aoss>;
				};
			};

			port@2 {
				reg = <2>;
				tpda_aoss_in_tpdm_swao_prio2: endpoint {
					remote-endpoint =
					<&tpdm_swao_prio2_out_tpda_aoss>;
				};
			};

			port@3 {
				reg = <3>;
				tpda_aoss_in_tpdm_swao_prio3: endpoint {
					remote-endpoint =
					<&tpdm_swao_prio3_out_tpda_aoss>;
				};
			};

			port@4 {
				reg = <4>;
				tpda_aoss_in_tpdm_swao_prio4: endpoint {
					remote-endpoint =
					<&tpdm_swao_prio4_out_tpda_aoss>;
				};
			};

			port@5 {
				reg = <5>;
				tpda_aoss_in_tpdm_swao: endpoint {
					remote-endpoint =
					<&tpdm_swao_out_tpda_aoss>;
				};
			};
		};

		out-ports {
			port {
				tpda_aoss_out_funnel_aoss: endpoint {
					remote-endpoint =
					<&funnel_aoss_in_tpda_aoss>;
				};
			};
		};
	};

	audio_etm0 {
		compatible = "qcom,coresight-remote-etm";

		device-name = "audio_etm0";
		qcom,atid-num = <2>;
		trace-name = "audio-etm0";
		atid = <40 41>;

		out-ports {
			port@0 {
				reg = <0>;
				audio_etm0_out_funnel_lpass_lpi: endpoint {
					remote-endpoint =
					<&funnel_lpass_lpi_in_audio_etm0>;
				};
			};

			port@1 {
				reg = <1>;
				audio_etm0_out_qmi: endpoint {
					remote-endpoint =
					<&qmi_in_audio_etm0>;
				};
			};
		};
	};

	lpass_stm: lpass-stm {
		compatible = "arm,coresight-dummy-source";
		device-name = "lpass_stm";
		trace-name = "lpass-stm";
		atid = <25>;

		out-ports {
			port@0 {
				reg = <0>;
				lpass_stm_out_funnel_lpass_lpi_1: endpoint {
					remote-endpoint =
					<&funnel_lpass_lpi_1_in_lpass_stm>;
				};
			};

			port@1 {
				reg = <1>;
				lpass_stm_out_qmi: endpoint {
					remote-endpoint =
					<&qmi_in_lpass_stm>;
				};
			};

		};
	};

	tpdm_lpass_lpi: tpdm@11350000 {
		compatible = "arm,coresight-dummy-source";
		device-name = "tpdm_lpass_lpi";

		trace-name = "tpda-lpass-lpi";

		out-ports {
			port@0 {
				reg = <0>;
				tpdm_lpass_lpi_out_funnel_lpass_lpi_1: endpoint {
					remote-endpoint =
					<&funnel_lpass_lpi_1_in_tpdm_lpass_lpi>;
				};
			};

			port@1 {
				reg = <1>;
				lpass_lpi_out_qmi: endpoint {
					remote-endpoint =
					<&qmi_in_lpass_lpi>;
				};
			};
		};
	};

	tpdm_lpass_rscc: tpdm@11351000 {
		compatible = "arm,coresight-dummy-source";
		device-name = "tpdm_lpass_rscc";

		trace-name = "tpda-lpass-lpi";

		out-ports {
			port@0 {
				reg = <0>;
				tpdm_lpass_rscc_out_funnel_lpass_lpi_1: endpoint {
					remote-endpoint =
					<&funnel_lpass_lpi_1_in_tpdm_lpass_rscc>;
				};
			};

			port@1 {
				reg = <1>;
				lpass_rscc_out_qmi: endpoint {
					remote-endpoint =
					<&qmi_in_lpass_rscc>;
				};
			};
		};
	};

	tpdm_lpass_audio: tpdm@11346000 {
		compatible = "arm,coresight-dummy-source";
		device-name = "tpdm_lpass_audio";

		trace-name = "tpda-lpass-audio";
		status = "disabled";

		out-ports {
			port@0 {
				reg = <0>;
				tpdm_lpass_audio_out_funnel_lpass_lpi_1: endpoint {
					remote-endpoint =
					<&funnel_lpass_lpi_1_in_tpdm_lpass_audio>;
				};
			};

			port@1 {
				reg = <1>;
				lpass_audio_out_qmi: endpoint {
					remote-endpoint =
					<&qmi_in_lpass_audio>;
				};
			};
		};
	};

	funnel_lpass_lpi_1: funnel@11353000 {
		compatible = "arm,coresight-static-funnel";
		device-name = "funnel_lpass_lpi_1";

		in-ports {
			#address-cells = <1>;
			#size-cells = <0>;

			port@0 {
				reg = <0>;
				funnel_lpass_lpi_1_in_lpass_stm: endpoint {
					remote-endpoint =
					<&lpass_stm_out_funnel_lpass_lpi_1>;
				};
			};

			port@1 {
				reg = <1>;
				funnel_lpass_lpi_1_in_tpdm_lpass_lpi: endpoint {
					remote-endpoint =
					<&tpdm_lpass_lpi_out_funnel_lpass_lpi_1>;
				};
			};

			port@2 {
				reg = <2>;
				funnel_lpass_lpi_1_in_tpdm_lpass_rscc: endpoint {
					remote-endpoint =
					<&tpdm_lpass_rscc_out_funnel_lpass_lpi_1>;
				};
			};

			port@5 {
				reg = <5>;
				funnel_lpass_lpi_1_in_tpdm_lpass_audio: endpoint {
					remote-endpoint =
					<&tpdm_lpass_audio_out_funnel_lpass_lpi_1>;
				};
			};

		};

		out-ports {
			port {
				funnel_lpass_lpi_1_out_funnel_lpass_lpi_0: endpoint {
					remote-endpoint =
					<&funnel_lpass_lpi_0_in_funnel_lpass_lpi_1>;
				};
			};
		};
	};

	funnel_lpass_lpi_0: funnel@11344000 {
		compatible = "arm,coresight-static-funnel";
		device-name = "funnel_lpass_lpi_0";

		in-ports {
			#address-cells = <1>;
			#size-cells = <0>;

			port@0 {
				reg = <0>;
				funnel_lpass_lpi_in_audio_etm0: endpoint {
					remote-endpoint =
					<&audio_etm0_out_funnel_lpass_lpi>;
				};
			};

			port@7 {
				reg = <7>;
				funnel_lpass_lpi_0_in_funnel_lpass_lpi_1: endpoint {
					remote-endpoint =
					<&funnel_lpass_lpi_1_out_funnel_lpass_lpi_0>;
				};
			};
		};

		out-ports {
			port {
				funnel_lpass_lpi_out_funnel_aoss: endpoint {
					remote-endpoint =
					<&funnel_aoss_in_funnel_lpass_lpi>;
				};
			};
		};
	};

	tpdm_ddr_lpi: tpdm@11334000 {
		compatible = "arm,coresight-dummy-source";
		device-name = "tpdm_ddr_lpi";
		trace-name = "tracenoc-ddr-lpi";

		out-ports {
			port@0 {
				reg = <0>;
				tpdm_ddr_lpi_out_funnel_aoss: endpoint {
					remote-endpoint =
					<&funnel_aoss_in_tpdm_ddr_lpi>;
				};
			};

			port@1 {
				reg = <1>;
				ddr_lpi_out_qmi: endpoint {
					remote-endpoint =
					<&qmi_in_ddr_lpi>;
				};
			};
		};
	};

	funnel_aoss: funnel@11304000 {
		compatible = "arm,coresight-dynamic-funnel", "arm,primecell";
		reg = <0x0 0x11304000 0x0 0x1000>;
		reg-names = "funnel-base";

		device-name = "funnel_aoss";

		clocks = <&aoss_qmp>;
		clock-names = "apb_pclk";

		in-ports {
			#address-cells = <1>;
			#size-cells = <0>;

			port@2 {
				reg = <2>;
				funnel_aoss_in_tpdm_ddr_lpi: endpoint {
					remote-endpoint =
					<&tpdm_ddr_lpi_out_funnel_aoss>;
				};
			};

			port@4 {
				reg = <4>;
				funnel_aoss_in_funnel_lpass_lpi: endpoint {
					remote-endpoint =
					<&funnel_lpass_lpi_out_funnel_aoss>;
				};
			};

			port@5 {
				reg = <5>;
				funnel_aoss_in_tpda_aoss: endpoint {
					remote-endpoint =
					<&tpda_aoss_out_funnel_aoss>;
				};
			};

			port@6 {
				reg = <6>;
				funnel_aoss_in_funnel_in0: endpoint {
					remote-endpoint =
					<&funnel_in0_out_funnel_aoss>;
				};
			};

		};

		out-ports {
			port {
				funnel_aoss_out_tmc_etf: endpoint {
					remote-endpoint =
					<&tmc_etf_in_funnel_aoss>;
				};
			};
		};
	};

	tmc_etf: tmc@11305000 {
		compatible = "arm,coresight-tmc", "arm,primecell";
		reg = <0x0 0x11305000 0x0 0x1000>;
		reg-names = "tmc-base";

		clocks = <&aoss_qmp>,
			<&cpucp_scmi_clk 0>;
		clock-names = "apb_pclk",
				"atclk";

		in-ports {
			port {
				tmc_etf_in_funnel_aoss: endpoint {
					remote-endpoint =
					<&funnel_aoss_out_tmc_etf>;
				};
			};
		};

		out-ports {
			port {
				tmc_etf_out_replicator_swao: endpoint {
					remote-endpoint =
					<&replicator_swao_in_tmc_etf>;
				};
			};
		};
	};

	replicator_swao: replicator@11306000 {
		compatible = "arm,primecell";
		arm,primecell-periphid = <0x000bb909>;
		reg = <0x0 0x11306000 0x0 0x1000>;
		reg-names = "replicator-base";

		device-name = "replicator_swao";

		qcom,replicator-loses-context;
		clocks = <&aoss_qmp>;
		clock-names = "apb_pclk";

		in-ports {
			port {
				replicator_swao_in_tmc_etf: endpoint {
					remote-endpoint =
					<&tmc_etf_out_replicator_swao>;
				};
			};
		};

		out-ports {
			#address-cells = <1>;
			#size-cells = <0>;

			port@0 {
				replicator_swao_out_replicator_qdss: endpoint {
					remote-endpoint =
					<&replicator_qdss_in_replicator_swao>;
				};
			};

			port@1 {
				reg = <1>;
				replicator_swao_out_eud: endpoint {
					remote-endpoint =
					  <&eud_in_replicator_swao>;
				};
			};
		};
	};

	dummy_eud: dummy-eud {
		compatible = "arm,coresight-dummy-sink";

		device-name = "eud";

		in-ports {
			port {
				eud_in_replicator_swao: endpoint {
					remote-endpoint =
						<&replicator_swao_out_eud>;
				};
			};
		};
	};

	replicator_qdss: replicator@10046000 {
		compatible = "arm,primecell";
		arm,primecell-periphid = <0x000bb909>;
		reg = <0x0 0x10046000 0x0 0x1000>;
		reg-names = "replicator-base";

		device-name = "replicator_qdss";

		clocks = <&aoss_qmp>;
		clock-names = "apb_pclk";

		in-ports {
			port {
				replicator_qdss_in_replicator_swao: endpoint {
					remote-endpoint =
					<&replicator_swao_out_replicator_qdss>;
				};
			};
		};

		out-ports {
			#address-cells = <1>;
			#size-cells = <0>;

			port@0 {
				replicator_qdss_out_replicator_etr: endpoint {
					remote-endpoint =
					<&replicator_etr_in_replicator_qdss>;
				};
			};
		};
	};

	replicator_etr: replicator@1004e000 {
		compatible = "arm,primecell";
		arm,primecell-periphid = <0x000bb909>;
		reg = <0x0 0x1004e000 0x0 0x1000>;
		reg-names = "replicator-base";

		device-name = "replicator_etr";

		clocks = <&aoss_qmp>;
		clock-names = "apb_pclk";

		in-ports {
			port {
				replicator_etr_in_replicator_qdss: endpoint {
					remote-endpoint =
					<&replicator_qdss_out_replicator_etr>;
				};
			};
		};

		out-ports {
			#address-cells = <1>;
			#size-cells = <0>;

			port@0 {
				reg = <0>;
				replicator_etr_out_tmc_etr: endpoint {
					remote-endpoint =
					<&tmc_etr_in_replicator_etr>;
				};
			};

			port@1 {
				reg = <1>;
				replicator_etr_out_replicator_dummy: endpoint {
					remote-endpoint =
					<&replicator_dummy_in_replicator_etr>;
				};
			};
		};
	};

	etr1_replicator {
		compatible = "arm,coresight-static-replicator";

		device-name = "replicator_etr1";

		in-ports {
			port {
				replicator_dummy_in_replicator_etr: endpoint {
					remote-endpoint =
					<&replicator_etr_out_replicator_dummy>;
				};
			};
		};

		out-ports {
			#address-cells = <1>;
			#size-cells = <0>;

			port@0 {
				reg = <0>;
				replicator_dummy_out_tmc_modem: endpoint {
					remote-endpoint =
					<&tmc_modem_in_replicator_dummy>;
				};
			};

			port@1 {
				reg = <1>;
				replicator_dummy_out_tmc_etr1: endpoint {
					remote-endpoint =
					<&tmc_etr1_in_replicator_dummy>;
				};
			};
		};
	};

	tmc_modem: tmc-modem {
		compatible = "qcom,coresight-secure-etr";

		device-name = "tmc_modem_etr1";

		real-name = "tmc_etr1";
		qdss,buffer-size = <0x2000000>;
		qcom,secure-component;
		memory-region = <&qdss_apps_mem>;
		coresight-csr = <&csr>;
		csr-atid-offset = <0x108>;
		csr-irqctrl-offset = <0x70>;
		clocks = <&aoss_qmp>;
		clock-names = "apb_pclk";

		in-ports {
			port {
				tmc_modem_in_replicator_dummy: endpoint {
					remote-endpoint =
					<&replicator_dummy_out_tmc_modem>;
				};
			};
		};

		out-ports {
			port {
				tmc_modem_out_qmi: endpoint {
					remote-endpoint =
					<&qmi_in_tmc_modem>;
				};
			};
		};
	};

	tmc_etr: tmc@10048000 {
		compatible = "arm,coresight-tmc", "arm,primecell";
		reg = <0x0 0x10048000 0x0 0x1000>;
		reg-names = "tmc-base";

		device-name = "tmc_etr0";

		qcom,iommu-dma = "bypass";
		iommus = <&apps_smmu 0x04e0 0x0>;
		dma-coherent;
		arm,scatter-gather;

		//usb_bamless_support;
		qcom,sw-usb;
		coresight-csr = <&csr>;
		csr-atid-offset = <0xf8>;
		csr-irqctrl-offset = <0x6c>;
		byte-cntr-name = "byte-cntr";
		byte-cntr-class-name = "coresight-tmc-etr-stream";
		interrupts = <GIC_SPI 738 IRQ_TYPE_EDGE_RISING>;
		interrupt-names = "byte-cntr-irq";

		clocks = <&aoss_qmp>,
			<&cpucp_scmi_clk 0>;
		clock-names = "apb_pclk",
				"atclk";

		in-ports {
			port {
				tmc_etr_in_replicator_etr: endpoint {
					remote-endpoint =
					<&replicator_etr_out_tmc_etr>;
				};
			};
		};
	};

	tmc_etr1: tmc@1004f000 {
		compatible = "arm,coresight-tmc", "arm,primecell";
		reg = <0x0 0x1004f000 0x0 0x1000>;
		reg-names = "tmc-base";

		device-name = "tmc_etr1";

		iommus = <&apps_smmu 0x0500 0x0>;
		memory-region = <&tmc_etr1_region>;
		dma-coherent;
		arm,scatter-gather;

		coresight-csr = <&csr>;
		csr-atid-offset = <0x108>;
		csr-irqctrl-offset = <0x70>;
		byte-cntr-name = "byte-cntr1";
		byte-cntr-class-name = "coresight-tmc-etr1-stream";
		interrupts = <GIC_SPI 737 IRQ_TYPE_EDGE_RISING>;
		interrupt-names = "byte-cntr-irq";

		clocks = <&aoss_qmp>,
			<&cpucp_scmi_clk 0>;
		clock-names = "apb_pclk",
				"atclk";

		in-ports {
			port {
				tmc_etr1_in_replicator_dummy: endpoint {
					remote-endpoint =
					<&replicator_dummy_out_tmc_etr1>;
				};
			};
		};

		tmc_etr1_region: tmc_etr1_region {
			iommu-addresses = <&tmc_etr1 0x1 0x0 0xfe 0x0>;
		};
	};

	turing-qmi {
		compatible = "qcom,coresight-qmi";

		device-name = "qmi_turing";
		qcom,inst-id = <13>;

		in-ports {
			port {
				qmi_in_turing_etm0: endpoint {
					remote-endpoint =
						<&turing_etm0_out_qmi>;
				};
			};
		};
	};

	audio-qmi {
		compatible = "qcom,coresight-qmi";

		device-name = "coresight-qmi-auido";
		qcom,inst-id = <5>;

		in-ports {
			port@0 {
				reg = <0>;
				qmi_in_audio_etm0: endpoint {
					remote-endpoint =
						<&audio_etm0_out_qmi>;
				};
			};

			port@1 {
				reg = <1>;
				qmi_in_lpass_stm: endpoint {
					remote-endpoint =
						<&lpass_stm_out_qmi>;
				};
			};

			port@2 {
				reg = <2>;
				qmi_in_lpass_lpi: endpoint {
					remote-endpoint =
						<&lpass_lpi_out_qmi>;
				};
			};

			port@3 {
				reg = <3>;
				qmi_in_lpass_rscc: endpoint {
					remote-endpoint =
						<&lpass_rscc_out_qmi>;
				};
			};

			port@4 {
				reg = <4>;
				qmi_in_lpass_audio: endpoint {
					remote-endpoint =
						<&lpass_audio_out_qmi>;
				};
			};

			port@5 {
				reg = <5>;
				qmi_in_ddr_lpi: endpoint {
					remote-endpoint =
						<&ddr_lpi_out_qmi>;
				};
			};
		};
	};

	modem0-qmi {
		compatible = "qcom,coresight-qmi";

		device-name = "qmi_modem0";
		qcom,inst-id = <2>;

		in-ports {
			port@0 {
				reg = <0>;
				qmi_in_modem_etm0: endpoint {
					remote-endpoint =
						<&modem_etm0_out_qmi>;
				};
			};

			port@1 {
				reg = <1>;
				qmi_in_tmc_modem: endpoint {
					remote-endpoint =
						<&tmc_modem_out_qmi>;
				};
			};
		};
	};

	modem2-qmi {
		compatible = "qcom,coresight-qmi";

		device-name = "qmi_modem2";
		qcom,inst-id = <11>;

		in-ports {
			port {
				qmi_in_modem2_etm0: endpoint {
					remote-endpoint =
						<&modem2_etm0_out_qmi>;
				};
			};
		};
	};

	cti@10010000 {
		compatible = "arm,coresight-cti", "arm,primecell";
		reg = <0x0 0x10010000 0x0 0x1000>;

		arm,primecell-periphid = <0x000bb922>;
		device-name = "cti_qdss";

		qcom,extended_cti;
		clocks = <&aoss_qmp>;
		clock-names = "apb_pclk";

		qcom,cti-gpio-trigout = <20>;
		pinctrl-names = "cti-trigout-pctrl";
		pinctrl-0 = <&trigout_a>;

		#address-cells = <1>;
		#size-cells = <0>;

		trig-conns@0 {
			reg = <0>;
			arm,trig-out-sigs = <3>;
			arm,cs-dev-assoc = <&tmc_etr>;
		};

		trig-conns@1 {
			reg = <1>;
			arm,trig-out-sigs = <16 20>;
		};

		trig-conns@2 {
			reg = <2>;
			arm,trig-out-sigs = <4 5 6 7>;
		};
		trig-conns@3 {
			reg = <3>;
			arm,trig-out-sigs = <27>;
			arm,cs-dev-assoc = <&tmc_etr1>;
		};
	};

	cti@11003000 {
		compatible = "arm,coresight-cti", "arm,primecell";
		reg = <0x0 0x11003000 0x0 0x1000>;

		arm,primecell-periphid = <0x000bb922>;
		device-name = "cti_mss";

		qcom,extended_cti;
		clocks = <&aoss_qmp>;
		clock-names = "apb_pclk";
	};

	cti@1100b000 {
		compatible = "arm,coresight-cti", "arm,primecell";
		reg = <0x0 0x1100b000 0x0 0x1000>;

		arm,primecell-periphid = <0x000bb922>;
		device-name = "cti_mss_qdsp6";

		clocks = <&aoss_qmp>;
		clock-names = "apb_pclk";
	};

	cti@11013000 {
		compatible = "arm,coresight-cti", "arm,primecell";
		reg = <0x0 0x11013000 0x0 0x1000>;

		arm,primecell-periphid = <0x000bb922>;
		device-name = "cti_mss_vdsp6";

		clocks = <&aoss_qmp>;
		clock-names = "apb_pclk";
		status = "disabled";
	};

	cti@11035000 {
		compatible = "arm,coresight-cti", "arm,primecell";
		reg = <0x0 0x11035000 0x0 0x1000>;

		arm,primecell-periphid = <0x000bb922>;
		device-name = "cti_venus";

		clocks = <&aoss_qmp>;
		clock-names = "apb_pclk";
		qcom,extended_cti;
	};

	cti@11104000 {
		compatible = "arm,coresight-cti", "arm,primecell";
		reg = <0x0 0x11104000 0x0 0x1000>;

		arm,primecell-periphid = <0x000bb922>;
		device-name = "cti_a6x_tracenoc";

		qcom,extended_cti;
		clocks = <&aoss_qmp>;
		clock-names = "apb_pclk";
		status = "disabled";
	};

	cti@11161000 {
		compatible = "arm,coresight-cti", "arm,primecell";
		reg = <0x0 0x11161000 0x0 0x1000>;

		arm,primecell-periphid = <0x000bb922>;
		device-name = "cti_a6x_isdb";

		clocks = <&aoss_qmp>;
		clock-names = "apb_pclk";
		status = "disabled";
	};

	cti@11162000 {
		compatible = "arm,coresight-cti", "arm,primecell";
		reg = <0x0 0x11162000 0x0 0x1000>;

		arm,primecell-periphid = <0x000bb922>;
		device-name = "cti_a6x_gpmu";

		clocks = <&aoss_qmp>;
		clock-names = "apb_pclk";
		status = "disabled";
	};

	cti@11187000 {
		compatible = "arm,coresight-cti", "arm,primecell";
		reg = <0x0 0x11187000 0x0 0x1000>;

		arm,primecell-periphid = <0x000bb922>;
		device-name = "cti_turing";

		qcom,extended_cti;
		clocks = <&aoss_qmp>;
		clock-names = "apb_pclk";
		status = "disabled";
	};

	cti@11193000 {
		compatible = "arm,coresight-cti", "arm,primecell";
		reg = <0x0 0x11193000 0x0 0x1000>;

		arm,primecell-periphid = <0x000bb922>;
		device-name = "cti_turing_qdsp";

		clocks = <&aoss_qmp>;
		clock-names = "apb_pclk";
		status = "disabled";
	};

	cti@111a0000 {
		compatible = "arm,coresight-cti", "arm,primecell";
		reg = <0x0 0x111a0000 0x0 0x1000>;

		arm,primecell-periphid = <0x000bb922>;
		device-name = "cti_trace_noc_cti0";

		clocks = <&aoss_qmp>;
		clock-names = "apb_pclk";
		qcom,extended_cti;
	};

	cti@111a1000 {
		compatible = "arm,coresight-cti", "arm,primecell";
		reg = <0x0 0x111a1000 0x0 0x1000>;

		arm,primecell-periphid = <0x000bb922>;
		device-name = "cti_trace_noc_cti2";

		clocks = <&aoss_qmp>;
		clock-names = "apb_pclk";
		qcom,extended_cti;
	};

	cti@111a2000 {
		compatible = "arm,coresight-cti", "arm,primecell";
		reg = <0x0 0x111a2000 0x0 0x1000>;

		arm,primecell-periphid = <0x000bb922>;
		device-name = "cti_trace_noc_cti0_mm";

		clocks = <&aoss_qmp>;
		clock-names = "apb_pclk";
		qcom,extended_cti;
	};

	cti@111c5000 {
		compatible = "arm,coresight-cti", "arm,primecell";
		reg = <0x0 0x111c5000 0x0 0x1000>;

		arm,primecell-periphid = <0x000bb922>;
		device-name = "cti_eva";

		clocks = <&aoss_qmp>;
		clock-names = "apb_pclk";
		qcom,extended_cti;
		status = "disabled";
	};

	cti@11207000 {
		compatible = "arm,coresight-cti", "arm,primecell";
		reg = <0x0 0x11207000 0x0 0x1000>;

		arm,primecell-periphid = <0x000bb922>;
		device-name = "cti_camera";

		qcom,extended_cti;
		clocks = <&aoss_qmp>;
		clock-names = "apb_pclk";
		status = "disabled";
	};

	swao_cti: cti@11300000 {
		compatible = "arm,coresight-cti", "arm,primecell";
		reg = <0x0 0x11300000 0x0 0x1000>;

		arm,primecell-periphid = <0x000bb922>;
		device-name = "cti_swao";
		qcom,extended_cti;
		clocks = <&aoss_qmp>;
		clock-names = "apb_pclk";

		#address-cells = <1>;
		#size-cells = <0>;

		trig-conns@0 {
			reg = <0>;
			arm,trig-in-sigs = <4>;
			arm,cs-dev-assoc = <&tmc_etr>;
		};

		trig-conns@1 {
			reg = <1>;
			arm,trig-in-sigs = <24>;
			arm,trig-out-sigs = <1>;
			arm,cs-dev-assoc = <&tmc_etf>;
		};
	};

	cti@11321000 {
		compatible = "arm,coresight-cti", "arm,primecell";
		reg = <0x0 0x11321000 0x0 0x1000>;

		arm,primecell-periphid = <0x000bb922>;
		device-name = "cti_aoss";

		clocks = <&aoss_qmp>;
		clock-names = "apb_pclk";
		status = "disabled";
	};

	cti@11335000 {
		compatible = "arm,coresight-cti", "arm,primecell";
		reg = <0x0 0x11335000 0x0 0x1000>;

		arm,primecell-periphid = <0x000bb922>;
		device-name = "cti_ddr_lpi";

		qcom,extended_cti;
		clocks = <&aoss_qmp>;
		clock-names = "apb_pclk";
		status = "disabled";
	};

	cti@11341000 {
		compatible = "arm,coresight-cti", "arm,primecell";
		reg = <0x0 0x11341000 0x0 0x1000>;

		arm,primecell-periphid = <0x000bb922>;
		device-name = "cti_lpass_lpi_cti_1";

		clocks = <&aoss_qmp>;
		clock-names = "apb_pclk";
		status = "disabled";
	};

	cti@11342000 {
		compatible = "arm,coresight-cti", "arm,primecell";
		reg = <0x0 0x11342000 0x0 0x1000>;

		arm,primecell-periphid = <0x000bb922>;
		device-name = "cti_lpass_lpi";

		clocks = <&aoss_qmp>;
		clock-names = "apb_pclk";
		status = "disabled";
	};

	cti@1134b000 {
		compatible = "arm,coresight-cti", "arm,primecell";
		reg = <0x0 0x1134b000 0x0 0x1000>;

		arm,primecell-periphid = <0x000bb922>;
		device-name = "cti_lpass_lpi_qdsp";

		clocks = <&aoss_qmp>;
		clock-names = "apb_pclk";
		status = "disabled";
	};

	cti@11354000 {
		compatible = "arm,coresight-cti", "arm,primecell";
		reg = <0x0 0x11354000 0x0 0x1000>;

		arm,primecell-periphid = <0x000bb922>;
		device-name = "cti_lpass_lpi_cti_3";

		clocks = <&aoss_qmp>;
		clock-names = "apb_pclk";
		status = "disabled";
	};

	cti@11385000 {
		compatible = "arm,coresight-cti", "arm,primecell";
		reg = <0x0 0x11385000 0x0 0x1000>;

		arm,primecell-periphid = <0x000bb922>;
		device-name = "cti_lpass";

		qcom,extended_cti;
		clocks = <&aoss_qmp>;
		clock-names = "apb_pclk";
	};

	cti@113a5000 {
		compatible = "arm,coresight-cti", "arm,primecell";
		reg = <0x0 0x113a5000 0x0 0x1000>;

		arm,primecell-periphid = <0x000bb922>;
		device-name = "cti_soccp";

		clocks = <&aoss_qmp>;
		clock-names = "apb_pclk";
		qcom,extended_cti;
	};

	cti@11466000 {
		compatible = "arm,coresight-cti", "arm,primecell";
		reg = <0x0 0x11466000 0x0 0x1000>;

		arm,primecell-periphid = <0x000bb922>;
		device-name = "cti_mdss";

		qcom,extended_cti;
		clocks = <&aoss_qmp>;
		clock-names = "apb_pclk";
	};

	cti@114c4000 {
		compatible = "arm,coresight-cti", "arm,primecell";
		reg = <0x0 0x114c4000 0x0 0x1000>;

		arm,primecell-periphid = <0x000bb922>;
		device-name = "cti_tmess_dragonlink_cti0";

		clocks = <&aoss_qmp>;
		clock-names = "apb_pclk";
		qcom,extended_cti;
		status = "disabled";
	};

	cti@114c5000 {
		compatible = "arm,coresight-cti", "arm,primecell";
		reg = <0x0 0x114c5000 0x0 0x1000>;

		arm,primecell-periphid = <0x000bb922>;
		device-name = "cti_tmess_dragonlink_cti1";

		clocks = <&aoss_qmp>;
		clock-names = "apb_pclk";
		qcom,extended_cti;
		status = "disabled";
	};

	cti@114d1000 {
		compatible = "arm,coresight-cti", "arm,primecell";
		reg = <0x0 0x114d1000 0x0 0x1000>;

		arm,primecell-periphid = <0x000bb922>;
		device-name = "cti_tmess_rvss";

		clocks = <&aoss_qmp>;
		clock-names = "apb_pclk";
		status = "disabled";
	};

	cti@114e1000 {
		compatible = "arm,coresight-cti", "arm,primecell";
		reg = <0x0 0x114e1000 0x0 0x1000>;

		arm,primecell-periphid = <0x000bb922>;
		device-name = "cti_tmess_rvss_seqr";

		clocks = <&aoss_qmp>;
		clock-names = "apb_pclk";
		status = "disabled";
	};

	cti@1150a000 {
		compatible = "arm,coresight-cti", "arm,primecell";
		reg = <0x0 0x1150a000 0x0 0x1000>;

		arm,primecell-periphid = <0x000bb922>;
		device-name = "cti_ddr_center";

		qcom,extended_cti;
		clocks = <&aoss_qmp>;
		clock-names = "apb_pclk";
	};

	cti@1150c000 {
		compatible = "arm,coresight-cti", "arm,primecell";
		reg = <0x0 0x1150c000 0x0 0x1000>;

		arm,primecell-periphid = <0x000bb922>;
		device-name = "cti_ddr_chhm02";

		qcom,extended_cti;
		clocks = <&aoss_qmp>;
		clock-names = "apb_pclk";
	};

	cti@1150d000 {
		compatible = "arm,coresight-cti", "arm,primecell";
		reg = <0x0 0x1150d000 0x0 0x1000>;

		arm,primecell-periphid = <0x000bb922>;
		device-name = "cti_ddr_chhm13";

		qcom,extended_cti;
		clocks = <&aoss_qmp>;
		clock-names = "apb_pclk";
	};

	cti@11561000 {
		compatible = "arm,coresight-cti", "arm,primecell";
		reg = <0x0 0x11561000 0x0 0x1000>;

		arm,primecell-periphid = <0x000bb922>;
		device-name = "cti_ddr_shrm";

		clocks = <&aoss_qmp>;
		clock-names = "apb_pclk";
		status = "disabled";
	};

	cti@120c0000 {
		compatible = "arm,coresight-cti", "arm,primecell";
		reg = <0x0 0x120c0000 0x0 0x1000>;

		arm,primecell-periphid = <0x000bb922>;
		device-name = "cti_apss_cti";

		qcom,extended_cti;
		clocks = <&aoss_qmp>,
			<&cpucp_scmi_clk 0>;
		clock-names = "apb_pclk",
				"atclk";
	};

	cti@1218a000 {
		compatible = "arm,coresight-cti", "arm,primecell";
		reg = <0x0 0x1218a000 0x0 0x1000>;

		arm,primecell-periphid = <0x000bb922>;
		device-name = "cti_apss_dl";

		qcom,extended_cti;
		clocks = <&aoss_qmp>,
			<&cpucp_scmi_clk 0>;
		clock-names = "apb_pclk",
				"atclk";
	};
};


/dts-v1/;
/plugin/;

#include "kalama-mtp.dtsi"
#include "sdxpinn-external-soc.dtsi"
#include "kalama-pinn.dtsi"

/ {
	model = "KALAMA PINN MTP";
	compatible = "qcom,kalama-mtp", "qcom,kalama", "qcom,mtp";
	qcom,msm-id = <519 0x10000>;
	qcom,board-id = <0x02010008 0x2>;
};

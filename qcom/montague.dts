// SPDX-License-Identifier: BSD-3-Clause
/*
 * Copyright (c) Qualcomm Technologies, Inc. and/or its subsidiaries.
 */

/dts-v1/;

#include "montague.dtsi"

/ {
	model = "Qualcomm Technologies, Inc. Montague SoC";
	compatible = "qcom,montague";
	qcom,board-id = <0 0>;
};


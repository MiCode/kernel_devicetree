/dts-v1/;
/plugin/;


/ {
	model = "Qualcomm Technologies, Inc. SA8195 Single LA Virtual Machine";
	compatible = "qcom,sa8195p", "qcom,quinvm";
	qcom,pmic-name = "PM8195";
	qcom,msm-id = <405 0x20000>;
	qcom,board-id = <0 0x1000001>;
};

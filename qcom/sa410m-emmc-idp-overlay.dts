/dts-v1/;
/plugin/;

#include "sa410m-idp.dtsi"

/ {
	model = "Qualcomm Technologies, Inc. SA410M EMMC IDP";
	compatible = "qcom,sa410m", "qcom,idp", "qcom,sa410m-idp";
	qcom,msm-id=<560 0x10000>;
	qcom,board-id = <34 0x0>;
};

&qnand_1 {
	status = "disabled";
};

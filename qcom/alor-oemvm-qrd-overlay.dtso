// SPDX-License-Identifier: BSD-3-Clause
/*
 * Copyright (c) Qualcomm Technologies, Inc. and/or its subsidiaries.
 */
/dts-v1/;
/plugin/;

#include "alor-oemvm-avf.dtsi"
#include "alor-oemvm-qrd-avf.dtsi"

/ {
	model = "Qualcomm Technologies, Inc. Alor OEMVM QRD";
	compatible = "qcom,alor-qrd", "qcom,alor", "qcom,alorp-qrd", "qcom,alorp",
			   "qcom,qrd";
	qcom,board-id = <0x1000B 0>;

	host {
	};
};

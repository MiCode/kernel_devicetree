/dts-v1/;
/memreserve/ 0x80C40000 0x00020000;

#include "cinder-v2-ru.dtsi"
#include "cinder-rumi.dtsi"

/ {
	model = "Qualcomm Technologies, Inc. Cinder V2 RU RUMI";
	compatible = "qcom,cinder-rumi", "qcom,cinder", "qcom,rumi";
	qcom,board-id = <0xF 0x600>;
};

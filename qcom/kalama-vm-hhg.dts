/dts-v1/;

#include "kalamap-vm.dtsi"
#include "kalamap-vm-hhg.dtsi"

/ {
	model = "Qualcomm Technologies, Inc. KalamaP SVM HHG";
	compatible = "qcom,kalamap-hhg", "qcom,kalamap", "qcom,hhg";
	qcom,board-id = <0x1001f 0x1>;
};

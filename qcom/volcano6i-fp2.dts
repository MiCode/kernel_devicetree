/dts-v1/;

#include "volcano6i.dtsi"

/ {
	model = "Qualcomm Technologies, Inc. Volcano6I FP2 SoC";
	compatible = "qcom,volcano";
	qcom,msm-id = <0X8000291 0x10000>;
	qcom,board-id = <0 0>;

	chosen {
		softsku-id = "2";
	};
};

&pcie1 {
	status = "ok";
};

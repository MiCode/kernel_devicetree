// SPDX-License-Identifier: BSD-3-Clause
/*
 * Copyright (c) 2024-2025, Qualcomm Innovation Center, Inc. All rights reserved.
 */

#include "tuna-mtp.dtsi"

&S1G {
	regulator-min-microvolt = <806000>;
	regulator-max-microvolt = <1003000>;
	qcom,init-voltage = <852000>;
};

&L3G {
	regulator-always-on;
};

&regulator_ocp_notifier {
	periph-1c1-supply = <&L1B>;
	periph-1c2-supply = <&L2B>;
	periph-1c3-supply = <&L3B>;
	periph-1c4-supply = <&L4B>;
	periph-1c5-supply = <&L5B>;
	periph-1c6-supply = <&L6B>;
	periph-1c7-supply = <&L7B>;
	periph-1c8-supply = <&L8B>;
	periph-1c9-supply = <&L9B>;
	periph-1ca-supply = <&L10B>;
	periph-1cb-supply = <&L11B>;
	periph-1cc-supply = <&L12B>;
	periph-1cd-supply = <&L13B>;
	periph-1ce-supply = <&L14B>;
	periph-1cf-supply = <&L15B>;
	periph-1d0-supply = <&L16B>;
	periph-1d1-supply = <&L17B>;
	periph-1d2-supply = <&L18B>;
	periph-1d3-supply = <&L19B>;
	periph-1d4-supply = <&L20B>;
	periph-1d5-supply = <&L21B>;
	periph-1d6-supply = <&L22B>;
	periph-1d7-supply = <&L23B>;
	periph-19b-supply = <&S1B>;
	periph-19e-supply = <&S2B>;
	periph-1a1-supply = <&S3B>;
	periph-1e4-supply = <&BOB>;
	periph-3c1-supply = <&L1D>;
	periph-3c2-supply = <&L2D_LEVEL>;
	periph-3c3-supply = <&L3D>;
	periph-59b-supply = <&S1F_LEVEL>;
	periph-5a0-supply = <&S2F_LEVEL>;
	periph-5a8-supply = <&S4F>;
	periph-5a9-supply = <&S5F_LEVEL>;
	periph-5ac-supply = <&S8F_LEVEL>;
	periph-5c1-supply = <&L1F>;
	periph-5c2-supply = <&L2F_LEVEL>;
	periph-5c3-supply = <&L3F>;
	periph-6c1-supply = <&L1G>;
	periph-6c2-supply = <&L2G>;
	periph-6c3-supply = <&L3G>;
	periph-c40-supply = <&L1M>;
	periph-c41-supply = <&L2M>;
	periph-c42-supply = <&L3M>;
	periph-c43-supply = <&L4M>;
	periph-c44-supply = <&L5M>;
	periph-c45-supply = <&L6M>;
	periph-c46-supply = <&L7M>;
	periph-d40-supply = <&L1N>;
	periph-d41-supply = <&L2N>;
	periph-d42-supply = <&L3N>;
	periph-d43-supply = <&L4N>;
	periph-d44-supply = <&L5N>;
	periph-d45-supply = <&L6N>;
	periph-d46-supply = <&L7N>;
};

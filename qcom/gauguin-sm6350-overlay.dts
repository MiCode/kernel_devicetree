/dts-v1/;
/plugin/;

#include <dt-bindings/interrupt-controller/arm-gic.h>
#include "gauguin-sm6350.dtsi"

/ {
	model = "Qualcomm Technologies, Inc. Gauguin";
	compatible = "qcom,lagoon-qrd", "qcom,lagoon", "qcom,qrd";
	qcom,msm-id = <434 0x10000>, <459 0x10000>;
	qcom,board-id = <0x23 0>;
};

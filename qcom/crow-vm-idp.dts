/dts-v1/;

#include "crow-vm.dtsi"
#include "crow-vm-idp.dtsi"

/ {
	model = "Qualcomm Technologies, Inc. Crow VM IDP";
	compatible = "qcom,crow-idp", "qcom,crow", "qcom,idp";
	qcom,board-id = <34 0>;
};

/dts-v1/;

#include "volcano-vm.dtsi"
#include "volcano-vm-rumi.dtsi"

/ {
	model = "Qualcomm Technologies, Inc. Volcano SVM RUMI";
	compatible = "qcom,volcano-rumi", "qcom,volcano", "qcom,rumi";
	qcom,board-id = <15 0>;
};

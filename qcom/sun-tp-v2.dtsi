// SPDX-License-Identifier: BSD-3-Clause
/*
 * Copyright (c) 2024 Qualcomm Innovation Center, Inc. All rights reserved.
 */

#include "sun-tp.dtsi"

/ {
	model = "Qualcomm Technologies, Inc. Sun Alt. Thermal Profile SoC";
	compatible = "qcom,sun";
	qcom,msm-id = <0x100026a 0x20000>;
};

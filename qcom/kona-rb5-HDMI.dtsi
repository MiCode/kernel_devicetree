#include <dt-bindings/gpio/gpio.h>

&tlmm {
	key_factory_reset {
		key_factory_reset_default: key_factory_reset_default {
			pins = "gpio22";
			function = "normal";
			input-enable;
			bias-pull-up;
		};
	};
};

// SPDX-License-Identifier: BSD-3-Clause
/*
 * Copyright (c) 2025 Qualcomm Innovation Center, Inc. All rights reserved.
 */

/dts-v1/;
/plugin/;

#include "vienna-wdp-ddsip.dtsi"

/ {
	model = "Qualcomm Technologies, Inc. Vienna WDP DDSIP";
	compatible = "qcom,vienna-wdp", "qcom,vienna", "qcom,wdp";
	qcom,board-id = <0x20024 0x0>;
};

// SPDX-License-Identifier: BSD-3-Clause
/*
 * Copyright (c) 2022-2023 Qualcomm Innovation Center, Inc. All rights reserved.
 */

#include "pineapple.dtsi"

/ {
	model = "Qualcomm Technologies, Inc. PineappleP SoC";
	compatible = "qcom,pineapplep";
	qcom,msm-id = <577 0x10000>;
};

/dts-v1/;
/plugin/;

#include "zijin-sm7325.dtsi"

/ {
	model = "zijin based Qualcomm Technologies, Inc. SM7325";
	compatible = "qcom,yupik-idp", "qcom,yupik", "qcom,idp";
	qcom,msm-id = <475 0x10000>, <515 0x10000>;
	qcom,board-id = <0x1000B 0>;
	xiaomi,board-id = <0xC 0>;
};

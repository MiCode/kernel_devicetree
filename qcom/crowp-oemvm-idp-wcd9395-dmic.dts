/dts-v1/;

#include "crowp-oemvm.dtsi"
#include "crowp-oemvm-idp-wcd9395-dmic.dtsi"

/ {
	model = "Qualcomm Technologies, Inc. OEM VM CrowP IDP + WCD9395 DMIC";
	compatible = "qcom,crowp-idp", "qcom,crowp", "qcom,idp";
	qcom,board-id = <34 2>;
};

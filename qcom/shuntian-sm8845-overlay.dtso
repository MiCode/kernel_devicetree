// SPDX-License-Identifier: BSD-3-Clause
/*
 * Copyright (c) Qualcomm Technologies, Inc. and/or its subsidiaries.
 */

/dts-v1/;
/plugin/;

#include "shuntian-sm8845.dtsi"
#include "shuntian-sm8845-touch.dtsi"
#include "shuntian-sm8845-keyboard.dtsi"
#include "alor-pm7550ba-pmd802x.dtsi"
#include "shuntian-sm8845-thermal.dtsi"
#include "shuntian-charger-common.dtsi"
#include "shuntian-ntag.dtsi"
#include "shuntian-usb.dtsi"

/ {
	model = "Qualcomm Technologies, Inc. Shuntian based on SM8845";
	compatible = "qcom,alor-mtp", "qcom,alor", "qcom,mtp", "qcom,alorp-mtp", "qcom,alorp";
	qcom,msm-id = <685 0x10000>, <727 0x10000>;
	qcom,board-id = <0x10008 0>;
	xiaomi,miboard-id = <0xA 0>;
};

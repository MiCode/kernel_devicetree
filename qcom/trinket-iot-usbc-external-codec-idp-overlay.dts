/dts-v1/;
/plugin/;

#include "trinket-iot-idp.dtsi"

/ {
	model = "USB-C Ext Audio Codec IDP";
	compatible = "qcom,trinket-iot-idp", "qcom,trinket-iot", "qcom,idp";
	qcom,msm-id = <467 0x10000>;
	qcom,board-id = <34 3>;
};

/dts-v1/;

#include "kalama-vm.dtsi"
#include "kalama-vm-rumi.dtsi"

/ {
	model = "Qualcomm Technologies, Inc. Kalama SVM RUMI";
	compatible = "qcom,kalama-rumi", "qcom,kalama", "qcom,rumi";
	qcom,board-id = <15 0>;
};

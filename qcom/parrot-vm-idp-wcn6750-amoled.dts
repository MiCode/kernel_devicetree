// SPDX-License-Identifier: BSD-3-Clause
/*
 * Copyright (c) 2024 Qualcomm Innovation Center, Inc. All rights reserved.
 */

/dts-v1/;

#include "parrot-vm.dtsi"
#include "parrot-vm-idp-wcn6750-amoled.dtsi"

/ {
	model = "Qualcomm Technologies, Inc. Parrot VM WCN6750 IDP + AMOLED";
	compatible = "qcom,parrot-idp", "qcom,parrot", "qcom,idp";
	qcom,board-id = <34 4>;
};

// SPDX-License-Identifier: BSD-3-Clause
/*
 * Copyright (c) Qualcomm Technologies, Inc. and/or its subsidiaries.
 */

/dts-v1/;
/plugin/;

#include "chora-rumi.dtsi"

/ {
	model = "Qualcomm Technologies, Inc. Chora Rumi";
	compatible = "qcom,chora-rumi", "qcom,chora", "qcom,rumi";
	qcom,msm-id = <724 0x10000>;
	qcom,board-id = <15 0>;
};

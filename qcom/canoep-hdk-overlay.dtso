// SPDX-License-Identifier: BSD-3-Clause
/*
 * Copyright (c) 2025 Qualcomm Innovation Center, Inc. All rights reserved.
 */

/dts-v1/;
/plugin/;

#include "canoep-hdk.dtsi"

/ {
	model = "Qualcomm Technologies, Inc. CanoeP HDK + Pandeiro";
	compatible = "qcom,canoep-hdk", "qcom,canoep", "qcom,hdk";
	qcom,msm-id = <661 0x10000>, <661 0x20000>, <0x1000295 0x10000>,
		      <0x1000295 0x20000>;
	qcom,board-id = <0x1001F 0>;
};

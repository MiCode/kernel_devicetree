// SPDX-License-Identifier: BSD-3-Clause
/*
 * Copyright (c) 2024 Qualcomm Innovation Center, Inc. All rights reserved.
 */

/dts-v1/;
/plugin/;

#include "tuna-cdp.dtsi"
#include "tuna-pmiv0108.dtsi"

/ {
	model = "Qualcomm Technologies, Inc. Tuna CDP";
	compatible = "qcom,tuna-cdp", "qcom,tuna", "qcom,tunap-cdp", "qcom,tunap",
			"qcom,cdp";

	qcom,msm-id = <681 0x10000>, <655 0x10000>, <694 0x10000>;
	qcom,board-id = <1 0>;
};

// SPDX-License-Identifier: BSD-3-Clause
/*
 * Copyright (c) 2024 Qualcomm Innovation Center, Inc. All rights reserved.
 */

/dts-v1/;
/plugin/;

#include "monaco-wdp-v1.dtsi"

/ {
	model = "Qualcomm Technologies, Inc. Monaco WDP V1.1";
	qcom,board-id = <0x010124 0x0>;
};

/dts-v1/;
/plugin/;

#include "parrot-wcn3990.dtsi"
#include "garnet-sm7435.dtsi"

/ {
	model = "Qualcomm Technologies, Inc. Garnet based on SM7435";
	compatible = "qcom,parrot-qrd", "qcom,parrot", "qcom,qrd";
	qcom,msm-id = <537 0x10000>, <583 0x10000>, <613 0x10000>;
	qcom,board-id = <0x1000B 0>;
	xiaomi,miboard-id = <0x11 0>;
};

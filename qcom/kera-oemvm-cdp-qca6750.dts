// SPDX-License-Identifier: BSD-3-Clause
/*
 * Copyright (c) 2024 Qualcomm Innovation Center, Inc. All rights reserved.
 */

/dts-v1/;

#include "kera-oemvm.dtsi"
#include "kera-oemvm-cdp-qca6750.dtsi"

/ {
	model = "Qualcomm Technologies, Inc. Kera OEMVM CDP + QCA6750";
	compatible = "qcom,kera-cdp", "qcom,kera", "qcom,kerap-cdp", "qcom,kerap",
			"qcom,cdp";

	qcom,board-id = <0x10001 0>, <0x20001 0>, <0x30001 0>, <0x40001 0>;
};

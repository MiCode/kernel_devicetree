/dts-v1/;
/plugin/;

#include "lemans-adp-star.dtsi"

/ {
	model = "Qualcomm Technologies, Inc. Lemans IVI ADP STAR";
	compatible = "qcom,lemans", "qcom,adp-star", "qcom,lemans-ivi", "qcom,lemans-ivi-adp-star";
	qcom,msm-id = <532 0x10000>;
	qcom,board-id = <0x10019 0>;
};

/dts-v1/;
/plugin/;

#include "niobep-idp.dtsi"

/ {
	model = "Qualcomm Technologies, Inc. NiobeP IDP";
	compatible = "qcom,niobep-idp", "qcom,niobep", "qcom,idp";
	qcom,msm-id = <652 0x10000>;
	qcom,board-id = <0x10022 0>;
};

/dts-v1/;
/plugin/;

#include "monaco-vm.dtsi"
#include "monaco-vm-la.dtsi"

/ {
	model = "Qualcomm Technologies, Inc. Monaco Single LA Virtual Machine";
	compatible = "qcom,monaco", "qcom,quinvm";
	qcom,msm-id = <606 0x10000>;
	qcom,board-id = <0 0x1000001>;
};

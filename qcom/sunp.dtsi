// SPDX-License-Identifier: BSD-3-Clause
/*
 * Copyright (c) Qualcomm Technologies, Inc. and/or its subsidiaries.
 */

#include "sun.dtsi"

/ {
	model = "Qualcomm Technologies, Inc. SunP SoC";
	compatible = "qcom,sunp";
	qcom,msm-id = <639 0x10000>, <705 0x10000>, <706 0x10000>;
};

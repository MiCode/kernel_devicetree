/dts-v1/;
/plugin/;

#include "holi-pm6125-overlay.dtsi"
#include "blair-regulators-pm6125.dtsi"
#include "holi-mtp-usbc-pm6125.dtsi"

/ {
	model = "Qualcomm Technologies, Inc. Holi MTP USBC PM6125 audio";
	compatible = "qcom,holi-mtp", "qcom,holi", "qcom,mtp";
	qcom,msm-id = <454 0x10000>, <472 0x10000>;
	qcom,board-id = <8 1>;
	qcom,pmic-id-size = <4>;
	qcom,pmic-id = <0x2D 0x0 0x2E 0x0>;
};

/dts-v1/;

#include "crowp-oemvm.dtsi"
#include "crowp-oemvm-qrd.dtsi"

/ {
	model = "Qualcomm Technologies, Inc. CrowP OEM VM QRD";
	compatible = "qcom,crowp-qrd", "qcom,crowp", "qcom,qrd";
	qcom,board-id = <11 0>;
};

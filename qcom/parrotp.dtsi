// SPDX-License-Identifier: BSD-3-Clause
/*
 * Copyright (c) 2024-2025 Qualcomm Innovation Center, Inc. All rights reserved.
 */

#include "parrot.dtsi"

/ {

	model = "Qualcomm Technologies, Inc. ParrotP";
	compatible = "qcom,parrotp";
	qcom,msm-id = <583 0x10000>, <631 0x10000>, <638 0x10000>, <713 0x10000>, <714 0x10000>;
};

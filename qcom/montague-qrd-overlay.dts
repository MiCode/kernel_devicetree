/dts-v1/;
/plugin/;

#include "montague-qrd.dtsi"

/ {
	model = "Qualcomm Technologies, Inc. Montague QRD";
	compatible = "qcom,montague-qrd", "qcom,montague", "qcom,qrd";
	qcom,msm-id = <581 0x10000>, <582 0x10000>;
	qcom,board-id = <0x1000B 0>;
};


/dts-v1/;
/plugin/;

#include "cliffs-mtp.dtsi"
#include "cliffs-pm8550b.dtsi"

/ {
	model = "Qualcomm Technologies, Inc. Cliffs MTP PM8550B";
	compatible = "qcom,cliffs-mtp", "qcom,cliffs", "qcom,cliffsp-mtp", "qcom,cliffsp", "qcom,mtp";
	qcom,msm-id = <614 0x10000>, <632 0x10000>, <642 0x10000>, <643 0x10000>;
	qcom,board-id = <8 0>;
};

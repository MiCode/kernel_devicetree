// SPDX-License-Identifier: BSD-3-Clause
/*
 * Copyright (c) Qualcomm Technologies, Inc. and/or its subsidiaries.
 */

#include "kera.dtsi"

/ {
	model = "Qualcomm Technologies, Inc. Kera QMB SoC";
	compatible = "qcom,kera-qmb";
	qcom,msm-id = <720 0x10000>;
};

/dts-v1/;

#include "cliffs-vm.dtsi"
#include "cliffs-vm-qrd.dtsi"

/ {
	model = "Qualcomm Technologies, Inc. Cliffs SVM QRD";
	compatible = "qcom,cliffs-qrd", "qcom,cliffs", "qcom,qrd";
	qcom,board-id = <11 0>;
};

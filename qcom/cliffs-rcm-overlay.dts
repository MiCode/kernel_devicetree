/dts-v1/;
/plugin/;

#include "cliffs-rcm.dtsi"

/ {
	model = "Qualcomm Technologies, Inc. Cliffs RCM";
	compatible = "qcom,cliffs-rcm", "qcom,cliffs", "qcom,rcm";
	qcom,msm-id = <614 0x10000>;
	qcom,board-id = <21 0>;
};

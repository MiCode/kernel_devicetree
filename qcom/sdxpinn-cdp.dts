/dts-v1/;

#include "sdxpinn.dtsi"
#include "sdxpinn-cdp.dtsi"

/ {
	model = "Qualcomm Technologies, Inc. SDXPINN CDP";
	compatible = "qcom,sdxpinn-cdp",
		"qcom,sdxpinn", "qcom,cdp";
	qcom,board-id = <0x10001 0x0>;
};

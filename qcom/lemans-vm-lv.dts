/dts-v1/;

#include "lemans-vm.dtsi"
#include "lemans-vm-lv.dtsi"

/ {
	model = "Qualcomm Technologies, Inc. LeMans Single Linux Virtual Machine";
	compatible = "qcom,lemans", "qcom,quinvm";
	qcom,board-id = <0 0x1000002>;
};

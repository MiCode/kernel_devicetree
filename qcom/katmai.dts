// SPDX-License-Identifier: BSD-3-Clause
/*
 * Copyright (c) 2025 Qualcomm Innovation Center, Inc. All rights reserved.
 */

/dts-v1/;

#include "katmai.dtsi"

/ {
	model = "Qualcomm Technologies, Inc. KATMAI SoC";
	compatible = "qcom,yupik-iot";
	qcom,board-id = <0 0>;
};

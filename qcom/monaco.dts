// SPDX-License-Identifier: BSD-3-Clause
/*
 * Copyright (c) 2024 Qualcomm Innovation Center, Inc. All rights reserved.
 */

/dts-v1/;

#include "monaco.dtsi"

/ {
	model = "Qualcomm Technologies, Inc. Monaco SoC";
	compatible = "qcom,monaco";
	qcom,board-id = <0 0>;
};

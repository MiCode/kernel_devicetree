/dts-v1/;

#include "yupik.dtsi"
#include "yupik-idp-pm7250b.dtsi"

/ {
	model = "Qualcomm Technologies, Inc. Yupik IDP + PM7250B";
	compatible = "qcom,yupik-idp", "qcom,yupik", "qcom,idp";
	qcom,board-id = <34 0>;
};

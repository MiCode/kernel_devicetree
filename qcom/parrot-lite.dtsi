// SPDX-License-Identifier: BSD-3-Clause
/*
 * Copyright (c) Qualcomm Technologies, Inc. and/or its subsidiaries.
 */

#include "parrot.dtsi"

/ {
	model = "Qualcomm Technologies, Inc. Parrot Lite";
	compatible = "qcom,parrot";
	qcom,msm-id = <715 0x10000>;
};

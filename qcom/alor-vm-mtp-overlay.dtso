// SPDX-License-Identifier: BSD-3-Clause
/*
 * Copyright (c) Qualcomm Technologies, Inc. and/or its subsidiaries.
 */
/dts-v1/;
/plugin/;

#include "alor-vm-avf.dtsi"
#include "alor-vm-mtp-avf.dtsi"

/ {
	model = "Qualcomm Technologies, Inc. Alor SVM MTP";
	compatible = "qcom,alor-mtp", "qcom,alor", "qcom,alorp-mtp",
			"qcom,alorp", "qcom,mtp";
	qcom,board-id = <0x10008 0>;

	host {
	};
};

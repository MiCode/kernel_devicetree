// SPDX-License-Identifier: BSD-3-Clause
/*
 * Copyright (c) 2025 Qualcomm Innovation Center, Inc. All rights reserved.
 */

/dts-v1/;
/plugin/;

#include "alor-qrd.dtsi"

/ {
	model = "Qualcomm Technologies, Inc. Alor QRD + WCN7750 WLAN + Kundu";
	compatible = "qcom,alor-qrd", "qcom,alor", "qcom,qrd";
	qcom,msm-id = <685 0x10000>;
	qcom,board-id = <0x1000B 0>;
};

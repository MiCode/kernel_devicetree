/dts-v1/;
/plugin/;

#include "trinketp-iot-idp.dtsi"

/ {
	model = "Ext Audio Codec IDP";
	compatible = "qcom,trinketp-iot-idp", "qcom,trinketp-iot", "qcom,idp";
	qcom,msm-id = <468 0x10000>;
	qcom,board-id = <34 1>;
};

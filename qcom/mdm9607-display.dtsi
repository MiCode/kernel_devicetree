/ {
	mdss_qpic: qcom,msm_qpic@7980000 {
		compatible = "qcom,mdss_qpic";
		reg = <0x7980000 0x24000>;
		reg-names = "qpic_base";

		interrupts = <0 251 0>;
		interrupt-names = "disp_irq";

		qcom,msm-bus,name = "mdss_qpic";
		qcom,msm-bus,num-cases = <2>;
		qcom,msm-bus,num-paths = <1>;

		qcom,msm-bus,vectors-KBps =
			<91 512 0 0>,
			/* Voting for max b/w on PNOC bus for now */
			<91 512 400000 800000>;

		vdd-supply = <&mdm9607_l11>;

		clock-names = "core_clk", "core_a_clk";
		clocks = <&rpmcc RPM_SMD_QPIC_CLK>,
			<&rpmcc RPM_SMD_QPIC_CLK_A>;

	};
};

/dts-v1/;

#include "kalama-oemvm.dtsi"
#include "kalama-oemvm-rumi.dtsi"

/ {
	model = "Qualcomm Technologies, Inc. Kalama OEMVM RUMI";
	compatible = "qcom,kalama-rumi", "qcom,kalama", "qcom,rumi";
	qcom,board-id = <15 0>;
};

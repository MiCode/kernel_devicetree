/dts-v1/;
/plugin/;

#include "kalama-rcm.dtsi"

/ {
	model = "Qualcomm Technologies, Inc. Kalama RCM";
	compatible = "qcom,kalama-rcm", "qcom,kalama", "qcom,rcm";
	qcom,msm-id = <519 0x10000>, <536 0x10000>, <519 0x20000>, <536 0x20000>,
			<600 0x20000>, <601 0x20000>, <603 0x20000>, <604 0x20000>,
			<668 0x20000>, <688 0x20000>;
	qcom,board-id = <0x10015 0>, <0x20015 0>;
};

&pcie0 {
	msi-map = <0x0 &gic_its 0x1400 0x1>,
		  <0x100 &gic_its 0x1401 0x1>; /* 32 event IDs */

};



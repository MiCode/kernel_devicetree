/dts-v1/;

#include "pineapplep-oemvm.dtsi"
#include "pineapplep-oemvm-hdk.dtsi"

/ {
	model = "Qualcomm Technologies, Inc. PineappleP OEMVM HDK";
	compatible = "qcom,pineapplep-hdk", "qcom,pineapplep", "qcom,hdk";
	qcom,board-id = <0x1f 0>;
};

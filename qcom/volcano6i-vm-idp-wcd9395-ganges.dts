/dts-v1/;
/plugin/;

#include "volcano-vm.dtsi"
#include "volcano6i-vm-idp-wcd9395-ganges.dtsi"

/ {
	model = "Qualcomm Technologies, Inc. Volcano6I SVM IDP + WCD9395 HSJ + Ganges";
	compatible = "qcom,volcano-idp", "qcom,volcano", "qcom,idp";
	qcom,board-id = <34 2>;
};

/dts-v1/;

#include "crowp-oemvm.dtsi"
#include "crowp-oemvm-idp-wcd9395-aatc.dtsi"

/ {
	model = "Qualcomm Technologies, Inc. OEM VM CrowP IDP + WCD9395 AATC";
	compatible = "qcom,crowp-idp", "qcom,crowp", "qcom,idp";
	qcom,board-id = <34 3>;
};

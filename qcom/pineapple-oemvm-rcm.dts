/dts-v1/;

#include "pineapple-oemvm.dtsi"
#include "pineapple-oemvm-rcm.dtsi"

/ {
	model = "Qualcomm Technologies, Inc. Pineapple OEMVM RCM";
	compatible = "qcom,pineapple-rcm", "qcom,pineapple", "qcom,rcm";
	qcom,board-id = <0x15 0>;
};

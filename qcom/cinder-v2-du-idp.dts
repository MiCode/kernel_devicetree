/dts-v1/;

#include "cinder-v2-du.dtsi"
#include "cinder-v2-du-hireg.dtsi"
#include "cinder-v2-idp.dtsi"

/ {
	model = "Qualcomm Technologies, Inc. Cinder V2 DU IDP";
	compatible = "qcom,cinder-idp", "qcom,cinder", "qcom,idp";
	qcom,board-id = <0x22 0x0>;
};

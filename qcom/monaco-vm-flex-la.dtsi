#include "monaco-vm-la.dtsi"

/ {
	cpus {
		/delete-node/ opp-table1;
		/delete-node/ cpu@2;
		/delete-node/ cpu@3;
		/delete-node/ cpu@4;
		/delete-node/ cpu@5;
		/delete-node/ cpu@6;
		/delete-node/ cpu@7;

		cpu-map {
			cluster0 {
				/delete-node/ core2;
				/delete-node/ core3;
			};

			/delete-node/ cluster1;
		};
	};
};

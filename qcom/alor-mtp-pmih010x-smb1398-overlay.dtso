// SPDX-License-Identifier: BSD-3-Clause
/*
 * Copyright (c) 2025 Qualcomm Innovation Center, Inc. All rights reserved.
 */

/dts-v1/;
/plugin/;

#include "alor-mtp-pmih010x-smb1398.dtsi"

/ {
	model = "Qualcomm Technologies, Inc. Alor MTP + Peach WLAN + PMIH010X SMB1398 + SN220U + Panderio";
	compatible = "qcom,alor-mtp", "qcom,alor", "qcom,mtp";
	qcom,msm-id = <685 0x10000>;
	qcom,board-id = <0x30008 0>;
};

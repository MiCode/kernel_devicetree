/dts-v1/;
/plugin/;

#include <dt-bindings/interconnect/qcom,yupik.h>
#include "yupikp-idp-hsp.dtsi"

/ {
	model = "Qualcomm Technologies, Inc. YupikP IDP + HSP";
	compatible = "qcom,yupikp-idp", "qcom,yupikp", "qcom,idp";
	qcom,msm-id = <499 0x10000>;
	qcom,board-id = <34 1>;
};

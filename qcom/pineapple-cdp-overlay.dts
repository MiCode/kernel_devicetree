/dts-v1/;
/plugin/;

#include "pineapple-cdp.dtsi"

/ {
	model = "Qualcomm Technologies, Inc. Pineapple CDP";
	compatible = "qcom,pineapple-cdp", "qcom,pineapple", "qcom,pineapplep-cdp", "qcom,pineapplep", "qcom,cdp";
	qcom,msm-id = <557 0x20000>, <577 0x20000>, <682 0x20000>,
			<645 0x10000>, <645 0x20000>,
			<646 0x10000>, <646 0x20000>,
			<702 0x10000>, <702 0x20000>;
	qcom,board-id = <1 0>, <0x01000001 0>;
};

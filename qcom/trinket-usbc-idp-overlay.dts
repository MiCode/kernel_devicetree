/dts-v1/;
/plugin/;

#include <dt-bindings/interrupt-controller/arm-gic.h>

#include "trinket-idp.dtsi"
#include "trinket-usbc-idp.dtsi"

/ {
	model = "USBC Audio IDP";
	compatible = "qcom,trinket-idp", "qcom,trinket", "qcom,idp";
	qcom,msm-id = <394 0x10000>;
	qcom,board-id = <34 2>;
};

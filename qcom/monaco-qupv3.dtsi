&soc {
	/* QUPv3_0  wrapper  instance */
	qupv3_0: qcom,qupv3_0_geni_se@4ac0000 {
		compatible = "qcom,geni-se-qup";
		reg = <0x4ac0000 0x2000>;
		#address-cells = <1>;
		#size-cells = <1>;
		clock-names = "m-ahb", "s-ahb";
		clocks = <&gcc GCC_QUPV3_WRAP_0_M_AHB_CLK>,
			<&gcc GCC_QUPV3_WRAP_0_S_AHB_CLK>;
		iommus = <&apps_smmu 0xe3 0x0>;
		qcom,iommu-dma-addr-pool = <0x40000000 0xc0000000>;
		qcom,iommu-geometry = <0x40000000 0x10000000>;
		qcom,iommu-dma = "fastmap";
		dma-coherent;
		ranges;
		status = "ok";

		/* Debug UART Instance */
		qupv3_se6_2uart: qcom,qup_uart@4a98000 {
			compatible = "qcom,geni-debug-uart";
			reg = <0x4a98000 0x4000>;
			reg-names = "se_phys";
			interrupts = <GIC_SPI 333 IRQ_TYPE_LEVEL_HIGH>;
			clock-names = "se";
			clocks = <&gcc GCC_QUPV3_WRAP0_S6_CLK>;
			interconnect-names = "qup-core", "qup-config", "qup-memory";
			interconnects =
			<&clk_virt MASTER_QUP_CORE_0 &clk_virt SLAVE_QUP_CORE_0>,
			<&bimc MASTER_AMPSS_M0 &config_noc SLAVE_QUP_0>,
			<&system_noc MASTER_QUP_0 &bimc SLAVE_EBI_CH0>;
			pinctrl-names = "default", "sleep";
			pinctrl-0 = <&qupv3_se6_2uart_tx_active>, <&qupv3_se3_2uart_rx_active>;
			pinctrl-1 = <&qupv3_se6_2uart_sleep>;
			status = "disabled";
		};

		/* HS UART Instance */
		qupv3_se5_4uart: qcom,qup_uart@4a94000 {
			compatible = "qcom,msm-geni-serial-hs";
			reg = <0x4a94000 0x4000>;
			reg-names = "se_phys";
			interrupts-extended = <&intc GIC_SPI 332 IRQ_TYPE_LEVEL_HIGH>,
					<&tlmm 29 IRQ_TYPE_LEVEL_HIGH>;
			clock-names = "se-clk";
			clocks = <&gcc GCC_QUPV3_WRAP0_S5_CLK>;
			interconnect-names = "qup-core", "qup-config", "qup-memory";
			interconnects =
			<&clk_virt MASTER_QUP_CORE_0 &clk_virt SLAVE_QUP_CORE_0>,
			<&bimc MASTER_AMPSS_M0 &config_noc SLAVE_QUP_0>,
			<&system_noc MASTER_QUP_0 &bimc SLAVE_EBI_CH0>;
			pinctrl-names = "default", "active", "sleep", "shutdown";
			pinctrl-0 = <&qupv3_se5_default_cts>, <&qupv3_se5_default_rts>,
			<&qupv3_se5_default_tx>, <&qupv3_se5_default_rx>;
			pinctrl-1 = <&qupv3_se5_cts>, <&qupv3_se5_rts>,
			<&qupv3_se5_tx>, <&qupv3_se5_rx>;
			pinctrl-2 = <&qupv3_se5_default_cts>, <&qupv3_se5_default_rts>,
			<&qupv3_se5_default_tx>, <&qupv3_se5_default_rx>;
			pinctrl-3 = <&qupv3_se5_default_cts>, <&qupv3_se5_default_rts>,
			<&qupv3_se5_default_tx>, <&qupv3_se5_default_rx>;
			qcom,wakeup-byte = <0xFD>;
			status = "disabled";
		};
	};
};

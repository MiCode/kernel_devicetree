/dts-v1/;

#include "sdxbaagha.dtsi"
#include "sdxbaagha-mtp.dtsi"

/ {
	model = "Qualcomm Technologies, Inc. SDXBAAGHA MTP";
	compatible = "qcom,sdxbaagha-mtp",
		"qcom,sdxbaagha", "qcom,mtp";
	qcom,board-id = <0x08 0>;
};

/dts-v1/;

#include "cliffs-oemvm.dtsi"
#include "cliffs-oemvm-atp.dtsi"

/ {
	model = "Qualcomm Technologies, Inc. Cliffs OEMVM ATP";
	compatible = "qcom,cliffs-atp", "qcom,cliffs", "qcom,atp";
	qcom,board-id = <33 0>;
};

// SPDX-License-Identifier: BSD-3-Clause
/*
 * Copyright (c) 2024 Qualcomm Innovation Center, Inc. All rights reserved.
 */
/dts-v1/;

#include "canoe-oemvm.dtsi"
#include "canoe-oemvm-mtp.dtsi"

/ {
	model = "Qualcomm Technologies, Inc. Canoe OEMVM MTP";
	compatible = "qcom,canoe-mtp", "qcom,canoe", "qcom,canoep-mtp",
			"qcom,canoep", "qcom,mtp";
	qcom,board-id = <8 0>;
};

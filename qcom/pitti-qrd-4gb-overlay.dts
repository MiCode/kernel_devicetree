/dts-v1/;
/plugin/;

#include "pitti-qrd-4gb.dtsi"

/ {
	model = "Qualcomm Technologies, Inc. Pitti QRD 4GB DDR";
	compatible = "qcom,pitti-qrd", "qcom,pitti", "qcom,qrd";
	qcom,msm-id = <623 0x10000>;
	qcom,board-id = <11 0x600>;
};

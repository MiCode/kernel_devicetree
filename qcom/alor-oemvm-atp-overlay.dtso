// SPDX-License-Identifier: BSD-3-Clause
/*
 * Copyright (c) Qualcomm Technologies, Inc. and/or its subsidiaries.
 */
/dts-v1/;
/plugin/;

#include "alor-oemvm-avf.dtsi"
#include "alor-oemvm-atp-avf.dtsi"

/ {
	model = "Qualcomm Technologies, Inc. Alor OEMVM ATP";
	compatible = "qcom,alor-atp", "qcom,alor", "qcom,alorp-atp",
			"qcom,alorp", "qcom,atp";
	qcom,board-id = <0x10021 0>;

	host {
	};
};

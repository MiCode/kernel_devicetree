// SPDX-License-Identifier: BSD-3-Clause
/*
 * Copyright (c) 2024 Qualcomm Innovation Center, Inc. All rights reserved.
 */

/dts-v1/;

#include "sun.dtsi"
#include "sun-tp.dtsi"

/ {
	model = "Qualcomm Technologies, Inc. Sun Alt. Thermal Profile SoC";
	compatible = "qcom,sun";
	qcom,board-id = <0 0>;
};

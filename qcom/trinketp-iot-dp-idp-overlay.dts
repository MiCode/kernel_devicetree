/dts-v1/;
/plugin/;

#include "trinketp-iot-idp.dtsi"

/ {
	model = "Display Port Enable IDP";
	compatible = "qcom,trinketp-iot-idp", "qcom,trinketp-iot", "qcom,idp";
	qcom,msm-id = <468 0x10000>;
	qcom,board-id = <34 4>;
};

&usb0 {
	dwc3@4e00000 {
		usb-phy = <&qusb_phy0>, <&usb_nop_phy>;
		maximum-speed = "high-speed";
	};
};

// SPDX-License-Identifier: BSD-3-Clause
/*
 * Copyright (c) 2025 Qualcomm Innovation Center, Inc. All rights reserved.
 */

/dts-v1/;

#include "yupikp-iot.dtsi"
#include "yupikp-iot-idps-amoled.dtsi"

/ {
	model = "Qualcomm Technologies, Inc. YUPIKP-IOT IDPS + AMOLED";
	compatible = "qcom,yupikp-iot-idp", "qcom,yupikp-iot", "qcom,idp";
	qcom,board-id = <34 2>;
};

// SPDX-License-Identifier: BSD-3-Clause
/*
 * Copyright (c) 2025 Qualcomm Innovation Center, Inc. All rights reserved.
 */

/dts-v1/;

#include "tuna7-vm.dtsi"

/ {
	model = "Qualcomm Technologies, Inc. Tuna 7 SVM SoC";
	compatible = "qcom,tuna";
	qcom,board-id = <0 0>;
};

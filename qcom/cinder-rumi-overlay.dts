/dts-v1/;
/plugin/;

#include "cinder.dtsi"
#include "cinder-rumi.dtsi"

/ {
	model = "Qualcomm Technologies, Inc. Cinder RUMI";
	compatible = "qcom,cinder-rumi", "qcom,cinder", "qcom,rumi";
	qcom,msm-id = <539 0x10000>;
	qcom,board-id = <0xF 0x0>;
};

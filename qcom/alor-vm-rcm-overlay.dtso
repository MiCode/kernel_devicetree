// SPDX-License-Identifier: BSD-3-Clause
/*
 * Copyright (c) Qualcomm Technologies, Inc. and/or its subsidiaries.
 */
/dts-v1/;
/plugin/;

#include "alor-vm-avf.dtsi"
#include "alor-vm-rcm-avf.dtsi"

/ {
	model = "Qualcomm Technologies, Inc. Alor SVM RCM";
	compatible = "qcom,alor-rcm", "qcom,alor", "qcom,alorp-rcm", "qcom,alorp",
			   "qcom,rcm";
	qcom,board-id = <0x10015 0>;

	host {
	};
};

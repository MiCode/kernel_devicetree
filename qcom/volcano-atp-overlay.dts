/dts-v1/;
/plugin/;

#include "volcano-atp.dtsi"
#include "volcano-pmiv0104.dtsi"

/ {
	model = "Qualcomm Technologies, Inc. Volcano ATP";
	compatible = "qcom,volcano-atp", "qcom,volcano", "qcom,volcanop-atp", "qcom,volcanop", "qcom,atp";
	qcom,msm-id = <636 0x10000>, <640 0x10000>, <641 0x10000>;
	qcom,board-id = <33 0>;
};

&pmiv0104_eusb2_repeater {
	status = "ok";
	vdd18-supply = <&L7B>;
	vdd3-supply = <&L17B>;
};

&eusb2_phy0 {
	dummy-supply = <&pmiv0104_eusb2_repeater>;
	usb-repeater = <&pmiv0104_eusb2_repeater>;
};

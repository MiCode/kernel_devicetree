/dts-v1/;

#include "crowp-vm.dtsi"
#include "crowp-vm-idp.dtsi"

/ {
	model = "Qualcomm Technologies, Inc. CrowP VM IDP";
	compatible = "qcom,crowp-idp", "qcom,crowp", "qcom,idp";
	qcom,board-id = <34 0>;
};

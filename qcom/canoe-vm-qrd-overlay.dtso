// SPDX-License-Identifier: BSD-3-Clause
/*
 * Copyright (c) 2025 Qualcomm Innovation Center, Inc. All rights reserved.
 */
/dts-v1/;
/plugin/;

#include "canoe-vm-avf.dtsi"
#include "canoe-vm-qrd-avf.dtsi"

/ {
	model = "Qualcomm Technologies, Inc. Canoe SVM QRD";
	compatible = "qcom,canoe-qrd", "qcom,canoe", "qcom,canoep-qrd", "qcom,canoep",
			   "qcom,qrd";
	qcom,board-id = <11 0>;
};

// SPDX-License-Identifier: BSD-3-Clause
/*
 * Copyright (c) 2024 Qualcomm Innovation Center, Inc. All rights reserved.
 */

/dts-v1/;

#include "ravelin.dtsi"
#include "ravelin-idp.dtsi"

/ {
	model = "Qualcomm Technologies, Inc. Ravelin IDP";
	compatible = "qcom,ravelin-idp", "qcom,ravelin", "qcom,idp";
	qcom,board-id = <34 0>;
};

// SPDX-License-Identifier: BSD-3-Clause
/*
 * Copyright (c) 2025 Qualcomm Innovation Center, Inc. All rights reserved.
 */

#include "yupik-iot.dtsi"

/ {
	model = "Qualcomm Technologies, Inc. YUPIKP-IOT";
	compatible = "qcom,yupikp-iot";
	qcom,msm-id = <498 0x10000>;
};

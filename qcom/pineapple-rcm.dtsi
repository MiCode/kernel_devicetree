#include "pineapple-cdp.dtsi"

&qupv3_se4_i2c {
	status = "disabled";
};

&qupv3_se4_spi {
	#address-cells = <1>;
	#size-cells = <0>;
	status = "ok";
	qcom,touch-active = "atmel,maxtouch";
	qcom,la-vm;

	goodix-berlin@0 {
		compatible = "goodix,gt9916";
		reg = <0x5d>;
		interrupt-parent = <&tlmm>;
		interrupts = <162 0x2008>;
		goodix,reset-gpio = <&tlmm 161 0x00>;
		goodix,irq-gpio = <&tlmm 162 0x2008>;
		goodix,irq-flags = <2>;
		goodix,panel-max-x = <1080>;
		goodix,panel-max-y = <2400>;
		goodix,panel-max-w = <255>;
		goodix,panel-max-p = <4096>;
		invert_xy;
		goodix,firmware-name = "goodix_firmware_i2c.bin";
		goodix,config-name = "goodix_cfg_group_i2c.bin";
		goodix,avdd-name = "avdd";
		goodix,iovdd-name = "iovdd";
		avdd-supply = <&L14B>;
		iovdd-supply = <&L12B>;
	};

	atmel_mxt_ts@4a {
		compatible = "atmel,maxtouch";
		reg = <0x4a>;
		interrupt-parent = <&tlmm>;
		interrupts = <162 0x2008>;
		avdd-supply = <&L14B>;
		vdd-supply = <&L12B>;
		pinctrl-names = "pmx_ts_active", "pmx_ts_suspend";
		pinctrl-0 = <&ts_active>;
		pinctrl-1 = <&ts_int_suspend &ts_res
		atmel,xy_switch;
		atmel,inverty;
		atmel,invertx;
		reset-gpios = <&tlmm 161 0x00>;
		irq-gpios = <&tlmm 162 0x2008>;
		atmel,panel-coords = <0 0 479 799>;
		atmel,display-coords = <0 0 339 729>;
	};
};

/dts-v1/;
/plugin/;

#include "kalamap-oemvm.dtsi"
#include "kalamap-oemvm-iot-vc.dtsi"

/ {
	model = "Qualcomm Technologies, Inc. KalamaP OEMVM IOT VC";
	compatible = "qcom,kalamap-iot", "qcom,kalamap", "qcom,iot";
	qcom,board-id = <0x10020 1>;
};

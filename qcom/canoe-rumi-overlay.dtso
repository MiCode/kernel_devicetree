// SPDX-License-Identifier: BSD-3-Clause
/*
 * Copyright (c) 2024 Qualcomm Innovation Center, Inc. All rights reserved.
 */

/dts-v1/;
/plugin/;

#include "canoe-rumi.dtsi"

/ {
	model = "Qualcomm Technologies, Inc. Canoe RUMI";
	compatible = "qcom,canoe-rumi", "qcom,canoe", "qcom,rumi";
	qcom,msm-id = <660 0x10000>, <660 0x20000>;
	qcom,board-id = <15 0>;
};

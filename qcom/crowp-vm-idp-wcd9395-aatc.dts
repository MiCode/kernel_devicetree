/dts-v1/;

#include "crowp-vm.dtsi"
#include "crowp-vm-idp-wcd9395-aatc.dtsi"

/ {
	model = "Qualcomm Technologies, Inc. VM CrowP IDP + WCD9395 AATC";
	compatible = "qcom,crowp-idp", "qcom,crowp", "qcom,idp";
	qcom,board-id = <34 3>;
};

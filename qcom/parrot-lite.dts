// SPDX-License-Identifier: BSD-3-Clause
/*
 * Copyright (c) Qualcomm Technologies, Inc. and/or its subsidiaries.
 */

/dts-v1/;

#include "parrot-lite.dtsi"

/ {
	model = "Qualcomm Technologies, Inc. Parrot Lite";
	compatible = "qcom,parrot";
	qcom,board-id = <0 0>;
};

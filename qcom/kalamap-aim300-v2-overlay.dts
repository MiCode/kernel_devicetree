/dts-v1/;
/plugin/;

#include "kalamap-aim300-v2.dtsi"

/ {
	model = "Qualcomm Technologies, Inc. Kalamap AIM300 V2";
	compatible = "qcom,kalamap-hdk", "qcom,kalamap", "qcom,hdk";
	qcom,msm-id = <603 0x20000>;
	qcom,board-id = <0x1011f 0x3>;
};

&pcie0 {
	qcom,config-recovery;
	qcom,drv-name = "lpass";
	msi-map = <0x0 &gic_its 0x1400 0x1>,
		  <0x100 &gic_its 0x1401 0x1>; /* 32 event IDs */
};

#include "trinket.dtsi"
#include "trinket-thermal-overlay.dtsi"

/ {
	model = "Qualcomm Technologies, Inc. TRINKET IOT";
	compatible = "qcom,trinket-iot";
	qcom,msm-id = <467 0x0>;
	qcom,msm-name = "trinket";
};

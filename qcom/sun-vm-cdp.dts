// SPDX-License-Identifier: BSD-3-Clause
/*
 * Copyright (c) 2023-2024 Qualcomm Innovation Center, Inc. All rights reserved.
 */
/dts-v1/;

#include "sun-vm.dtsi"
#include "sun-vm-cdp.dtsi"

/ {
	model = "Qualcomm Technologies, Inc. Sun SVM CDP";
	compatible = "qcom,sun-cdp", "qcom,sun", "qcom,sunp-cdp",
			"qcom,sunp", "qcom,cdp";
	qcom,board-id = <1 0>;
};

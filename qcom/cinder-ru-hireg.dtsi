&reserved_memory {
	#address-cells = <2>;
	#size-cells = <2>;
	ranges;

	ecc_meta_data_reserved_mem: ecc_meta_data_reserved_region@f0000000 {
		no-map;
		reg = <0x0 0xf0000000 0x0 0x10000000>;
	};

	tenx_sp_mem: tenx_sp_region@800000000 {
		no-map;
		reg = <0x8 0x0 0x0 0x80000000>;
	};
};

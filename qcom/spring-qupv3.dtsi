&qupv3_se0_spi {
	pinctrl-0 = <&qupv3_se0_spi_mosi_active>, <&qupv3_se0_spi_miso_active>,
	<&qupv3_se0_spi_clk_active>, <&qupv3_se0_spi_cs_active>;
	pinctrl-1 = <&qupv3_se0_spi_miso_cs_sleep>, <&qupv3_se0_spi_mosi_clk_sleep>;
};
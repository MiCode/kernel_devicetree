/dts-v1/;

#include "kalamap-vm.dtsi"
#include "kalamap-vm-cdp.dtsi"

/ {
	model = "Qualcomm Technologies, Inc. KalamaP SVM CDP";
	compatible = "qcom,kalamap-cdp", "qcom,kalamap", "qcom,cdp";
	qcom,board-id = <0x10001 0>;
};

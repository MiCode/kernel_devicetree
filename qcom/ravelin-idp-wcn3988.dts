/dts-v1/;

#include "ravelin.dtsi"
#include "ravelin-idp-wcn3988.dtsi"

/ {
	model = "Qualcomm Technologies, Inc. Ravelin IDP + WCN3988";
	compatible = "qcom,ravelin-idp", "qcom,ravelin", "qcom,idp";
	qcom,board-id = <34 1>;
};

#include "pineapple.dtsi"

/ {
	model = "Qualcomm Technologies, Inc. Pineapple v2 SoC";
	compatible = "qcom,pineapple";
	qcom,msm-id = <557 0x20000>;
};

&camcc {
	compatible = "qcom,pineapple-camcc-v2", "syscon";
};

&videocc {
	compatible = "qcom,pineapple-videocc-v2", "syscon";
};

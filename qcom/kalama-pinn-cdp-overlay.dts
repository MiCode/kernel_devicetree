/dts-v1/;
/plugin/;

#include "kalama-cdp.dtsi"
#include "sdxpinn-external-soc.dtsi"
#include "kalama-pinn.dtsi"

/ {
	model = "KALAMA PINN CDP";
	compatible = "qcom,kalama-cdp", "qcom,kalama", "qcom,cdp";
	qcom,msm-id = <519 0x10000>;
	qcom,board-id = <0x03010001 0x3>;
};

/dts-v1/;

#include "cliffs-vm.dtsi"
#include "cliffs-vm-cdp.dtsi"

/ {
	model = "Qualcomm Technologies, Inc. Cliffs SVM CDP";
	compatible = "qcom,cliffs-cdp", "qcom,cliffs", "qcom,cdp";
	qcom,board-id = <1 0>;
};

/dts-v1/;
/plugin/;

#include "kona-iot-v2.1-rb5.dtsi"

/ {
	model = "Qualcomm Technologies, Inc. kona-7230-iot RB5";
	compatible = "qcom,kona-iot-qrd", "qcom,kona-iot", "qcom,kona-qrd";
	qcom,msm-id = <548 0x20001>;
	qcom,board-id = <0x301000b 0x0>;
};

&usb1 {
	status = "disabled";
};

&usb_qmp_phy {
	status = "disabled";
};

&usb2_phy1 {
	status = "disabled";
};

#include "monaco_auto.dtsi"
#include "monaco_auto-regulators-ivi.dtsi"

/ {
	model = "Qualcomm Technologies, Inc. MonacoAU IVI SoC";
	compatible = "qcom,monaco_auto-ivi", "qcom,monaco_auto";
	qcom,msm-id = <606 0x10000>;
};

&ufshc_mem {

	vccq2-supply = <&S4A>;
	vccq2-max-microamp = <800000>;

};

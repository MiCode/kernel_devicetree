/dts-v1/;
/plugin/;

#include "kona-rb5-HDMI.dtsi"

/ {
	model = "Qualcomm Technologies, Inc. Robotics RB5 Platform with HDMI adapter card";
	compatible = "qcom,kona-mtp", "qcom,kona", "qcom,mtp";
	qcom,board-id = <0x5010008 0x0>;
};

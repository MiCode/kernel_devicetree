// SPDX-License-Identifier: BSD-3-Clause
/*
 * Copyright (c) 2025 Qualcomm Innovation Center, Inc. All rights reserved.
 */

&soc {
	walt {
		#address-cells = <1>;
		#size-cells = <1>;
		ranges;

		qcom,cycle-cntr {
			compatible = "qcom,epss";
			reg = <0x18591000 0x1000>,
				<0x18592000 0x1000>,
				<0x18593000 0x1000>;
			reg-names = "freq-domain0",
				"freq-domain1",
				"freq-domain2";
		};
	};
};

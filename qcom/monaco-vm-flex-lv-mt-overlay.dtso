// SPDX-License-Identifier: BSD-3-Clause
/*
 * Copyright (c) Qualcomm Technologies, Inc. and/or its subsidiaries.
 */

/dts-v1/;
/plugin/;

/ {
	model = "Qualcomm Technologies, Inc. Monaco Multi LV Virtual Machine";
	qcom,msm-name = "SA_MONACO_FLEX_IVI";
	compatible = "qcom,monaco", "qcom,quinvm";
	qcom,msm-id = <695 0x10000>;
	qcom,board-id = <0x0 0x2000002>;
};

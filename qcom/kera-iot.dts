// SPDX-License-Identifier: BSD-3-Clause
/*
 * Copyright (c) Qualcomm Technologies, Inc. and/or its subsidiaries.
 */

/dts-v1/;
#include "kera.dtsi"

/ {
	model = "Qualcomm Technologies, Inc. Kera IoT SoC";
	compatible = "qcom,kera";
	qcom,msm-id = <731 0x10000>;
	qcom,board-id = <0 0>;
};

/dts-v1/;

#include "kalama-oemvm.dtsi"
#include "kalama-oemvm-mtp.dtsi"

/ {
	model = "Qualcomm Technologies, Inc. Kalama OEMVM MTP";
	compatible = "qcom,kalama-mtp", "qcom,kalama", "qcom,mtp";
	qcom,board-id = <0x10008 0>;
};

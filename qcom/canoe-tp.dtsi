// SPDX-License-Identifier: BSD-3-Clause
/*
 * Copyright (c) 2024 Qualcomm Innovation Center, Inc. All rights reserved.
 */

#include "canoe.dtsi"

/ {
	model = "Qualcomm Technologies, Inc. Canoe Alt. Thermal Profile SoC";
	compatible = "qcom,canoe";
	qcom,msm-id = <0x1000294 0x10000>;
};

/dts-v1/;
/plugin/;

#include "volcano6i-mtp-wcd9395-ganges-hac2019.dtsi"

/ {
	model = "Qualcomm Technologies, Inc. Volcano6I MTP + WCD9395 HSJ + HAC2019/RFID + Ganges";
	compatible = "qcom,volcano-mtp", "qcom,volcano", "qcom,volcanop-mtp", "qcom,volcanop", "qcom,mtp";
	qcom,msm-id = <657 0x10000>, <658 0x10000>;
	qcom,board-id = <8 4>;
};


/dts-v1/;

#include "sa410m-rumi.dtsi"

/ {
	model = "Qualcomm Technologies, Inc. SA410M RUMI";
	compatible = "qcom,sa410m", "qcom,rumi", "qcom,sa410m-rumi";
	qcom,msm-id=<560 0x10000>;
	qcom,board-id = <15 0x400>;
};

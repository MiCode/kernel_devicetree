// SPDX-License-Identifier: BSD-3-Clause
/*
 * Copyright (c) 2024 Qualcomm Innovation Center, Inc. All rights reserved.
 */

/dts-v1/;

#include "parrotp.dtsi"
#include "parrotp-qrd.dtsi"
#include "parrot-qrd-pm8350b.dtsi"

/ {
	model = "Qualcomm Technologies, Inc. ParrotP QRD";
	compatible = "qcom,parrotp-qrd", "qcom,parrotp", "qcom,qrd";
	qcom,board-id = <0x1000B 0>;
};

// SPDX-License-Identifier: BSD-3-Clause
/*
 * Copyright (c) 2025 Qualcomm Innovation Center, Inc. All rights reserved.
 */

#include "tuna-oemvm.dtsi"

/ {
	model = "Qualcomm Technologies, Inc. Tuna 7 OEMVM";
	compatible = "qcom,tuna";
	qcom,msm-id = <681 0x10000>;
};


// SPDX-License-Identifier: BSD-3-Clause
/*
 * Copyright (c) 2024 Qualcomm Innovation Center, Inc. All rights reserved.
 */

/dts-v1/;

#include "tuna-oemvm.dtsi"
#include "tuna-oemvm-rumi.dtsi"

/ {
	model = "Qualcomm Technologies, Inc. Tuna OEMVM RUMI";
	compatible = "qcom,tuna-rumi", "qcom,tuna", "qcom,rumi";
	qcom,board-id = <15 0>;
};

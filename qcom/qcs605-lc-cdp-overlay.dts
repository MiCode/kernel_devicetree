/dts-v1/;
/plugin/;

#include <dt-bindings/interrupt-controller/arm-gic.h>
#include "qcs605-lc-cdp.dtsi"

/ {
	model = "Qualcomm Technologies, Inc. QC605 LC Groot + PM8005 CDP";
	compatible = "qcom,qcs605-cdp", "qcom,qcs605", "qcom,cdp";
	qcom,msm-id = <347 0x0>;
	qcom,board-id = <1 4>;
};

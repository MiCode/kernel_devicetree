/dts-v1/;
/plugin/;

#include "pineapple-rcm.dtsi"

/ {
	model = "Qualcomm Technologies, Inc. Pineapple RCM";
	compatible = "qcom,pineapple-rcm", "qcom,pineapple", "qcom,pineapplep-rcm", "qcom,pineapplep", "qcom,rcm";
	qcom,msm-id = <557 0x10000>, <557 0x20000>, <577 0x10000>, <577 0x20000>;
	qcom,board-id = <0x15 0>;
};

// SPDX-License-Identifier: BSD-3-Clause
/*
 * Copyright (c) Qualcomm Technologies, Inc. and/or its subsidiaries.
 */

/dts-v1/;
/plugin/;

#include "x1p42100-crd.dtsi"

/ {
        model = "Qualcomm Technologies, Inc. X1P42100 CRD";
        compatible = "qcom,x1p42100-crd", "qcom,x1p42100", "qcom,crd";
        qcom,msm-id = <635 0x10000>, <635 0x20000>;
        qcom,board-id = <40 0>;
};

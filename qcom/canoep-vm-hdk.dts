// SPDX-License-Identifier: BSD-3-Clause
/*
 * Copyright (c) 2025 Qualcomm Innovation Center, Inc. All rights reserved.
 */

/dts-v1/;

#include "canoep-vm.dtsi"
#include "canoep-vm-hdk.dtsi"

/ {
	model = "Qualcomm Technologies, Inc. CanoeP SVM HDK";
	compatible = "qcom,canoep-hdk", "qcom,canoep", "qcom,hdk";
	qcom,board-id = <0x1001F 0>;
};

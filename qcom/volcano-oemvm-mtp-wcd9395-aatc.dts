/dts-v1/;

#include "volcano-oemvm.dtsi"
#include "volcano-oemvm-mtp-wcd9395-aatc.dtsi"

/ {
	model = "Qualcomm Technologies, Inc. Volcano OEMVM MTP + WCD9395 AATC";
	compatible = "qcom,volcano-mtp", "qcom,volcano", "qcom,mtp";
	qcom,board-id = <8 1>;
};

// SPDX-License-Identifier: BSD-3-Clause
/*
 * Copyright (c) 2025 Qualcomm Innovation Center, Inc. All rights reserved.
 */
/dts-v1/;
/plugin/;

#include "canoe-vm-avf.dtsi"
#include "canoe-vm-cdp-avf.dtsi"

/ {
	model = "Qualcomm Technologies, Inc. Canoe SVM CDP";
	compatible = "qcom,canoe-cdp", "qcom,canoe", "qcom,canoep-cdp",
			"qcom,canoep", "qcom,cdp";
	qcom,board-id = <1 0>;
};

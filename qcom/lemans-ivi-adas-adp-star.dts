/dts-v1/;

#include "lemans-ivi-adas.dtsi"
#include "lemans-qam-star.dtsi"

/ {
	model = "Qualcomm Technologies, Inc. Lemans IVI ADAS ADP STAR";
	compatible = "qcom,lemans-ivi-adas", "qcom,lemans", "qcom,adp-star", "qcom,lemans-ivi-adas-adp-star";
};


/dts-v1/;

#include "cliffs-oemvm.dtsi"
#include "cliffs-oemvm-rcm-fhdp-kiwi.dtsi"

/ {
	model = "Qualcomm Technologies, Inc. Cliffs OEMVM RCM FHD Plus + kiwi WLAN";
	compatible = "qcom,cliffs-rcm", "qcom,cliffs", "qcom,rcm";
	qcom,board-id = <21 2>;
};

/dts-v1/;

#include "lemans-gunyah-vm-lv.dtsi"

/ {
	model = "Qualcomm Technologies, Inc. Lemans IVI ADAS COB Gunyah LV VM";
	compatible = "qcom,lemans", "qcom,cob";
	qcom,board-id = <0x10019 0x0>;
};

/dts-v1/;
/plugin/;

#include "sa8155-adp-common.dtsi"

/ {
	model = "ADP-AIR";
	compatible = "qcom,sa8155-v2-adp-air", "qcom,sa8155",
		"qcom,adp-air";
	qcom,msm-id = <362 0x20000>;
	qcom,board-id = <0X01000019 0>;
};

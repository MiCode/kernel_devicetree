/dts-v1/;
/plugin/;

/ {
	model = "Qualcomm Technologies, Inc. Monaco Single LV Virtual Machine";
	compatible = "qcom,monaco", "qcom,quinvm";
	qcom,msm-id = <606 0x10000>;
	qcom,board-id = <0 0x1000002>;
};

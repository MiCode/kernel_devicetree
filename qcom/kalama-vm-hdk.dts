/dts-v1/;

#include "kalamap-vm.dtsi"
#include "kalamap-vm-hdk.dtsi"

/ {
	model = "Qualcomm Technologies, Inc. KalamaP SVM HDK";
	compatible = "qcom,kalamap-hdk", "qcom,kalamap", "qcom,hdk";
	qcom,board-id = <0x1001f 0>;
};

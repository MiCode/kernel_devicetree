#include "sm8150.dtsi"

/ {
	model = "Qualcomm Technologies, Inc. SM8150 V2";
	qcom,msm-name = "SM8150 V2";
	qcom,msm-id = <339 0x20000>;
};

/delete-node/ &apps_smmu;
/delete-node/ &kgsl_smmu;

#include "msm-arm-smmu-sm8150-v2.dtsi"

&pcie0 {
	reg = <0x1c00000 0x4000>,
		<0x1c06000 0x1000>,
		<0x60000000 0xf1d>,
		<0x60000f20 0xa8>,
		<0x60001000 0x1000>,
		<0x60100000 0x100000>,
		<0x60200000 0x100000>,
		<0x60300000 0x3d00000>;

	qcom,pcie-phy-ver = <2110>;

	qcom,phy-sequence = <0x0840 0x03 0x0
			0x0094 0x08 0x0
			0x0154 0x34 0x0
			0x016c 0x08 0x0
			0x0058 0x0f 0x0
			0x00a4 0x42 0x0
			0x0110 0x24 0x0
			0x011c 0x03 0x0
			0x0118 0xb4 0x0
			0x010c 0x02 0x0
			0x01bc 0x11 0x0
			0x00bc 0x82 0x0
			0x00d4 0x03 0x0
			0x00d0 0x55 0x0
			0x00cc 0x55 0x0
			0x00b0 0x1a 0x0
			0x00ac 0x0a 0x0
			0x00c4 0x68 0x0
			0x00e0 0x02 0x0
			0x00dc 0xaa 0x0
			0x00d8 0xab 0x0
			0x00b8 0x34 0x0
			0x00b4 0x14 0x0
			0x0158 0x01 0x0
			0x0074 0x06 0x0
			0x007c 0x16 0x0
			0x0084 0x36 0x0
			0x0078 0x06 0x0
			0x0080 0x16 0x0
			0x0088 0x36 0x0
			0x01b0 0x1e 0x0
			0x01ac 0xb9 0x0
			0x01b8 0x18 0x0
			0x01b4 0x94 0x0
			0x0050 0x07 0x0
			0x0010 0x00 0x0
			0x001c 0x31 0x0
			0x0020 0x01 0x0
			0x0024 0xde 0x0
			0x0028 0x07 0x0
			0x0030 0x4c 0x0
			0x0034 0x06 0x0
			0x029c 0x12 0x0
			0x0284 0x35 0x0
			0x023c 0x11 0x0
			0x051c 0x03 0x0
			0x0518 0x1c 0x0
			0x0524 0x1e 0x0
			0x04e8 0x00 0x0
			0x04ec 0x0e 0x0
			0x04f0 0x4a 0x0
			0x04f4 0x0f 0x0
			0x05b4 0x04 0x0
			0x0434 0x7f 0x0
			0x0444 0x70 0x0
			0x0510 0x17 0x0
			0x04d4 0x54 0x0
			0x04d8 0x07 0x0
			0x0598 0xd4 0x0
			0x059c 0x54 0x0
			0x05a0 0xdb 0x0
			0x05a4 0x3b 0x0
			0x05a8 0x31 0x0
			0x0584 0x24 0x0
			0x0588 0xe4 0x0
			0x058c 0xec 0x0
			0x0590 0x3b 0x0
			0x0594 0x36 0x0
			0x0570 0xff 0x0
			0x0574 0xff 0x0
			0x0578 0xff 0x0
			0x057c 0x7f 0x0
			0x0580 0x66 0x0
			0x04fc 0x00 0x0
			0x04f8 0xc0 0x0
			0x0460 0x30 0x0
			0x0464 0xc0 0x0
			0x05bc 0x0c 0x0
			0x04dc 0x0d 0x0
			0x0408 0x0c 0x0
			0x0414 0x03 0x0
			0x09a4 0x01 0x0
			0x0c90 0x00 0x0
			0x0c40 0x01 0x0
			0x0c48 0x01 0x0
			0x0c50 0x00 0x0
			0x0cbc 0x00 0x0
			0x0ce0 0x58 0x0
			0x0048 0x90 0x0
			0x0c1c 0xc1 0x0
			0x0988 0x88 0x0
			0x0998 0x0b 0x0
			0x08dc 0x0d 0x0
			0x09ec 0x01 0x0
			0x0800 0x00 0x0
			0x0844 0x03 0x0>;
};

&pcie1 {
	reg = <0x1c08000 0x4000>,
		<0x1c0e000 0x2000>,
		<0x40000000 0xf1d>,
		<0x40000f20 0xa8>,
		<0x40001000 0x1000>,
		<0x40100000 0x100000>,
		<0x40200000 0x100000>,
		<0x40300000 0x1fd00000>;

	qcom,pcie-phy-ver = <2109>;

	qcom,phy-sequence = <0x0a40 0x03 0x0
			0x0010 0x00 0x0
			0x001c 0x31 0x0
			0x0020 0x01 0x0
			0x0024 0xde 0x0
			0x0028 0x07 0x0
			0x0030 0x4c 0x0
			0x0034 0x06 0x0
			0x0048 0x90 0x0
			0x0058 0x0f 0x0
			0x0074 0x06 0x0
			0x0078 0x06 0x0
			0x007c 0x16 0x0
			0x0080 0x16 0x0
			0x0084 0x36 0x0
			0x0088 0x36 0x0
			0x0094 0x08 0x0
			0x00a4 0x42 0x0
			0x00ac 0x0a 0x0
			0x00b0 0x1a 0x0
			0x00b4 0x14 0x0
			0x00b8 0x34 0x0
			0x00bc 0x82 0x0
			0x00c4 0x68 0x0
			0x00cc 0x55 0x0
			0x00d0 0x55 0x0
			0x00d4 0x03 0x0
			0x00d8 0xab 0x0
			0x00dc 0xaa 0x0
			0x00e0 0x02 0x0
			0x010c 0x02 0x0
			0x0110 0x24 0x0
			0x0118 0xb4 0x0
			0x011c 0x03 0x0
			0x0154 0x34 0x0
			0x0158 0x01 0x0
			0x016c 0x08 0x0
			0x01ac 0xb9 0x0
			0x01b0 0x1e 0x0
			0x01b4 0x94 0x0
			0x01b8 0x18 0x0
			0x01bc 0x11 0x0
			0x023c 0x11 0x0
			0x0284 0x35 0x0
			0x029c 0x12 0x0
			0x0304 0x02 0x0
			0x0408 0x0c 0x0
			0x0414 0x03 0x0
			0x0434 0x7f 0x0
			0x0444 0x70 0x0
			0x0460 0x30 0x0
			0x0464 0x00 0x0
			0x04d4 0x04 0x0
			0x04d8 0x07 0x0
			0x04dc 0x0d 0x0
			0x04e8 0x00 0x0
			0x04ec 0x0e 0x0
			0x04f0 0x4a 0x0
			0x04f4 0x0f 0x0
			0x04f8 0xc0 0x0
			0x04fc 0x00 0x0
			0x0510 0x17 0x0
			0x0518 0x1c 0x0
			0x051c 0x03 0x0
			0x0524 0x1e 0x0
			0x0570 0xff 0x0
			0x0574 0xff 0x0
			0x0578 0xff 0x0
			0x057c 0x7f 0x0
			0x0580 0x66 0x0
			0x0584 0x24 0x0
			0x0588 0xe4 0x0
			0x058c 0xec 0x0
			0x0590 0x3b 0x0
			0x0594 0x36 0x0
			0x0598 0xd4 0x0
			0x059c 0x54 0x0
			0x05a0 0xdb 0x0
			0x05a4 0x3b 0x0
			0x05a8 0x31 0x0
			0x05bc 0x0c 0x0
			0x063c 0x11 0x0
			0x0684 0x35 0x0
			0x069c 0x12 0x0
			0x0704 0x20 0x0
			0x0808 0x0c 0x0
			0x0814 0x03 0x0
			0x0834 0x7f 0x0
			0x0844 0x70 0x0
			0x0860 0x30 0x0
			0x0864 0x00 0x0
			0x08d4 0x04 0x0
			0x08d8 0x07 0x0
			0x08dc 0x0d 0x0
			0x08e8 0x00 0x0
			0x08ec 0x0e 0x0
			0x08f0 0x4a 0x0
			0x08f4 0x0f 0x0
			0x08f8 0xc0 0x0
			0x08fc 0x00 0x0
			0x0910 0x17 0x0
			0x0918 0x1c 0x0
			0x091c 0x03 0x0
			0x0924 0x1e 0x0
			0x0970 0xff 0x0
			0x0974 0xff 0x0
			0x0978 0xff 0x0
			0x097c 0x7f 0x0
			0x0980 0x66 0x0
			0x0984 0x24 0x0
			0x0988 0xe4 0x0
			0x098c 0xec 0x0
			0x0990 0x3b 0x0
			0x0994 0x36 0x0
			0x0998 0xd4 0x0
			0x099c 0x54 0x0
			0x09a0 0xdb 0x0
			0x09a4 0x3b 0x0
			0x09a8 0x31 0x0
			0x09bc 0x0c 0x0
			0x0adc 0x05 0x0
			0x0b88 0x88 0x0
			0x0b98 0x0b 0x0
			0x0ba4 0x01 0x0
			0x0bec 0x12 0x0
			0x0e0c 0x0d 0x0
			0x0e14 0x07 0x0
			0x0e1c 0xc1 0x0
			0x0e40 0x01 0x0
			0x0e48 0x01 0x0
			0x0e90 0x00 0x0
			0x0eb4 0x33 0x0
			0x0ebc 0x00 0x0
			0x0ee0 0x58 0x0
			0x0ea4 0x0f 0x0
			0x0a00 0x00 0x0
			0x0a44 0x03 0x0>;
};

/dts-v1/;

#include "cliffs-vm.dtsi"
#include "cliffs-vm-rcm-fhdp-kiwi.dtsi"

/ {
	model = "Qualcomm Technologies, Inc. Cliffs SVM RCM FHD Plus + kiwi WLAN";
	compatible = "qcom,cliffs-rcm", "qcom,cliffs", "qcom,rcm";
	qcom,board-id = <21 2>;
};

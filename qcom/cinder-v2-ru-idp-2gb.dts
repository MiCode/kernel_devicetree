/dts-v1/;

#include "cinder-v2-ru.dtsi"
#include "cinder-v2-idp.dtsi"

/ {
	model = "Qualcomm Technologies, Inc. Cinder V2 RU IDP";
	compatible = "qcom,cinder-idp", "qcom,cinder", "qcom,idp";
	qcom,board-id = <0x20022 0x400>;
};

/dts-v1/;

#include "crow-oemvm.dtsi"
#include "crow-oemvm-idp-wcd9395-wcd-dmic.dtsi"

/{
	model = "Qualcomm Technologies, Inc. Crow OEM VM IDP + WCD9395 WCD-DMIC";
	compatible = "qcom,crow-idp", "qcom,crow", "qcom,idp";
	qcom,board-id = <34 1>;
};

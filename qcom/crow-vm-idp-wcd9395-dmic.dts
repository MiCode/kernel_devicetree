/dts-v1/;

#include "crow-vm.dtsi"
#include "crow-vm-idp-wcd9395-dmic.dtsi"

/ {
	model = "Qualcomm Technologies, Inc. VM Crow IDP + WCD9395 DMIC";
	compatible = "qcom,crow-idp", "qcom,crow", "qcom,idp";
	qcom,board-id = <34 2>;
};

#include "trinket.dtsi"
#include "trinketp-iot-qcs.dtsi"

/ {
	model = "Qualcomm Technologies, Inc. TRINKETP";
	compatible = "qcom,trinketp-iot";
	qcom,msm-id = <468 0x0>;
	qcom,msm-name = "trinket";
};

/dts-v1/;

#include "sdxpinn.dtsi"
#include "sdxpinn-mtp.dtsi"

/ {
	model = "Qualcomm Technologies, Inc. SDXPINN MTP";
	compatible = "qcom,sdxpinn-mtp",
		"qcom,sdxpinn", "qcom,mtp";
	qcom,board-id = <0x10008 0x0>;
};

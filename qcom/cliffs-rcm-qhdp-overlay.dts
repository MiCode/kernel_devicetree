/dts-v1/;
/plugin/;

#include "cliffs-rcm-qhdp.dtsi"
#include "cliffs-pm7550ba.dtsi"

/ {
	model = "Qualcomm Technologies, Inc. Cliffs RCM QHD Plus";
	compatible = "qcom,cliffs-rcm", "qcom,cliffs", "qcom,cliffsp-rcm", "qcom,cliffsp", "qcom,rcm";
	qcom,msm-id = <614 0x10000>, <632 0x10000>, <642 0x10000>, <643 0x10000>;
	qcom,board-id = <21 1>;
};

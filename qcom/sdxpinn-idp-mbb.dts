/dts-v1/;

#include "sdxpinn.dtsi"
#include "sdxpinn-idp-mbb.dtsi"

/ {
	model = "Qualcomm Technologies, Inc. SDXPINN IDP MBB";
	compatible = "qcom,sdxpinn-idp",
		"qcom,sdxpinn", "qcom,idp";
	qcom,board-id = <34 0>;
};

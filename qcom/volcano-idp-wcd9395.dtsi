#include "volcano-idp.dtsi"
#include <dt-bindings/interrupt-controller/irq.h>

&qupv3_se7_i2c {
	status = "ok";
	wcd_usbss: wcd939x_i2c@e {
		compatible = "qcom,wcd939x-i2c";
		reg = <0xe>;
		vdd-usb-cp-supply = <&L7B>;
		interrupt-parent = <&spmi_bus>;
		interrupts = <0x0 0xb6 0x1 IRQ_TYPE_EDGE_BOTH>;
		interrupt-names = "usb_wcd";
		nvmem-cells = <&usb_mode>;
		nvmem-cell-names = "usb_mode";
	};
};

&usb0 {
	qcom,wcd_usbss = <&wcd_usbss>;
};

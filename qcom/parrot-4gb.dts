// SPDX-License-Identifier: BSD-3-Clause
/*
 * Copyright (c) 2024 Qualcomm Innovation Center, Inc. All rights reserved.
 */

/dts-v1/;

#include "parrot-4gb.dtsi"

/ {
	model = "Qualcomm Technologies, Inc. Parrot 4Gb SoC";
	compatible = "qcom,parrot";
	qcom,board-id = <0 0x600>;
};

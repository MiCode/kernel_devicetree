/dts-v1/;
/plugin/;

#include "kalamap-vm.dtsi"
#include "kalamap-vm-iot-vc.dtsi"

/ {
	model = "Qualcomm Technologies, Inc. KalamaP SVM IOT VC";
	compatible = "qcom,kalamap-iot", "qcom,kalamap", "qcom,iot";
	qcom,board-id = <0x10020 1>;
};

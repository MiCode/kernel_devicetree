&reserved_memory {
	#address-cells = <2>;
	#size-cells = <2>;
	ranges;

	ecc_meta_data_reserved_mem: ecc_meta_data_reserved_region@b8000000 {
		no-map;
		reg = <0x0 0xb8000000 0x0 0x8000000>;
	};

	tenx_sp_mem: tenx_sp_region@800000000 {
		no-map;
		reg = <0x8 0x0 0x0 0x40000000>;
	};
};

/dts-v1/;
/plugin/;

#include "cliffs-qrd.dtsi"
#include "cliffs-pm7550ba.dtsi"

/ {
	model = "Qualcomm Technologies, Inc. Cliffs QRD";
	compatible = "qcom,cliffs-qrd", "qcom,cliffs", "qcom,cliffsp-qrd", "qcom,cliffsp", "qcom,qrd";
	qcom,msm-id = <614 0x10000>, <632 0x10000>, <642 0x10000>, <643 0x10000>;
	qcom,board-id = <11 0>;
};

#include <dt-bindings/interrupt-controller/irq.h>

bq25960h_standalone: bq25960h@3f {
        compatible = "bq,bq25960h-standalone";
        #io-channel-cells = <1>;
        status = "ok";
        dep-supply = <&qupv3_se8_i2c>;
        reg = <0x3f>;
        bq25960h,intr_gpio = <&tlmm 84 0>;
        charger_name = "primary_dvchg1";
};

bq25960_standalone: bq25960@65 {
        compatible = "bq,bq25960-standalone";
        #io-channel-cells = <1>;
        reg = <0x65>;
        status = "ok";
        dep-supply = <&qupv3_se8_i2c>;
        def-supply = <&bq25960h_standalone>;
        bq25960,intr_gpio = <&tlmm 24 0>;
        charger_name = "primary_dvchg";

        bq,bq25960,vbat-ovp-dis = <0>;
        bq,bq25960,vbat-ovp = <127>; /*3500 + val * 10*/
        bq,bq25960,vbat-ovp-alm-dis = <1>;
        bq,bq25960,vbat-ovp-alm = <122>; /*3500 + val * 10*/
        bq,bq25960,ibat-ocp-dis = <0>;
        bq,bq25960,ibat-ocp  = <61>; /*2000 + val * 100*/
        bq,bq25960,ibat-ocp-alm-dis = <1>;
        bq,bq25960,ibat-ocp-alm = <61>; /*2000 + val * 100*/
        bq,bq25960,ibus-ucp-dis = <0>;
        bq,bq25960,ibus-ucp = <0>;
        bq,bq25960,chg-config-2 = <0>;
        bq,bq25960,vbus-pd-en = <0>;
        bq,bq25960,vbus-ovp = <100>; /*7000 + val * 50*/
        bq,bq25960,vbus-ovp-alm-dis = <0>;
        bq,bq25960,vbus-ovp-alm = <100>; /*7000 + val * 50*/
        bq,bq25960,ibus-ocp = <13>; /*1000 + val * 250*/
        bq,bq25960,tsbus-flt-dis = <1>;
        bq,bq25960,tsbat-flt-dis = <1>;
        bq,bq25960,tdie-alm = <200>; /*25 + val * 0.5*/
        bq,bq25960,tsbus-flt = <21>;
        bq,bq25960,tsbat-flt = <21>;
        bq,bq25960,vac1-ovp = <3>; /*0:6.5V 1:10.5V 2:12V 3:14V 4:16V 5~7:18V*/
        bq,bq25960,vac2-ovp = <3>; /*0:6.5V 1:10.5V 2:12V 3:14V 4:16V 5~7:18V*/
        bq,bq25960,vac1-pd-en = <0>;
        bq,bq25960,vac2-pd-en = <0>;
        bq,bq25960,fsw-set = <4>; /*0:187.5KHz 1:250KHz 2:300KHz
                                    3:375KHz 4:500KHz 5:750KHz */
        bq,bq25960,wd-timeout = <0>; /*0:0.5s 1:1s 2:5s 3:30s*/
        bq,bq25960,wd-timeout-dis = <1>;
        bq,bq25960,ibat-sns-r = <0>; /*0:2mho 1:5mho*/
        bq,bq25960,ss-timeout = <5>; /*0:6.25ms 1:12.5ms 2:25ms 3:50ms
                                        4:100ms 5:400ms 6:1.5s 7:10s*/
        bq,bq25960,ibus-ucp-fall-dg = <1>; /*0:0.01ms, 1:5ms, 2:50ms, 3:150ms*/
        bq,bq25960,vout-ovp-dis = <0>;
        bq,bq25960,ms = <0>;
        bq,bq25960,vout-ovp = <3>; /*4700 + val * 100*/
};
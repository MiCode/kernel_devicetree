&soc{
    xm_smart_chg: xm_smart_chg {
        compatible = "xiaomi,xm_smart_chg";
        status = "ok";
                label = "smart_charging";

                xiaomi,pd-thermal-mitigation = <5950000 5400000 5000000
                4500000 4000000 3700000 3300000 3000000 2800000
                2600000 2400000 1500000 1000000 800000 500000
                400000 400000 400000 400000 400000>;

                xiaomi,pd-thermal-mitigation-fast = <5950000 5400000 5000000
                4500000 4000000 3700000 3300000 3000000 2800000
                2600000 2400000 1500000 1000000 800000 500000
                400000 400000 400000 400000 400000>;
    };
};

#include <dt-bindings/interrupt-controller/irq.h>

&soc {
    lc_chg_sysfs: lc_chg_sysfs {
        compatible = "lc,chg_sysfs";
        status = "ok";

        #io-channel-cells = <1>;
    };
};

&qupv3_se8_i2c {
	bob_supply: bob@75 {
		compatible = "richtek,rt6160";
		reg = <0x75>;
		regulator-name = "rt6160-buckboost";
		regulator-min-microvolt = <2025000>;
		regulator-max-microvolt = <5200000>;
	};
};

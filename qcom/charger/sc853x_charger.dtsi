 #include <dt-bindings/interrupt-controller/irq.h>

 sc853x_standalone: sc853x-charger@61{
        compatible = "southchip,sc853x-standalone";
        #io-channel-cells = <1>;
        reg = <0x61>;
        status = "ok";
        dep-supply = <&qupv3_se8_i2c>;
        sc853x,intr_gpio = <&tlmm 24 0>;
        charger_name = "primary_dvchg";
        charger_name_v4_19 = "primary_dvchg";

        sc,sc853x,vbat-ovp-dis = <0>;
        sc,sc853x,vbat-ovp = <90>; /*3840 + val * 10*/
        sc,sc853x,ibat-ocp-dis = <0>;
        sc,sc853x,ibat-ocp = <65>; /*val * 100*/
        sc,sc853x,vbus-ovp-dis = <0>;
        sc,sc853x,vbus-ovp = <3>; /*9250 + val * 250*/
        sc,sc853x,vac-ovp-dis = <0>;
        sc,sc853x,vac-ovp = <4>; /*0:6.5V 1:11V 2:12V 3:13V 4:14V 5~7:15V*/
        sc,sc853x,ibus-ocp-dis = <0>;
        sc,sc853x,ibus-ocp = <70>; /*val * 50*/
        sc,sc853x,pmid2out-ovp-dis = <0>;
        sc,sc853x,pmid2out-ovp = <0>; /*400 + val * 100*/
        sc,sc853x,pmid2out-uvp-dis = <0>;
        sc,sc853x,pmid2out-uvp = <1>; /*100 + val * 50*/
        sc,sc853x,ibatreg = <0>; /*200 + val * 100*/
        sc,sc853x,ibusreg = <0>; /*100 + val * 50*/
        sc,sc853x,vbatreg = <0>; /*50 + val * 50*/
        sc,sc853x,tdiereg = <1>; /*0:90°C 1:100°C 2:110°C 3:120°C*/
        sc,sc853x,them-flt = <24>; /*val * 25*/
        sc,sc853x,ibat-sns-res = <1>; /*0:2hmo 1:5hmo*/
        sc,sc853x,pmid-pd-en = <0>;
        sc,sc853x,vbus-pd-en = <0>;
        sc,sc8553,vac-pd-en = <0>;
        sc,sc853x,work-mode = <0>; /*0: 2:1charge   1: 1:1charge
                                     2: 1:2converte 3: 1:1converte*/
        sc,sc853x,ss-timeout = <7>; /*0:disable 1:10ms 2:20ms 3:400ms
                                    4:80ms 5:320ms 6:1.28s 7:10.24s*/
        sc,sc853x,wd-timeout-dis = <1>;
        sc,sc853x,wd-timeout = <0>; /*0:0.5s 1:1s 2:5s 3:30s*/
        sc,sc853x,vout-ovp-dis = <0>;
        sc,sc853x,vout-ovp = <3>; /*4700 + val * 100*/
        sc,sc853x,fsw-freq = <7>; /*500 + val * 100*/
        sc,sc853x,pin-diag-fall-dis = <0>;
        sc,sc853x,them-flt-dis = <1>;
        sc,sc853x,tshut-dis = <1>;
        sc,sc853x,vbus-in-range-dis = <0>;
        sc,sc853x,ibus-ucp-dis = <0>;
        sc,sc853x,ibat-reg-dis = <0>;
        sc,sc853x,ibus-reg-dis = <0>;
        sc,sc853x,vbat-reg-dis = <0>;
        sc,sc853x,tdie-reg-dis = <1>;
        sc,sc853x,ibat-ocp-dg = <0>; /*0:160us 1:80us 2:320us 3:5ms*/
        sc,sc853x,ibus-ucp-fall-dg = <1>; /*0:8us 1:5ms 2:40ms 3:160ms*/
        sc,sc853x,ibus-ocp-dg = <0>; /*0:160us 1:80us 2:320us 3:5ms*/
        sc,sc853x,vbat-ovp-dg = <0>; /*0:8us 1:160us 2:320us 3:5ms*/
};
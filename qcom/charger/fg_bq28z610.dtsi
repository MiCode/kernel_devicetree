#include <dt-bindings/interrupt-controller/irq.h>

fg_bq28z610: bq28z610@55 {
        compatible = "bq28z610";
        #io-channel-cells = <1>;
        reg = <0x55>;
        status = "ok";
        clock-frequency = <400000>;
        dep-supply = <&qupv3_se8_i2c>;
        enable_shutdown_delay;
        normal_shutdown_vbat_1s = <3400>;
        critical_shutdown_vbat_1s = <3310>;
        cool_critical_shutdown_vbat_1s = <3290>;
        old_critical_shutdown_vbat_1s = <3300>;
        report_full_rsoc_1s = <9700>;
        soc_gap_1s = <2>;
        soc_decimal_rate = <
                0  38
                10 35
                20 33
                30 33
                40 33
                50 33
                60 33
                70 30
                80 25
                90 20
                95 10 >;
	vbus_ctrl = <&pm7250b_gpios 5 0>;
	pinctrl-names = "default";
	pinctrl-0 = <&vbus_ctrl_default>;
};

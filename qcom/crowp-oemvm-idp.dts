/dts-v1/;

#include "crowp-oemvm.dtsi"
#include "crowp-oemvm-idp.dtsi"

/ {
	model = "Qualcomm Technologies, Inc. CrowP OEM VM IDP";
	compatible = "qcom,crowp-idp", "qcom,crowp", "qcom,idp";
	qcom,board-id = <34 0>;
};

// SPDX-License-Identifier: BSD-3-Clause
/*
 * Copyright (c) Qualcomm Technologies, Inc. and/or its subsidiaries.
 */

/dts-v1/;
/plugin/;

#include "alor-mtp-pm7550ba-smb1398.dtsi"
#include "alor-pm7550ba-smb1398.dtsi"

/ {
	model = "Qualcomm Technologies, Inc. Alor MTP + WCN7750 WLAN + PM7750BA SMB1398 + ST54L + Panderio";
	compatible = "qcom,alor-mtp", "qcom,alor", "qcom,mtp";
	qcom,msm-id = <685 0x10000>;
	qcom,board-id = <0x20008 0>;
};

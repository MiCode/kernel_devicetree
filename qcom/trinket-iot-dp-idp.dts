/dts-v1/;

#include "trinket-iot.dtsi"
#include "trinket-iot-idp.dtsi"

/ {
	model = "Qualcomm Technologies, Inc. TRINKET IOT Disp. Port Enable IDP";
	compatible = "qcom,trinket-iot-idp", "qcom,trinket-iot", "qcom,idp";
	qcom,board-id = <34 4>;
};

&usb0 {
	dwc3@4e00000 {
		usb-phy = <&qusb_phy0>, <&usb_nop_phy>;
		maximum-speed = "high-speed";
	};
};

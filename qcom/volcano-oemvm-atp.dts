/dts-v1/;

#include "volcano-oemvm.dtsi"
#include "volcano-oemvm-atp.dtsi"

/ {
	model = "Qualcomm Technologies, Inc. Volcano OEMVM ATP";
	compatible = "qcom,volcano-atp", "qcom,volcano", "qcom,atp";
	qcom,board-id = <33 0>;
};

// SPDX-License-Identifier: BSD-3-Clause
/*
 * Copyright (c) 2024 Qualcomm Innovation Center, Inc. All rights reserved.
 */

/dts-v1/;

#include "parrot-sg.dtsi"

/ {
	model = "Qualcomm Technologies, Inc. Parrot SG SoC";
	compatible = "qcom,parrot";
	qcom,board-id = <0 0>;
};

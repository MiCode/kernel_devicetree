// SPDX-License-Identifier: BSD-3-Clause
/*
 * Copyright (c) 2024 Qualcomm Innovation Center, Inc. All rights reserved.
 */

/dts-v1/;
/memreserve/ 0x90000000 0x00010000;

#include "ravelin.dtsi"
#include "ravelin-rumi.dtsi"

/ {
	model = "Qualcomm Technologies, Inc. Ravelin RUMI";
	compatible = "qcom,ravelin-rumi", "qcom,ravelin", "qcom,rumi";
	qcom,board-id = <0x1000F 0>;
};


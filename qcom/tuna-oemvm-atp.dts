// SPDX-License-Identifier: BSD-3-Clause
/*
 * Copyright (c) 2024 Qualcomm Innovation Center, Inc. All rights reserved.
 */

/dts-v1/;

#include "tuna-oemvm.dtsi"
#include "tuna-oemvm-atp.dtsi"

/ {
	model = "Qualcomm Technologies, Inc. Tuna OEMVM ATP";
	compatible = "qcom,tuna-atp", "qcom,tuna", "qcom,tunap-atp", "qcom,tunap",
			"qcom,atp";

	qcom,board-id = <33 0>;
};

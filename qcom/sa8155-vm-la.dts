/dts-v1/;

#include "sa8155-vm.dtsi"
#include "sa8155-vm-la.dtsi"

/ {
	model = "Qualcomm Technologies, Inc. SA8155 Single LA Guest Virtual Machine";
	compatible = "qcom,sa8155", "qcom,quinvm";
	qcom,board-id = <0x0 0x1000001>;
};

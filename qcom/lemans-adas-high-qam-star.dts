/dts-v1/;

#include "lemans-adas-high.dtsi"
#include "lemans-qam-star.dtsi"

/ {
	model = "Qualcomm Technologies, Inc. Lemans ADAS HIGH QAM STAR";
	compatible = "qcom,lemans", "qcom,qam-star", "qcom,lemans-adas-high", "qcom,lemans-adas-high-qam-star";
};


/dts-v1/;
/plugin/;

#include "sa8155-adp-star.dtsi"

/ {
	model = "ADP-STAR";
	compatible = "qcom,sa8155-adp-star", "qcom,sa8155",
		"qcom,adp-star";
	qcom,msm-id = <362 0x20000>;
	qcom,board-id = <25 0>;
};

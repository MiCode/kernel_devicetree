/dts-v1/;
/plugin/;

#include "zizhan-sde-display-cape-mtp.dtsi"

/ {
	model = "Qualcomm Technologies, Inc. 8475 zizhan";
	compatible = "qcom,cape-mtp", "qcom,cape", "qcom,mtp";
	qcom,msm-id = <530 0x10000>, <531 0x10000>, <540 0x10000>;
	qcom,board-id = <0x10008 0>;
	xiaomi,miboard-id = <0x5 0>;
};

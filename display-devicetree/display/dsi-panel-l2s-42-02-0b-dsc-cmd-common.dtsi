qcom,mdss-dsi-off-command = [
	05 00 00 00 00 00 01 28
	05 00 00 00 78 00 01 10
];
qcom,mdss-dsi-off-command-state = "dsi_hs_mode";

mi,mdss-dsi-dimmingon-command = [
	39 00 00 40 00 00 06 F0 55 AA 52 08 00
	39 00 00 40 00 00 02 B2 08
	39 00 00 40 00 00 02 6F 05
	/*DimmingSpeed set by last 2Bytes*/
	/*time = 32fps*/
	39 00 00 00 00 00 03 B2 20 20
	15 00 00 00 00 00 02 53 28
];
mi,mdss-dsi-dimmingon-command-state = "dsi_hs_mode";

mi,mdss-dsi-dimmingoff-command = [15 00 00 00 00 00 02 53 20];
mi,mdss-dsi-dimmingoff-command-state = "dsi_hs_mode";

mi,mdss-dsi-doze-hbm-command = [
	/*Base 120HZ*/
	39 00 00 40 00 00 02 2F 00
	/*30HZ*/
	39 00 00 40 00 00 06 F0 55 AA 52 08 00
	39 00 00 40 00 00 02 6F 06
	39 00 00 00 00 00 02 BB 70
	/*AOD Mode on*/
	39 00 00 40 00 00 02 5F 01
	39 00 00 40 00 00 07 51 00 00 0F FF 0F FF
	39 00 00 40 00 00 02 39 00
	39 00 00 00 00 00 02 65 01
];
mi,mdss-dsi-doze-hbm-command-state = "dsi_hs_mode";

mi,mdss-dsi-doze-lbm-command = [
	/*Base 120HZ*/
	39 00 00 40 00 00 02 2F 00
	/*30HZ*/
	39 00 00 40 00 00 06 F0 55 AA 52 08 00
	39 00 00 40 00 00 02 6F 06
	39 00 00 00 00 00 02 BB 70
	/*AOD Mode on*/
	39 00 00 40 00 00 02 5F 01
	39 00 00 40 00 00 07 51 00 00 0F FF 01 55
	39 00 00 40 00 00 02 39 00
	39 00 00 00 00 00 02 65 01
];
mi,mdss-dsi-doze-lbm-command-state = "dsi_hs_mode";

mi,mdss-dsi-local-hbm-normal-white-1000nit-command = [
	#include "dsi-panel-l2s-42-02-0b-dsc-cmd-lhbm-common.dtsi"
	39 00 00 40 00 00 06 F0 55 AA 52 08 00
	39 00 00 40 00 00 02 6F 2B
	39 00 00 40 00 00 07 DF 3F FF 3F FF 3F FF
	39 00 00 40 00 00 02 6F 01
	39 00 00 40 00 00 03 87 0B AC
	39 00 00 40 00 00 03 51 3F FF
	39 00 00 40 00 00 02 53 20
	39 00 00 40 00 00 02 87 21
	39 00 00 00 00 00 01 85
];
mi,mdss-dsi-local-hbm-normal-white-1000nit-command-update = <0x87 114 2>;
mi,mdss-dsi-local-hbm-normal-white-1000nit-command-state = "dsi_hs_mode";

mi,mdss-dsi-local-hbm-hlpm-white-1000nit-command = [
	/*AOD OFF*/
	39 00 00 40 00 00 02 65 00
	39 00 00 00 00 00 01 38
	#include "dsi-panel-l2s-42-02-0b-dsc-cmd-lhbm-common.dtsi"
	39 00 00 40 00 00 06 F0 55 AA 52 08 00
	39 00 00 40 00 00 02 6F 2B
	39 00 00 40 00 00 07 DF 3F FF 3F FF 3F FF
	39 00 00 40 00 00 02 6F 01
	39 00 00 40 00 00 03 87 0B AC
	39 00 00 40 00 00 03 51 3F FF
	39 00 00 40 00 00 02 53 20
	39 00 00 40 00 00 02 87 21
	39 00 00 00 00 00 01 85
];
mi,mdss-dsi-local-hbm-hlpm-white-1000nit-command-update = <0x87 116 2>;
mi,mdss-dsi-local-hbm-hlpm-white-1000nit-command-state = "dsi_hs_mode";

mi,mdss-dsi-local-hbm-normal-white-750nit-command = [
	#include "dsi-panel-l2s-42-02-0b-dsc-cmd-lhbm-common.dtsi"
	39 00 00 40 00 00 06 F0 55 AA 52 08 00
	39 00 00 40 00 00 02 6F 2B
	39 00 00 40 00 00 07 DF 2F FF 2F FF 2F FF
	39 00 00 40 00 00 02 6F 01
	39 00 00 40 00 00 03 87 0B AC
	39 00 00 40 00 00 03 51 3F FF
	39 00 00 40 00 00 02 53 20
	39 00 00 40 00 00 02 87 21
	39 00 00 00 00 00 01 85
];
mi,mdss-dsi-local-hbm-normal-white-750nit-command-state = "dsi_hs_mode";

mi,mdss-dsi-local-hbm-normal-white-500nit-command = [
	#include "dsi-panel-l2s-42-02-0b-dsc-cmd-lhbm-common.dtsi"
	39 00 00 40 00 00 06 F0 55 AA 52 08 00
	39 00 00 40 00 00 02 6F 2B
	39 00 00 40 00 00 07 DF 1F FF 1F FF 1F FF
	39 00 00 40 00 00 02 6F 01
	39 00 00 40 00 00 03 87 0B AC
	39 00 00 40 00 00 03 51 3F FF
	39 00 00 40 00 00 02 53 20
	39 00 00 40 00 00 02 87 21
	39 00 00 00 00 00 01 85
];
mi,mdss-dsi-local-hbm-normal-white-500nit-command-state = "dsi_hs_mode";

mi,mdss-dsi-local-hbm-normal-white-110nit-command = [
	#include "dsi-panel-l2s-42-02-0b-dsc-cmd-lhbm-common.dtsi"
	39 00 00 40 00 00 06 F0 55 AA 52 08 00
	39 00 00 40 00 00 02 6F 2B
	39 00 00 40 00 00 07 DF 07 0A 07 0A 07 0A
	39 00 00 40 00 00 02 6F 01
	39 00 00 40 00 00 03 87 05 DC
	39 00 00 40 00 00 03 51 3F FF
	39 00 00 40 00 00 02 53 20
	39 00 00 40 00 00 02 87 21
	39 00 00 00 00 00 01 85
];
mi,mdss-dsi-local-hbm-normal-white-110nit-command-update  = <0x87 114 2>;
mi,mdss-dsi-local-hbm-normal-white-110nit-command-state = "dsi_hs_mode";

mi,mdss-dsi-local-hbm-hlpm-white-110nit-command = [
	/*AOD OFF*/
	39 00 00 40 00 00 02 65 00
	39 00 00 00 00 00 01 38
	#include "dsi-panel-l2s-42-02-0b-dsc-cmd-lhbm-common.dtsi"
	39 00 00 40 00 00 06 F0 55 AA 52 08 00
	39 00 00 40 00 00 02 6F 2B
	39 00 00 40 00 00 07 DF 07 0A 07 0A 07 0A
	39 00 00 40 00 00 02 6F 01
	39 00 00 40 00 00 03 87 05 DC
	39 00 00 40 00 00 03 51 3F FF
	39 00 00 40 00 00 02 53 20
	39 00 00 40 00 00 02 87 21
	39 00 00 00 00 00 01 85
];
mi,mdss-dsi-local-hbm-hlpm-white-110nit-command-update = <0x87 114 2>;
mi,mdss-dsi-local-hbm-hlpm-white-110nit-command-state = "dsi_hs_mode";

mi,mdss-dsi-local-hbm-normal-green-500nit-command = [
	#include "dsi-panel-l2s-42-02-0b-dsc-cmd-lhbm-common.dtsi"
	39 00 00 40 00 00 06 F0 55 AA 52 08 00
	39 00 00 40 00 00 02 6F 2B
	39 00 00 40 00 00 07 DF 00 00 1F FF 00 00
	39 00 00 40 00 00 02 6F 01
	39 00 00 40 00 00 03 87 0B AC
	39 00 00 40 00 00 03 51 3F FF
	39 00 00 40 00 00 02 53 20
	39 00 00 40 00 00 02 87 21
	39 00 00 00 00 00 01 85
];
mi,mdss-dsi-local-hbm-normal-green-500nit-command-update = <0x87 114 2>;
mi,mdss-dsi-local-hbm-normal-green-500nit-command-state = "dsi_hs_mode";

mi,mdss-dsi-local-hbm-off-to-normal-command = [
	39 00 00 40 00 00 02 53 20
	39 00 00 40 00 00 01 86
	39 00 00 00 00 00 02 87 20
	39 00 00 00 00 00 03 51 00 00
];
mi,mdss-dsi-local-hbm-off-to-normal-command-update = <0x51 3 2>;
mi,mdss-dsi-local-hbm-off-to-normal-command-state = "dsi_hs_mode";

mi,mdss-dsi-local-hbm-off-to-hbm-command = [
	39 00 00 40 00 00 02 53 20
	39 00 00 40 00 00 01 86
	39 00 00 00 00 00 02 87 20
	39 00 00 00 00 00 03 51 0F FF
];
mi,mdss-dsi-local-hbm-off-to-hbm-command-update = <0x51 3 2>;
mi,mdss-dsi-local-hbm-off-to-hbm-command-state = "dsi_hs_mode";

mi,mdss-dsi-local-hbm-off-to-hlpm-command = [
	39 00 00 40 00 00 02 53 20
	39 00 00 40 00 00 01 86
	39 00 00 00 00 00 02 87 20
	/*Base 120HZ*/
	39 00 00 40 00 00 02 2F 00
	/*30HZ*/
	39 00 00 40 00 00 06 F0 55 AA 52 08 00
	39 00 00 40 00 00 02 6F 06
	39 00 00 00 00 00 02 BB 70
	/*AOD Mode on*/
	39 00 00 40 00 00 02 5F 01
	39 00 00 40 00 00 07 51 00 00 0F FF 0F FF
	39 00 00 40 00 00 02 39 00
	39 00 00 00 00 00 02 65 01
];
mi,mdss-dsi-local-hbm-off-to-hlpm-command-state = "dsi_hs_mode";

mi,mdss-dsi-local-hbm-off-to-llpm-command = [
	39 00 00 40 00 00 02 53 20
	39 00 00 40 00 00 01 86
	39 00 00 00 00 00 02 87 20
	/*Base 120HZ*/
	39 00 00 40 00 00 02 2F 00
	/*30HZ*/
	39 00 00 40 00 00 06 F0 55 AA 52 08 00
	39 00 00 40 00 00 02 6F 06
	39 00 00 00 00 00 02 BB 70
	/*AOD Mode on*/
	39 00 00 40 00 00 02 5F 01
	39 00 00 40 00 00 07 51 00 00 0F FF 01 55
	39 00 00 40 00 00 02 39 00
	39 00 00 00 00 00 02 65 01
];
mi,mdss-dsi-local-hbm-off-to-llpm-command-state = "dsi_hs_mode";

mi,mdss-dsi-hbm-on-command = [
	39 00 00 00 00 00 03 51 0F FF
];
mi,mdss-dsi-hbm-on-command-state = "dsi_hs_mode";

mi,mdss-dsi-hbm-off-command = [
	39 00 00 00 00 00 03 51 07 FF
];
mi,mdss-dsi-hbm-off-command-state = "dsi_hs_mode";

mi,mdss-dsi-hbm-fod-on-command = [
	39 00 00 00 00 00 03 51 0F FF
];
mi,mdss-dsi-hbm-fod-on-command-state = "dsi_hs_mode";

mi,mdss-dsi-hbm-fod-off-command = [
	39 00 00 00 00 00 03 51 07 FF
];
mi,mdss-dsi-hbm-fod-off-command-state = "dsi_hs_mode";

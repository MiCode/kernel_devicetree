/dts-v1/;
/plugin/;

#include "zeus-sde-display-mtp.dtsi"

/ {
	model = "Qualcomm Technologies, Inc. 8450 zeus";
	compatible = "qcom,waipio-mtp", "qcom,waipio", "qcom,mtp";
	qcom,msm-id = <457 0x10000>, <482 0x10000>, <457 0x20000>, <482 0x20000>, <552 0x10000>;
	qcom,board-id = <0x10008 0>;
	xiaomi,miboard-id = <0x1 0>;
};

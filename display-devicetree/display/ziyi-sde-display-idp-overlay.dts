/dts-v1/;
/plugin/;

#include "ziyi-sde-display-idp.dtsi"
/ {
	model = "Ziyi based on Qualcomm Technologies, Inc. Diwali IDP";
	compatible = "qcom,diwali-idp", "qcom,diwali", "qcom,idp";
	qcom,msm-id = <506 0x10000>, <547 0x10000>;
	qcom,board-id = <34 0>;
	xiaomi,miboard-id = <0x9 0>;
};
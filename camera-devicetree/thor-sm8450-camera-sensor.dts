/dts-v1/;
/plugin/;

#include <dt-bindings/clock/qcom,gcc-waipio.h>
#include <dt-bindings/clock/qcom,camcc-waipio.h>
#include <dt-bindings/interconnect/qcom,waipio.h>
#include <dt-bindings/interrupt-controller/arm-gic.h>
#include <dt-bindings/regulator/qcom,rpmh-regulator-levels.h>

#include "thor-sm8450-camera-sensor.dtsi"
/ {
	model = "Qualcomm Technologies, Inc. 8450 thor";
	compatible = "qcom,waipio", "qcom,waipiop";
	qcom,msm-id = <457 0x10000>, <482 0x10000>, <457 0x20000>, <482 0x20000>, <552 0x10000>;
	qcom,board-id = <8 0>, <0x10008 0>, <0x02010008 0>, <0x03010008 0x03>, <0x04010008 0x04>;
	xiaomi,miboard-id = <0x6 0>;
};

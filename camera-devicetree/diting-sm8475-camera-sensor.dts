/dts-v1/;
/plugin/;

#include <dt-bindings/clock/qcom,gcc-waipio.h>
#include <dt-bindings/clock/qcom,camcc-waipio.h>
#include <dt-bindings/interconnect/qcom,waipio.h>
#include <dt-bindings/interrupt-controller/arm-gic.h>
#include <dt-bindings/regulator/qcom,rpmh-regulator-levels.h>

#include "diting-sm8475-camera-sensor.dtsi"
/ {
	model = "Qualcomm Technologies, Inc. 8475 diting";
	compatible = "qcom,cape", "qcom,capep";
	qcom,msm-id = <530 0x10000>, <531 0x10000>, <540 0x10000>;
	qcom,board-id = <0x10008 0>;
	xiaomi,miboard-id = <0xA 0>;
};

/dts-v1/;
/plugin/;

#include <dt-bindings/clock/qcom,gcc-waipio.h>
#include <dt-bindings/clock/qcom,camcc-waipio.h>
#include <dt-bindings/interconnect/qcom,waipio.h>
#include <dt-bindings/interrupt-controller/arm-gic.h>
#include <dt-bindings/regulator/qcom,rpmh-regulator-levels.h>

#include "ziyi-sm7450-camera-sensor.dtsi"
/ {
	model = "Qualcomm Technologies, Inc. 7450 ziyi";
	compatible = "qcom,waipio", "qcom,waipiop";
	qcom,msm-id = <506 0x10000>, <547 0x10000>;
	qcom,board-id = <34 0>;
	xiaomi,miboard-id = <0x9 0>;
};
